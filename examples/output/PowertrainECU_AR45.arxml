AUTOSAR XML (schema 00050)
package /PowertrainECU_AR45
  ecuc value collection PowertrainECU_AR45_EcucValues: uuid=551a78e6-4138-4322-9a9e-df6b6d4399af, ecu-extract-version=1.0.0
    ecuc-values:
      module config CanIf: uuid=38595922-d39e-426f-b168-a0181d4b641b, implementation-config-variant=VariantPostBuild
        CanIfInitCfg: uuid=75ba8aa2-cb2d-414f-b333-b6b5c1f1b66f
          CanIfCtrlCfg_PowertrainCAN (CanIfCtrlCfg): uuid=02172a75-b946-40f8-9d70-ea65c1967721
            ecuc numerical param value CanIfCtrlId: uuid=5567188a-0f8a-48e1-99a6-cbc6faa7d103, value=0
          CanIfRxPdu_PowertrainCAN_EngineData (CanIfRxPduCfg): uuid=226c5d79-9365-4dc1-bb32-ffe8114dd3b2
            ecuc numerical param value CanIfRxPduId: uuid=f17989e5-d61c-4bf8-8466-bf47ef6e2f86, value=256
            ecuc numerical param value CanIfRxPduCanId: uuid=12620819-0493-4c27-bebf-8a8293642543, value=256
      module config Can: uuid=4cb53ad0-4b6d-4da9-8b95-67d244290cf5, implementation-config-variant=VariantPostBuild
        CanGeneral: uuid=58b72061-7e3c-482c-9b36-e2a06a35f04b
          ecuc numerical param value CanDevErrorDetect: uuid=352188d7-6548-461e-84e1-ddeffcd9e6d2, value=true
        CanConfigSet: uuid=003ffb08-1245-414e-98df-9663e421846e
          CanController_PowertrainCAN (CanController): uuid=9a04bbdd-46d6-46bf-936c-eca8624c765b
            ecuc numerical param value CanControllerId: uuid=1e249916-1b25-4d1d-9c87-5445bee6bd97, value=0
            ecuc numerical param value CanControllerBaudRate: uuid=b493cc29-4d7b-4da8-82e5-dab1be706d06, value=500000
