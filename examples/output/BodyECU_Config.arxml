AUTOSAR XML (schema 4-2-2)
package /BodyECU_Config
  ecuc value collection BodyECU_Config_EcucValues: uuid=100c8b9f-585d-4feb-8476-77ab9e68d9cd, ecu-extract-version=1.0.0
    ecuc-values:
      module config CanIf: uuid=a9acd3e0-1733-4ebc-8c03-76d979fd77a2, implementation-config-variant=VariantPostBuild
        CanIfInitCfg: uuid=aab33bbf-97e3-4a60-ab2e-0f6e1d58a6ac
          CanIfCtrlCfg_BodyCAN (CanIfCtrlCfg): uuid=099f65be-a25c-4ad7-b1f7-69dd33c7ebc6
            ecuc numerical param value CanIfCtrlId: uuid=3a7a1718-ecb0-4f1f-99d8-14dfcdc94709, value=0
          CanIfRxPdu_BodyCAN_DoorStatus (CanIfRxPduCfg): uuid=8ff9847c-8447-4887-9582-f1a7bd90fa26
            ecuc numerical param value CanIfRxPduId: uuid=660b1141-db81-4c87-ace8-9441a5df8d71, value=512
            ecuc numerical param value CanIfRxPduCanId: uuid=b437405d-e3c2-4674-8cc9-3ed41b311619, value=512
      module config Can: uuid=61cdbade-70db-46b6-b8df-918057f1dc31, implementation-config-variant=VariantPostBuild
        CanGeneral: uuid=082dc947-d027-479c-bb9c-836e7c44a4f9
          ecuc numerical param value CanDevErrorDetect: uuid=bebf7fa6-e8ad-421f-8065-c6d21f791839, value=true
        CanConfigSet: uuid=87b4127f-232a-42b0-9614-1d5738a34aa3
          CanController_BodyCAN (CanController): uuid=00c851e8-714a-49e3-aea2-5414e36e3dee
            ecuc numerical param value CanControllerId: uuid=6bf34fdf-f90b-4a0e-89e6-4323fc6e28c0, value=0
            ecuc numerical param value CanControllerBaudRate: uuid=7fa21bc1-9e6c-442e-b926-6a724b1627b6, value=500000
      module config LinIf: uuid=4aa7926c-786d-487d-93d6-d4d9f167800b, implementation-config-variant=VariantPostBuild
        LinIfGlobalConfig: uuid=736bf8e0-8d55-4211-9394-577653bd869a
          ecuc numerical param value LinIfDevErrorDetect: uuid=04207d8a-75ab-48f8-b636-bd10d32be318, value=true
        LinIfChannel_DoorLIN (LinIfChannel): uuid=45f779a4-49c3-4969-b205-acd2213b00de
          LinIfFrame_DoorCommand (LinIfFrame): uuid=cbb34235-7070-45ba-bfeb-73863bbc7709
            ecuc textual param value LinIfFrameType: uuid=27435edf-b724-4b87-8bdb-0f6eb8a74e66, value=unconditional
      module config Lin: uuid=d5fceda0-4888-4f84-891c-d8fe61926592, implementation-config-variant=VariantPostBuild
        LinGeneral: uuid=c635dab2-35f8-4fff-9efc-05fe4b26d0d9
          ecuc numerical param value LinDevErrorDetect: uuid=46fa2b9f-f76c-414f-a25d-97160674c74f, value=true
        LinChannel_DoorLIN (LinChannel): uuid=dcf90f53-fadb-4868-b10d-ae93ab097c16
          ecuc numerical param value LinChannelBaudRate: uuid=1eb2ff64-83ef-42c5-9295-14f4f9c8c178, value=19200
