VERSION ""

NS_ :

BS_:

BU_: ECM

BO_ 513 BRAKE_FD_1: 32 Vector__XXX
 SG_ VehicleStandStillSts : 111|2@0+ (1,0) [0|2] "-"  ECM
 SG_ BrkTrq_Driver : 150|15@0+ (3,0) [0|98301] "Nm"  ECM
 SG_ BrkTrq : 94|15@0+ (3,0) [0|98301] "Nm"  ECM
 SG_ SelectSpdSts : 165|2@0+ (1,0) [0|2] "-"  ECM
 SG_ REF_VEH_SPEED : 57|10@0+ (0.5,0) [0|511] "kph"  ECM
 SG_ MessageCounter_BRAKE1 : 179|4@0+ (1,0) [0|15] "-"  ECM
 SG_ CRC_BRAKE1 : 191|8@0+ (1,0) [0|255] "-"  ECM
 SG_ HILL_DES_STAT : 79|3@0+ (1,0) [0|7] "-"  ECM
 SG_ EngSpdIntervReq : 95|1@0+ (1,0) [0|1] "-"  ECM
 SG_ EngSpdInterv : 163|16@0+ (1,0) [0|65535] "rpm"  ECM

BO_ 1066 BCM_FD_9: 32 Vector__XXX
 SG_ PowerModeSts : 161|2@0+ (1,0) [0|3] "" ECM
 SG_ ParkBrakeSts : 180|1@0+ (1,0) [0|1] "-"  ECM
 SG_ FuelLevel : 135|8@0+ (1,0) [0|255] "%"  ECM
 SG_ BonnetSts : 182|1@0+ (1,0) [0|1] "-"  ECM
 SG_ RHRDoorSts : 42|1@0+ (1,0) [0|1] "-"  ECM
 SG_ RHatchSts : 43|1@0+ (1,0) [0|1] "-"  ECM
 SG_ PsngrDoorSts : 46|1@0+ (1,0) [0|1] "-"  ECM
 SG_ MessageCounter_BCM9 : 179|4@0+ (1,0) [0|15] "-"  ECM
 SG_ LowFuelWarningSts : 47|1@0+ (1,0) [0|1] "-"  ECM
 SG_ LHRDoorSts : 32|1@0+ (1,0) [0|1] "-"  ECM
 SG_ FrontWiperMoveSts : 60|1@0+ (1,0) [0|1] "" ECM
 SG_ DriverDoorSts : 35|1@0+ (1,0) [0|1] "-"  ECM
 SG_ CRC_BCM9 : 191|8@0+ (1,0) [0|255] "-"  ECM
 SG_ FuelLevel2 : 143|8@0+ (0.5,0) [0|127.5] "%"  ECM

BO_ 1827 BCM_FD_7: 32 Vector__XXX
 SG_ IgnitionOnCounter : 95|16@0+ (1,0) [0|65535] "-"  ECM

BO_ 1375 BCM_FD_6: 32 Vector__XXX
 SG_ ChkFuelLevelSts : 99|3@0+ (1,0) [0|7] "-"  ECM
 SG_ ChkFuelLevelSts2 : 102|3@0+ (1,0) [0|7] "-"  ECM

BO_ 1051 BCM_FD_4: 32 Vector__XXX
 SG_ FUEL_VOLT : 143|8@0+ (0.019607843,0) [0|4.98] "Volt"  ECM
 SG_ ExternalTemperatureAD_Voltage : 159|8@0+ (0.019607843,0) [0|4.98] "Volt"  ECM
 SG_ VoltageMin : 119|8@0+ (0.025,10.6) [10.6|16.975] "Volt"  ECM
 SG_ VoltageMax : 127|8@0+ (0.025,10.6) [10.6|16.975] "Volt"  ECM
 SG_ FUEL_VOLT2 : 151|8@0+ (0.019607843,0) [0|4.98] "Volt"  ECM
 SG_ BCMSAMFailSts : 183|1@0+ (1,0) [0|1] "-"  ECM
 SG_ AM_ECM_Trace : 71|2@0+ (1,0) [0|2] "-"  ECM
 SG_ MessageCounter_BCM4 : 179|4@0+ (1,0) [0|15] "-"  ECM
 SG_ CRC_BCM4 : 191|8@0+ (1,0) [0|255] "-"  ECM

BO_ 256 BCM_FD_2: 32 Vector__XXX
 SG_ StartRelayBCMSts : 109|1@0+ (1,0) [0|1] "" ECM
 SG_ StartRelayBCMFault : 108|1@0+ (1,0) [0|1] "" ECM
 SG_ OperationalModeSts : 75|4@0+ (1,0) [0|15] "" ECM
 SG_ EngineOffRequest : 119|1@0+ (1,0) [0|1] "-"  ECM
 SG_ RemStActvSts_R : 7|1@0+ (1,0) [0|1] "" ECM
 SG_ RefuelRequest : 19|2@0+ (1,0) [0|3] "" ECM
 SG_ MessageCounter_BCM2 : 179|4@0+ (1,0) [0|15] "-"  ECM
 SG_ CRC_BCM2 : 191|8@0+ (1,0) [0|255] "-"  ECM

BO_ 512 BCM_FD_18: 32 Vector__XXX
 SG_ LeakCheckTimerExpired : 73|2@0+ (1,0) [0|0] "" ECM
 SG_ FuelDrRelSwRawSt : 87|8@0+ (0.019607843,0) [0|4.98] "Volts"  ECM
 SG_ DriverDoorAjarXtionSts : 39|2@0+ (1,0) [0|3] "-"  ECM
 SG_ DriverDoor2AjarXtionSts : 37|2@0+ (1,0) [0|3] "-"  ECM
 SG_ DriverDoorAjarRawValSts_8 : 31|8@0+ (0.019607843,0) [0|4.999999965] "Volt"  ECM
 SG_ DriverDoor2AjarRawValSts_8 : 7|8@0+ (0.019607843,0) [0|4.999999965] "Volt"  ECM
 SG_ BonnetAjarRawValSts_8 : 15|8@0+ (0.019607843,0) [0|4.999999965] "Volt"  ECM
 SG_ MessageCounter_BCM18 : 179|4@0+ (1,0) [0|15] "-"  ECM
 SG_ CRC_BCM18 : 191|8@0+ (1,0) [0|255] "-"  ECM

BO_ 736 BCM_FD_14: 32 Vector__XXX
 SG_ Command_15Sts : 111|2@0+ (1,0) [0|2] "" ECM

BO_ 159 BCM_FD_13: 32 Vector__XXX
 SG_ SpeedLimiterOnOffSts : 81|1@0+ (1,0) [0|1] "" ECM
 SG_ MC_CSWC_1 : 95|4@0+ (1,0) [0|15] "" ECM
 SG_ CrusCnclSwitch : 84|1@0+ (1,0) [0|1] "" ECM
 SG_ CRC_CSWC_1 : 103|8@0+ (1,0) [0|255] "" ECM
 SG_ ACC_On : 85|1@0+ (1,0) [0|1] "" ECM
 SG_ MessageCounter_BCM13 : 179|4@0+ (1,0) [0|15] "-"  ECM
 SG_ CRC_BCM13 : 191|8@0+ (1,0) [0|255] "-"  ECM
 SG_ ResumeSwitch : 108|1@0+ (1,0) [0|1] "" ECM
 SG_ DeceleratorSts : 109|1@0+ (1,0) [0|1] "" ECM
 SG_ CruiseControlOnOffSts : 111|1@0+ (1,0) [0|1] "" ECM
 SG_ CruiseControlFailSts : 107|1@0+ (1,0) [0|1] "" ECM
 SG_ AcceleratorSts : 110|1@0+ (1,0) [0|1] "" ECM

BO_ 1431 BCM_FD_12: 32 Vector__XXX
 SG_ TerrainSwStat : 7|3@0+ (1,0) [0|6] "" ECM
 SG_ Sport_Request : 103|3@0+ (1,0) [0|6] "" ECM
 SG_ TerrainModeInterfaceButton_BCM : 74|3@0+ (1,0) [0|6] "" ECM
 SG_ Right_Button_BCM : 77|3@0+ (1,0) [0|6] "" ECM
 SG_ Left_Button_BCM : 58|3@0+ (1,0) [0|6] "" ECM
 SG_ Launch_Hard_Btn : 138|3@0+ (1,0) [0|7] "" ECM

BO_ 1430 BCM_FD_11: 32 Vector__XXX
 SG_ Parallel_Prk_Ast_Pad1 : 172|3@0+ (1,0) [0|6] "-"  ECM
 SG_ AcOutputCurrentSts : 55|8@0+ (0.008,0) [0|2.04] "A"  ECM
 SG_ StopStartClimateInfo : 175|3@0+ (1,0) [0|7] "" ECM

BO_ 1153 BCM_FD_10: 32 Vector__XXX
 SG_ ExternalTemperatureC : 80|9@0+ (0.5,-85) [-85|170] "°C"  ECM
 SG_ CompressorACReqSts : 175|1@0+ (1,0) [0|1] "-"  ECM
 SG_ CmdIgnSts : 138|3@0+ (1,0) [0|7] "" ECM
 SG_ SpSt_Pad1 : 149|3@0+ (1,0) [0|6] "" ECM
 SG_ MessageCounter_BCM10 : 179|4@0+ (1,0) [0|15] "-"  ECM
 SG_ CRC_BCM10 : 191|8@0+ (1,0) [0|255] "-"  ECM

BO_ 1445 ASCM_FD_2: 32 Vector__XXX
 SG_ ASCM_Stat : 135|4@0+ (1,0) [0|14] "-"  ECM

BO_ 2654555920 APPL_ECU_FD_ECM: 64 Vector__XXX
 SG_ APPL_ECU_FD_ECM : 455|64@0+ (1,0) [0|0] "" ECM

BO_ 1465 TELEMATIC_FD_14: 32 Vector__XXX
 SG_ PSI_Rq : 47|2@0+ (1,0) [0|3] "-"  ECM
 SG_ PSI_RPM_Reset : 45|1@0+ (1,0) [0|1] "-"  ECM
 SG_ PSI_Gr5_RPM_SET : 39|5@0+ (250,500) [2000|8000] "rpm"  ECM
 SG_ PSI_Gr4_RPM_SET : 31|5@0+ (250,500) [2000|8000] "rpm"  ECM
 SG_ PSI_Gr3_RPM_SET : 23|5@0+ (250,500) [2000|8000] "rpm"  ECM
 SG_ PSI_Gr2_RPM_SET : 15|5@0+ (250,500) [2000|8000] "rpm"  ECM
 SG_ PSI_Gr1_RPM_SET : 7|5@0+ (250,500) [2000|8000] "rpm"  ECM
 SG_ RACE_CLDWN_ON_OFF_REQ : 2|1@0+ (1,0) [0|0] "-"  ECM
 SG_ Trns_DrvMdReq : 95|4@0+ (1,0) [0|14] "-"  ECM

BO_ 255 PT_TORQUE_FD_1: 48 ECM
 SG_ SumTorqueTgt_SEM : 130|11@0+ (1,-500) [-500|1546] "Nm"  Vector__XXX
 SG_ SumTorqueStatic_SEM : 114|11@0+ (1,-500) [-500|1546] "Nm"  Vector__XXX
 SG_ SumTorqueStatic : 98|11@0+ (1,-500) [-500|1546] "Nm"  Vector__XXX
 SG_ SumTorqueSel_D_TTC : 82|11@0+ (1,-500) [-500|1546] "Nm"  Vector__XXX
 SG_ SumTorqueMin : 66|11@0+ (1,-500) [-500|1546] "Nm"  Vector__XXX
 SG_ SumTorqueMax : 50|11@0+ (1,-500) [-500|1546] "Nm"  Vector__XXX
 SG_ SumTorqueExp : 34|11@0+ (1,-500) [-500|1546] "Nm"  Vector__XXX
 SG_ SumTorque_DrvReqMod : 20|13@0+ (0.25,-500) [-500|1547.5] "Nm"  Vector__XXX
 SG_ MotorB_Speed : 7|16@0+ (1,-16382) [-16382|49151] "RPM"  Vector__XXX
 SG_ MessageCounter_PT_TORQUE_FD_1 : 307|4@0+ (1,0) [0|15] "-"  Vector__XXX
 SG_ CRC_PT_TORQUE_FD_1 : 319|8@0+ (1,0) [0|255] "-"  Vector__XXX
 SG_ SSC_TrqEnblRq_Allowed : 22|1@0+ (1,0) [0|1] "-"  Vector__XXX
 SG_ ESC_TrqEnblRq_Allowed : 38|1@0+ (1,0) [0|1] "-"  Vector__XXX
 SG_ Accel_Pedal_Override : 37|1@0+ (1,0) [0|1] "-"  Vector__XXX
 SG_ ACC_NCC_TrqEnblRq_Allowed : 23|1@0+ (1,0) [0|1] "-"  Vector__XXX
 SG_ Total_AxleTorque_Static : 151|16@0+ (2,-65534) [-65534|65536] "Nm"  Vector__XXX
 SG_ Rear_AxleTorque_Static : 183|16@0+ (2,-65534) [-65534|65536] "Nm"  Vector__XXX
 SG_ Front_AxleTorque_Static : 167|16@0+ (2,-65534) [-65534|65536] "Nm"  Vector__XXX
 SG_ Veh_StandStill_Req_OPD : 36|2@0+ (1,0) [0|3] "" Vector__XXX
 SG_ Front_Axle_Target_Torque : 199|16@0+ (2,-65535) [-65535|65535] "Nm"  Vector__XXX
 SG_ Rear_Axle_Target_Torque : 215|16@0+ (2,-65535) [-65535|65535] "Nm"  Vector__XXX

BO_ 2654339184 PDC_INFO_FD_SGW: 64 Vector__XXX
 SG_ GenericFailSts_FD11_SGW : 269|1@0+ (1,0) [0|1] "" ECM
 SG_ GenericFailSts_FD08_SGW : 357|1@0+ (1,0) [0|1] "" ECM
 SG_ GenericFailSts_FD03_SGW : 181|1@0+ (1,0) [0|1] "" ECM
 SG_ GenericFailSts_FD02_SGW : 93|1@0+ (1,0) [0|1] "" ECM
 SG_ GenericFailSts_FD01_SGW : 5|1@0+ (1,0) [0|1] "" ECM
 SG_ EOL_FD11_SGW : 271|1@0+ (1,0) [0|1] "-"  ECM
 SG_ EOL_FD08_SGW : 359|1@0+ (1,0) [0|1] "-"  ECM
 SG_ EOL_FD03_SGW : 183|1@0+ (1,0) [0|1] "-"  ECM
 SG_ EOL_FD02_SGW : 95|1@0+ (1,0) [0|1] "-"  ECM
 SG_ EOL_FD01_SGW : 7|1@0+ (1,0) [0|1] "-"  ECM
 SG_ CurrentFailSts_FD11_SGW : 270|1@0+ (1,0) [0|1] "" ECM
 SG_ CurrentFailSts_FD08_SGW : 358|1@0+ (1,0) [0|1] "" ECM
 SG_ CurrentFailSts_FD03_SGW : 182|1@0+ (1,0) [0|1] "" ECM
 SG_ CurrentFailSts_FD02_SGW : 94|1@0+ (1,0) [0|1] "" ECM
 SG_ CurrentFailSts_FD01_SGW : 6|1@0+ (1,0) [0|1] "" ECM
 SG_ WakeupSource_FD11_SGW : 287|8@0+ (1,0) [0|255] "" ECM
 SG_ WakeupSource_FD08_SGW : 375|8@0+ (1,0) [0|255] "" ECM
 SG_ WakeupSource_FD03_SGW : 199|8@0+ (1,0) [0|255] "" ECM
 SG_ WakeupSource_FD02_SGW : 111|8@0+ (1,0) [0|255] "" ECM
 SG_ WakeupSource_FD01_SGW : 23|8@0+ (1,0) [0|255] "" ECM
 SG_ PreviousCanNMState_FD11_SGW : 275|4@0+ (1,0) [0|15] "" ECM
 SG_ PreviousCanNMState_FD08_SGW : 363|4@0+ (1,0) [0|15] "" ECM
 SG_ PreviousCanNMState_FD03_SGW : 187|4@0+ (1,0) [0|15] "" ECM
 SG_ PreviousCanNMState_FD02_SGW : 99|4@0+ (1,0) [0|15] "" ECM
 SG_ PreviousCanNMState_FD01_SGW : 11|4@0+ (1,0) [0|15] "" ECM
 SG_ DES_FD11_SGW : 268|2@0+ (1,0) [0|3] "" ECM
 SG_ DES_FD08_SGW : 356|2@0+ (1,0) [0|3] "" ECM
 SG_ DES_FD03_SGW : 180|2@0+ (1,0) [0|3] "" ECM
 SG_ DES_FD02_SGW : 92|2@0+ (1,0) [0|3] "" ECM
 SG_ DES_FD01_SGW : 4|2@0+ (1,0) [0|3] "" ECM
 SG_ CurrentCanNMState_FD11_SGW : 279|4@0+ (1,0) [0|15] "" ECM
 SG_ CurrentCanNMState_FD08_SGW : 367|4@0+ (1,0) [0|15] "" ECM
 SG_ CurrentCanNMState_FD03_SGW : 191|4@0+ (1,0) [0|15] "" ECM
 SG_ CurrentCanNMState_FD02_SGW : 103|4@0+ (1,0) [0|15] "" ECM
 SG_ CurrentCanNMState_FD01_SGW : 15|4@0+ (1,0) [0|15] "" ECM
 SG_ StayActiveSource_FD11_SGW : 295|64@0+ (1,0) [0|18446744073709551615] "" ECM
 SG_ StayActiveSource_FD08_SGW : 383|64@0+ (1,0) [0|18446744073709551615] "" ECM
 SG_ StayActiveSource_FD03_SGW : 207|64@0+ (1,0) [0|18446744073709551615] "" ECM
 SG_ StayActiveSource_FD02_SGW : 119|64@0+ (1,0) [0|18446744073709551615] "" ECM
 SG_ StayActiveSource_FD01_SGW : 31|64@0+ (1,0) [0|18446744073709551615] "" ECM

CM_ SG_ 2654339184 DES_FD08_SGW "Indicates whether the ECU?s CAN cell is in either ErrorActive, or ErrorPassive state OR has just now recovered from a BusOff condition";
CM_ SG_ 2654339184 DES_FD11_SGW "Indicates whether the ECU?s CAN cell is in either ErrorActive, or ErrorPassive state OR has just now recovered from a BusOff condition";
CM_ SG_ 2654339184 PreviousCanNMState_FD01_SGW "Indicates the last CanNM state that the ECU existed in";
CM_ SG_ 2654339184 PreviousCanNMState_FD02_SGW "Indicates the last CanNM state that the ECU existed in";
CM_ SG_ 2654339184 PreviousCanNMState_FD03_SGW "Indicates the last CanNM state that the ECU existed in";
CM_ SG_ 2654339184 PreviousCanNMState_FD08_SGW "Indicates the last CanNM state that the ECU existed in";
CM_ SG_ 2654339184 CurrentCanNMState_FD03_SGW "Indicates that CanNM state the ECU is currently executing";
CM_ SG_ 2654339184 CurrentCanNMState_FD08_SGW "Indicates that CanNM state the ECU is currently executing";
CM_ SG_ 2654339184 CurrentCanNMState_FD11_SGW "Indicates that CanNM state the ECU is currently executing";
CM_ SG_ 2654339184 DES_FD01_SGW "Indicates whether the ECU?s CAN cell is in either ErrorActive, or ErrorPassive state OR has just now recovered from a BusOff condition";
CM_ SG_ 2654339184 DES_FD02_SGW "Indicates whether the ECU?s CAN cell is in either ErrorActive, or ErrorPassive state OR has just now recovered from a BusOff condition";
CM_ SG_ 2654339184 DES_FD03_SGW "Indicates whether the ECU?s CAN cell is in either ErrorActive, or ErrorPassive state OR has just now recovered from a BusOff condition";
CM_ SG_ 2654339184 GenericFailSts_FD02_SGW "Indicates the presence/absent of at least one DTC in the System Memory";
CM_ SG_ 2654339184 GenericFailSts_FD03_SGW "Indicates the presence/absent of at least one DTC in the System Memory";
CM_ SG_ 2654339184 GenericFailSts_FD08_SGW "Indicates the presence/absent of at least one DTC in the System Memory";
CM_ SG_ 2654339184 GenericFailSts_FD11_SGW "Indicates the presence/absent of at least one DTC in the System Memory";
CM_ SG_ 2654339184 CurrentCanNMState_FD01_SGW "Indicates that CanNM state the ECU is currently executing";
CM_ SG_ 2654339184 CurrentCanNMState_FD02_SGW "Indicates that CanNM state the ECU is currently executing";
CM_ SG_ 2654339184 EOL_FD01_SGW "Indicates if the ECU requires configuration data at the assembly plant End Of Line";
CM_ SG_ 2654339184 EOL_FD02_SGW "Indicates if the ECU requires configuration data at the assembly plant End Of Line";
CM_ SG_ 2654339184 EOL_FD03_SGW "Indicates if the ECU requires configuration data at the assembly plant End Of Line";
CM_ SG_ 2654339184 EOL_FD08_SGW "Indicates if the ECU requires configuration data at the assembly plant End Of Line";
CM_ SG_ 2654339184 EOL_FD11_SGW "Indicates if the ECU requires configuration data at the assembly plant End Of Line";
CM_ SG_ 2654339184 GenericFailSts_FD01_SGW "Indicates the presence/absent of at least one DTC in the System Memory";
CM_ SG_ 2654339184 StayActiveSource_FD11_SGW "Indicates the source that requests the ECU to stay active";
CM_ SG_ 2654339184 CurrentFailSts_FD01_SGW "Indicates the presence/absence of at least one DTC with DTCStatus = present in the System Memory";
CM_ SG_ 2654339184 CurrentFailSts_FD02_SGW "Indicates the presence/absence of at least one DTC with DTCStatus = present in the System Memory";
CM_ SG_ 2654339184 CurrentFailSts_FD03_SGW "Indicates the presence/absence of at least one DTC with DTCStatus = present in the System Memory";
CM_ SG_ 2654339184 CurrentFailSts_FD08_SGW "Indicates the presence/absence of at least one DTC with DTCStatus = present in the System Memory";
CM_ SG_ 2654339184 CurrentFailSts_FD11_SGW "Indicates the presence/absence of at least one DTC with DTCStatus = present in the System Memory";
CM_ SG_ 2654339184 StayActiveSource_FD01_SGW "Indicates the source that requests the ECU to stay active";
CM_ SG_ 2654339184 StayActiveSource_FD02_SGW "Indicates the source that requests the ECU to stay active";
CM_ SG_ 2654339184 StayActiveSource_FD03_SGW "Indicates the source that requests the ECU to stay active";
CM_ SG_ 2654339184 StayActiveSource_FD08_SGW "Indicates the source that requests the ECU to stay active";
CM_ SG_ 2654339184 PreviousCanNMState_FD11_SGW "Indicates the last CanNM state that the ECU existed in";
CM_ SG_ 2654339184 WakeupSource_FD01_SGW "Indicates the reason the ECU was most recently awakened";
CM_ SG_ 2654339184 WakeupSource_FD02_SGW "Indicates the reason the ECU was most recently awakened";
CM_ SG_ 2654339184 WakeupSource_FD03_SGW "Indicates the reason the ECU was most recently awakened";
CM_ SG_ 2654339184 WakeupSource_FD08_SGW "Indicates the reason the ECU was most recently awakened";
CM_ SG_ 2654339184 WakeupSource_FD11_SGW "Indicates the reason the ECU was most recently awakened";
CM_ SG_ 2654555920 APPL_ECU_FD_ECM "External application to ECU";
CM_ SG_ 1445 ASCM_Stat "Air suspension status";
CM_ SG_ 1153 ExternalTemperatureC "Used to indicate the external temperature value in °C";
CM_ SG_ 1153 CRC_BCM10 "CRC according to SAE J1850 standard at each frame transmission.";
CM_ SG_ 1153 MessageCounter_BCM10 "This signal is a counter used for safety checks strategies. This counter is incremented of 1 (one) unit at each frame transmission.";
CM_ SG_ 1153 SpSt_Pad1 "Stop Start Button Press 1";
CM_ SG_ 1153 CmdIgnSts "Used to give information about the key selector position";
CM_ SG_ 1153 CompressorACReqSts "This signal is sent from BCM to ECM to inform of Compressor AC activation request";
CM_ SG_ 1430 StopStartClimateInfo "HVAC conditions effecting stop start enable";
CM_ SG_ 1430 AcOutputCurrentSts "It is the ECVD electrovalve current";
CM_ SG_ 1430 Parallel_Prk_Ast_Pad1 "Parallel Park Assist Pad 1 switch state";
CM_ SG_ 1431 Launch_Hard_Btn "Launch hard Button";
CM_ SG_ 1431 Right_Button_BCM "Signal indicates Customer pressed Right terrain switch";
CM_ SG_ 1431 TerrainModeInterfaceButton_BCM "Signal Indicates G/T or TRX Button activated or Not Activated by driver";
CM_ SG_ 1431 Left_Button_BCM "Signal indicates Customer pressed Left terrain switch";
CM_ SG_ 1431 Sport_Request "Indicates the Sport Switch is pressed";
CM_ SG_ 1431 TerrainSwStat "Terrain select switch status";
CM_ SG_ 159 CRC_BCM13 "CRC according to SAE J1850 standard at each frame transmission.";
CM_ SG_ 159 MessageCounter_BCM13 "This signal is a counter used for safety checks strategies. This counter is incremented of 1 (one) unit at each frame transmission.";
CM_ SG_ 159 AcceleratorSts "This signal is used to give information about cruise control accelerator button activation.";
CM_ SG_ 159 SpeedLimiterOnOffSts "The signal is sent from SCCM to the ECM for turning the Speed Limter Function ON and OFF.";
CM_ SG_ 255 Rear_Axle_Target_Torque "Rear Axle Target Axle Torque Request from EVCU2";
CM_ SG_ 255 Front_Axle_Target_Torque "Front Axle Target Axle Torque Request from EVCU2";
CM_ SG_ 255 Rear_AxleTorque_Static "Static Rear Axle Torque";
CM_ SG_ 255 Front_AxleTorque_Static "Static Front Axle Torqu";
CM_ SG_ 255 Veh_StandStill_Req_OPD "Vehicle Stand Still Request from EVCU2 When One Pedal Drive is Active";
CM_ SG_ 255 MessageCounter_PT_TORQUE_FD_1 "This signal is a counter used for safety checks strategies. This counter is incremented of 1 (one) unit at each frame transmission.";
CM_ SG_ 255 MotorB_Speed "Electric motor revolutions per minute";
CM_ SG_ 255 SumTorque_DrvReqMod "Driver requested sum torque modified";
CM_ SG_ 255 SumTorqueExp "Expected sum torque based on target transmission input speed";
CM_ SG_ 255 SumTorqueMax "Maximum sum torque";
CM_ SG_ 255 SumTorqueMin "Minimum sum torque";
CM_ SG_ 255 ESC_TrqEnblRq_Allowed "ESC Torque request allowed. True =[1]";
CM_ SG_ 255 SSC_TrqEnblRq_Allowed "SCC Torque request allowed. True =[1]";
CM_ SG_ 255 CRC_PT_TORQUE_FD_1 "CRC according to SAE J1850 standard at each frame transmission.";
CM_ SG_ 255 Total_AxleTorque_Static "Static Axle Torque (effective total Axle torque)";
CM_ SG_ 255 ACC_NCC_TrqEnblRq_Allowed "ACC/NCC Torque request allowed. True =[1]";
CM_ SG_ 255 Accel_Pedal_Override "Driver Accelerator Pedal Override. True =[1]";
CM_ SG_ 255 SumTorqueSel_D_TTC "Corrected (substitute) driver torque demand";
CM_ SG_ 255 SumTorqueStatic "Static sum torque (effective sum torque)";
CM_ SG_ 255 SumTorqueStatic_SEM "Static sum torque (transmission torque request)";
CM_ SG_ 255 SumTorqueTgt_SEM "Target torque (transmission torque request)";
CM_ SG_ 159 CruiseControlFailSts "This signal is used to give information about a fault on cruise control commands";
CM_ SG_ 159 CruiseControlOnOffSts "This signal is used to give information about cruise control on/off button activation .";
CM_ SG_ 159 DeceleratorSts "This signal is used to give information about cruise control decelerator button activation.";
CM_ SG_ 159 ResumeSwitch "This signal is used to give information about cruise control RESUME button activation.";
CM_ SG_ 159 ACC_On "ACC on/off";
CM_ SG_ 159 CRC_CSWC_1 "CRC according to SAE J1850 standard that has to be calculated from bit 63 to bit 48 at each frame transmission.";
CM_ SG_ 159 CrusCnclSwitch "Cruise Switch:  Cancel Pressed.";
CM_ SG_ 159 MC_CSWC_1 "This signal is a counter used for safety checks strategies. This counter is incremented of 1 (one) unit at each frame transmission.";
CM_ SG_ 512 BonnetAjarRawValSts_8 "The signal gives info on Bonnet ajar input to engine controller to use for stop-start and do diagnosis in the engine controller.";
CM_ SG_ 512 DriverDoor2AjarRawValSts_8 "Driver door status value";
CM_ SG_ 512 DriverDoorAjarRawValSts_8 "The signal gives info on Driver Door ajar input to engine controller to use for stop-start and do diagnosis in the engine controller.";
CM_ SG_ 512 DriverDoor2AjarXtionSts "Driver door status change";
CM_ SG_ 512 DriverDoorAjarXtionSts "Driver door status change";
CM_ SG_ 512 FuelDrRelSwRawSt "Raw voltage of fuel door release switch in the cabin";
CM_ SG_ 512 LeakCheckTimerExpired "Status of leak test timer";
CM_ SG_ 512 CRC_BCM18 "CRC according to SAE J1850 standard at each frame transmission.";
CM_ SG_ 512 MessageCounter_BCM18 "This signal is a counter used for safety checks strategies. This counter is incremented of 1 (one) unit at each frame transmission.";
CM_ SG_ 256 CRC_BCM2 "CRC according to SAE J1850 standard at each frame transmission.";
CM_ SG_ 256 MessageCounter_BCM2 "This signal is a counter used for safety checks strategies. This counter is incremented of 1 (one) unit at each frame transmission.";
CM_ SG_ 256 RefuelRequest "Driver has initiated a refueling event";
CM_ SG_ 256 RemStActvSts_R "Redundant Remote Start Active Status";
CM_ SG_ 256 EngineOffRequest "The signal is used to require an  engine shut off";
CM_ SG_ 256 StartRelayBCMFault "BCM starter relay fault detected";
CM_ SG_ 256 StartRelayBCMSts "BCM starter relay status; [1] = ON";
CM_ SG_ 1051 CRC_BCM4 "CRC according to SAE J1850 standard at each frame transmission.";
CM_ SG_ 1051 MessageCounter_BCM4 "This signal is a counter used for safety checks strategies. This counter is incremented of 1 (one) unit at each frame transmission.";
CM_ SG_ 1051 AM_ECM_Trace "Aftermarket ECM trace";
CM_ SG_ 1051 BCMSAMFailSts "This signal indicates a fault present in BCM related to the SAM strategy.";
CM_ SG_ 1051 FUEL_VOLT2 "Sub Side Fuel level sensor A/D Voltage (saddle/Dual tank)";
CM_ SG_ 1051 VoltageMax "This signal indicates the maximum regulation voltage permitted by BCM in the SAM strategy.";
CM_ SG_ 1051 VoltageMin "This signal indicates the minimum regulation voltage permitted by BCM in the SAM strategy.";
CM_ SG_ 1051 ExternalTemperatureAD_Voltage "Indicates the raw voltage of the ambient temp sensor";
CM_ SG_ 1051 FUEL_VOLT "Used to give information about the not filtered fuell level value in volt.";
CM_ SG_ 1375 ChkFuelLevelSts2 "Used to give information about the diagnostic of the secondary fuel sensor";
CM_ SG_ 1375 ChkFuelLevelSts "Used to give information about the diagnostic of CILC.";
CM_ SG_ 1066 BonnetSts "Used to indicate the status of the bonnet";
CM_ SG_ 1066 ParkBrakeSts "Status of Park Brake";
CM_ SG_ 1066 PsngrDoorSts "Used to indicate the status of passenger door";
CM_ SG_ 1066 RHatchSts "Used to indicate the status of the trunk liftgate";
CM_ SG_ 1066 RHRDoorSts "Used to indicate the status of right rear door";
CM_ SG_ 1066 LHRDoorSts "Used to indicate the status of left rear door";
CM_ SG_ 1066 FuelLevel2 "Average fuel level";
CM_ SG_ 1066 CRC_BCM9 "CRC according to SAE J1850 standard at each frame transmission.";
CM_ SG_ 1066 DriverDoorSts "Used to indicate the status of driver door";
CM_ SG_ 1066 FrontWiperMoveSts "This signal indicates the position of the front wiper (contact cam open or close).";
CM_ SG_ 1066 LowFuelWarningSts "Used to give information about the status of the low fuel warning.";
CM_ SG_ 1066 MessageCounter_BCM9 "This signal is a counter used for safety checks strategies. This counter is incremented of 1 (one) unit at each frame transmission.";
CM_ SG_ 1066 FuelLevel "Used to give information about the percentage of the fuel level present in the tank.";
CM_ SG_ 513 EngSpdInterv "Engine speed intervention value";
CM_ SG_ 513 VehicleStandStillSts "This signal indicates if the car is in stand still condition";
CM_ SG_ 513 EngSpdIntervReq "Engine speed intervention request (1=active)";
CM_ SG_ 513 SelectSpdSts "0";
CM_ SG_ 513 HILL_DES_STAT "Hill descent feature status";
CM_ SG_ 513 CRC_BRAKE1 "CRC according to SAE J1850 standard at each frame transmission.";
CM_ SG_ 513 MessageCounter_BRAKE1 "This signal is a counter used for safety checks strategies. This counter is incremented of 1 (one) unit at each frame transmission.";
CM_ SG_ 513 REF_VEH_SPEED "0";
CM_ SG_ 513 BrkTrq "0";
CM_ SG_ 513 BrkTrq_Driver "0";
CM_ SG_ 1465 RACE_CLDWN_ON_OFF_REQ "Activate Quick Cooldown for ADR; Pressed = [1]";
CM_ SG_ 1465 PSI_Gr1_RPM_SET "Requested rpm set point for Performance Shift Indication; 500 indicates not set";
CM_ SG_ 1465 PSI_Gr2_RPM_SET "Requested rpm set point for Performance Shift Indication; 500 indicates not set";
CM_ SG_ 1465 PSI_Gr3_RPM_SET "Requested rpm set point for Performance Shift Indication; 500 indicates not set";
CM_ SG_ 1465 PSI_Gr4_RPM_SET "Requested rpm set point for Performance Shift Indication; 500 indicates not set";
CM_ SG_ 1465 PSI_Gr5_RPM_SET "Requested rpm set point for Performance Shift Indication; 500 indicates not set";
CM_ SG_ 1465 PSI_RPM_Reset "Reset performance shift indication RPM set points to default ;  Reset = [1]";
CM_ SG_ 1465 PSI_Rq "Performance shift indication request";
CM_ SG_ 1465 Trns_DrvMdReq "The requested state of the drive mode feature";
CM_ SG_ 736 Command_15Sts "Infotainment Switch 15";
BA_DEF_ SG_ "GenSigTimeoutTime_ADCAM" INT 0 65535;
BA_DEF_ SG_ "GenSigTimeoutTime_EVCU2" INT 0 65535;
BA_DEF_ SG_ "GenSigTimeoutTime_VDCM" INT 0 65535;
BA_DEF_ SG_ "GenSigStartValue" INT 0 2147483647;
BA_DEF_ SG_ "GenSigInactiveValue" INT 0 2147483647;
BA_DEF_ SG_ "GenSigSendType" ENUM "NotUsed","OnWrite","OnWriteWithRepetition","OnChange","OnChangeWithRepetition","IfActive","IfActiveWithRepetition","NoSigSendType";
BA_DEF_ SG_ "SystemSignalLongSymbol" STRING ;
BA_DEF_ SG_ "GenSigTimeoutTime_AGSM" INT 0 65535;
BA_DEF_ SG_ "GenSigTimeoutTime_ASBS" INT 0 65535;
BA_DEF_ SG_ "GenSigTimeoutTime_BCM" INT 0 65535;
BA_DEF_ SG_ "GenSigTimeoutTime_BSM" INT 0 65535;
BA_DEF_ SG_ "GenSigTimeoutTime_CADM" INT 0 65535;
BA_DEF_ SG_ "GenSigTimeoutTime_DMSM" INT 0 65535;
BA_DEF_ SG_ "GenSigTimeoutTime_DTCM" INT 0 65535;
BA_DEF_ SG_ "GenSigTimeoutTime_ECM" INT 0 65535;
BA_DEF_ SG_ "GenSigTimeoutTime_ELSDM" INT 0 65535;
BA_DEF_ SG_ "GenSigTimeoutTime_ESL" INT 0 65535;
BA_DEF_ SG_ "GenSigTimeoutTime_GNMM" INT 0 65535;
BA_DEF_ SG_ "GenSigTimeoutTime_HCP" INT 0 65535;
BA_DEF_ SG_ "GenSigTimeoutTime_IPC" INT 0 65535;
BA_DEF_ SG_ "GenSigTimeoutTime_RFHM" INT 0 65535;
BA_DEF_ SG_ "GenSigTimeoutTime_SGW" INT 0 65535;
BA_DEF_ SG_ "GenSigTimeoutTime_TCM" INT 0 65535;
BA_DEF_ BO_ "DiagRequest" ENUM "No","Yes";
BA_DEF_ BO_ "Type" ENUM "P","C","PE","COC","PE_Cntrl","E","E_Cntrl","OC","S","BAF","DC","EM","MM","ISO-TP","-";
BA_DEF_ BO_ "DiagResponse" ENUM "No","Yes";
BA_DEF_ BO_ "NmMessage" ENUM "No","Yes";
BA_DEF_ BO_ "GenMsgSendType" ENUM "Cyclic","NotUsed","NotUsed","NotUsed","NotUsed","NotUsed","NotUsed","NotUsed","NoMsgSendType";
BA_DEF_ BO_ "GenMsgNrOfRepetition" INT 0 255;
BA_DEF_ BO_ "GenMsgILSupport" ENUM "No","Yes";
BA_DEF_ BO_ "GenMsgStartDelayTime" INT 0 65535;
BA_DEF_ BO_ "GenMsgCycleTimeFast" INT 0 65535;
BA_DEF_ BO_ "GenMsgCycleTime" INT 0 65535;
BA_DEF_ BO_ "GenMsgDelayTime" INT 0 65535;
BA_DEF_ BO_ "NmAsrMessage" ENUM "No","Yes";
BA_DEF_ BO_ "DiagState" ENUM "No","Yes";
BA_DEF_ BO_ "DiagConnection" HEX 0 65535;
BA_DEF_ BO_ "VFrameFormat" ENUM "StandardCAN","ExtendedCAN","reserved","reserved","reserved","reserved","reserved","reserved","reserved","reserved","reserved","reserved","reserved","reserved","StandardCAN_FD","ExtendedCAN_FD";
BA_DEF_ BO_ "CANFD_BRS" ENUM "0","1";
BA_DEF_DEF_ "GenSigTimeoutTime_ADCAM" 2500;
BA_DEF_DEF_ "GenSigTimeoutTime_EVCU2" 2500;
BA_DEF_DEF_ "GenSigTimeoutTime_VDCM" 2500;
BA_DEF_DEF_ "GenSigStartValue" 0;
BA_DEF_DEF_ "GenSigInactiveValue" 0;
BA_DEF_DEF_ "GenSigSendType" "NoSigSendType";
BA_DEF_DEF_ "SystemSignalLongSymbol" "";
BA_DEF_DEF_ "GenSigTimeoutTime_AGSM" 2500;
BA_DEF_DEF_ "GenSigTimeoutTime_ASBS" 2500;
BA_DEF_DEF_ "GenSigTimeoutTime_BCM" 2500;
BA_DEF_DEF_ "GenSigTimeoutTime_BSM" 2500;
BA_DEF_DEF_ "GenSigTimeoutTime_CADM" 2500;
BA_DEF_DEF_ "GenSigTimeoutTime_DMSM" 2500;
BA_DEF_DEF_ "GenSigTimeoutTime_DTCM" 2500;
BA_DEF_DEF_ "GenSigTimeoutTime_ECM" 2500;
BA_DEF_DEF_ "GenSigTimeoutTime_ELSDM" 2500;
BA_DEF_DEF_ "GenSigTimeoutTime_ESL" 2500;
BA_DEF_DEF_ "GenSigTimeoutTime_GNMM" 2500;
BA_DEF_DEF_ "GenSigTimeoutTime_HCP" 2500;
BA_DEF_DEF_ "GenSigTimeoutTime_IPC" 2500;
BA_DEF_DEF_ "GenSigTimeoutTime_RFHM" 2500;
BA_DEF_DEF_ "GenSigTimeoutTime_SGW" 2500;
BA_DEF_DEF_ "GenSigTimeoutTime_TCM" 2500;
BA_DEF_DEF_ "DiagRequest" "No";
BA_DEF_DEF_ "Type" "-";
BA_DEF_DEF_ "DiagResponse" "No";
BA_DEF_DEF_ "NmMessage" "No";
BA_DEF_DEF_ "GenMsgSendType" "NoMsgSendType";
BA_DEF_DEF_ "GenMsgNrOfRepetition" 0;
BA_DEF_DEF_ "GenMsgILSupport" "No";
BA_DEF_DEF_ "GenMsgStartDelayTime" 0;
BA_DEF_DEF_ "GenMsgCycleTimeFast" 0;
BA_DEF_DEF_ "GenMsgCycleTime" 0;
BA_DEF_DEF_ "GenMsgDelayTime" 0;
BA_DEF_DEF_ "NmAsrMessage" "No";
BA_DEF_DEF_ "DiagState" "No";
BA_DEF_DEF_ "DiagConnection" 0;
BA_DEF_DEF_ "VFrameFormat" "StandardCAN_FD";
BA_DEF_DEF_ "CANFD_BRS" "0";
BA_ "GenMsgDelayTime" BO_ 159 50;
BA_ "CANFD_BRS" BO_ 159 1;
BA_ "Type" BO_ 512 1;
BA_ "GenMsgSendType" BO_ 512 0;
BA_ "GenMsgILSupport" BO_ 512 1;
BA_ "GenMsgStartDelayTime" BO_ 512 15;
BA_ "GenMsgCycleTime" BO_ 512 20;
BA_ "CANFD_BRS" BO_ 512 1;
BA_ "Type" BO_ 256 1;
BA_ "GenMsgSendType" BO_ 256 0;
BA_ "GenMsgILSupport" BO_ 256 1;
BA_ "GenMsgCycleTime" BO_ 256 10;
BA_ "CANFD_BRS" BO_ 256 1;
BA_ "Type" BO_ 1051 1;
BA_ "GenMsgSendType" BO_ 1051 0;
BA_ "GenMsgILSupport" BO_ 1051 1;
BA_ "GenMsgStartDelayTime" BO_ 1051 65;
BA_ "GenMsgCycleTime" BO_ 1051 100;
BA_ "CANFD_BRS" BO_ 1051 1;
BA_ "Type" BO_ 1375 1;
BA_ "GenMsgSendType" BO_ 1375 0;
BA_ "GenMsgILSupport" BO_ 1375 1;
BA_ "GenMsgStartDelayTime" BO_ 1375 55;
BA_ "GenMsgCycleTime" BO_ 1375 250;
BA_ "CANFD_BRS" BO_ 1375 1;
BA_ "Type" BO_ 1827 1;
BA_ "GenMsgSendType" BO_ 1827 0;
BA_ "GenMsgILSupport" BO_ 1827 1;
BA_ "GenMsgStartDelayTime" BO_ 1827 410;
BA_ "GenMsgCycleTime" BO_ 1827 1000;
BA_ "CANFD_BRS" BO_ 1827 1;
BA_ "Type" BO_ 1066 3;
BA_ "GenMsgSendType" BO_ 1066 0;
BA_ "GenMsgNrOfRepetition" BO_ 1066 2;
BA_ "GenMsgILSupport" BO_ 1066 1;
BA_ "GenMsgStartDelayTime" BO_ 1066 50;
BA_ "GenMsgCycleTimeFast" BO_ 1066 20;
BA_ "GenMsgCycleTime" BO_ 1066 250;
BA_ "GenMsgDelayTime" BO_ 1066 20;
BA_ "CANFD_BRS" BO_ 1066 1;
BA_ "Type" BO_ 513 1;
BA_ "GenMsgSendType" BO_ 513 0;
BA_ "GenMsgILSupport" BO_ 513 1;
BA_ "GenMsgCycleTime" BO_ 513 20;
BA_ "CANFD_BRS" BO_ 513 1;
BA_ "Type" BO_ 1465 3;
BA_ "GenMsgSendType" BO_ 1465 0;
BA_ "GenMsgNrOfRepetition" BO_ 1465 2;
BA_ "GenMsgILSupport" BO_ 1465 1;
BA_ "GenMsgStartDelayTime" BO_ 1465 225;
BA_ "GenMsgCycleTimeFast" BO_ 1465 20;
BA_ "GenMsgCycleTime" BO_ 1465 1000;
BA_ "GenMsgDelayTime" BO_ 1465 20;
BA_ "CANFD_BRS" BO_ 1465 1;
BA_ "Type" BO_ 736 7;
BA_ "GenMsgILSupport" BO_ 736 1;
BA_ "GenMsgDelayTime" BO_ 736 20;
BA_ "CANFD_BRS" BO_ 736 1;
BA_ "Type" BO_ 255 1;
BA_ "GenMsgSendType" BO_ 255 0;
BA_ "GenMsgILSupport" BO_ 255 1;
BA_ "GenMsgCycleTime" BO_ 255 10;
BA_ "CANFD_BRS" BO_ 255 1;
BA_ "GenMsgILSupport" BO_ 159 1;
BA_ "Type" BO_ 2654339184 1;
BA_ "GenMsgSendType" BO_ 2654339184 0;
BA_ "GenMsgILSupport" BO_ 2654339184 1;
BA_ "GenMsgCycleTime" BO_ 2654339184 1000;
BA_ "VFrameFormat" BO_ 2654339184 15;
BA_ "CANFD_BRS" BO_ 2654339184 1;
BA_ "Type" BO_ 2654555920 8;
BA_ "GenMsgILSupport" BO_ 2654555920 1;
BA_ "VFrameFormat" BO_ 2654555920 15;
BA_ "CANFD_BRS" BO_ 2654555920 1;
BA_ "Type" BO_ 1445 3;
BA_ "GenMsgSendType" BO_ 1445 0;
BA_ "GenMsgNrOfRepetition" BO_ 1445 2;
BA_ "GenMsgILSupport" BO_ 1445 1;
BA_ "GenMsgStartDelayTime" BO_ 1445 375;
BA_ "GenMsgCycleTimeFast" BO_ 1445 20;
BA_ "GenMsgCycleTime" BO_ 1445 1000;
BA_ "GenMsgDelayTime" BO_ 1445 20;
BA_ "CANFD_BRS" BO_ 1445 1;
BA_ "Type" BO_ 1153 3;
BA_ "GenMsgSendType" BO_ 1153 0;
BA_ "GenMsgNrOfRepetition" BO_ 1153 2;
BA_ "GenMsgILSupport" BO_ 1153 1;
BA_ "GenMsgStartDelayTime" BO_ 1153 65;
BA_ "GenMsgCycleTimeFast" BO_ 1153 20;
BA_ "GenMsgCycleTime" BO_ 1153 500;
BA_ "GenMsgDelayTime" BO_ 1153 20;
BA_ "CANFD_BRS" BO_ 1153 1;
BA_ "Type" BO_ 1430 3;
BA_ "GenMsgSendType" BO_ 1430 0;
BA_ "GenMsgNrOfRepetition" BO_ 1430 2;
BA_ "GenMsgILSupport" BO_ 1430 1;
BA_ "GenMsgStartDelayTime" BO_ 1430 380;
BA_ "GenMsgCycleTimeFast" BO_ 1430 20;
BA_ "GenMsgCycleTime" BO_ 1430 1000;
BA_ "GenMsgDelayTime" BO_ 1430 20;
BA_ "CANFD_BRS" BO_ 1430 1;
BA_ "Type" BO_ 1431 3;
BA_ "GenMsgSendType" BO_ 1431 0;
BA_ "GenMsgNrOfRepetition" BO_ 1431 2;
BA_ "GenMsgILSupport" BO_ 1431 1;
BA_ "GenMsgStartDelayTime" BO_ 1431 385;
BA_ "GenMsgCycleTimeFast" BO_ 1431 20;
BA_ "GenMsgCycleTime" BO_ 1431 100;
BA_ "GenMsgDelayTime" BO_ 1431 20;
BA_ "CANFD_BRS" BO_ 1431 1;
BA_ "Type" BO_ 159 11;
BA_ "GenSigTimeoutTime_ECM" SG_ 255 Front_AxleTorque_Static 0;
BA_ "GenSigTimeoutTime_ESL" SG_ 255 Front_AxleTorque_Static 0;
BA_ "GenSigTimeoutTime_IPC" SG_ 255 Front_AxleTorque_Static 0;
BA_ "GenSigTimeoutTime_RFHM" SG_ 255 Front_AxleTorque_Static 0;
BA_ "GenSigTimeoutTime_TCM" SG_ 255 Front_AxleTorque_Static 0;
BA_ "GenSigTimeoutTime_ADCAM" SG_ 255 Veh_StandStill_Req_OPD 0;
BA_ "GenSigTimeoutTime_EVCU2" SG_ 255 Veh_StandStill_Req_OPD 0;
BA_ "GenSigTimeoutTime_VDCM" SG_ 255 Veh_StandStill_Req_OPD 0;
BA_ "GenSigTimeoutTime_AGSM" SG_ 255 Veh_StandStill_Req_OPD 0;
BA_ "GenSigTimeoutTime_BCM" SG_ 255 Veh_StandStill_Req_OPD 0;
BA_ "GenSigTimeoutTime_DTCM" SG_ 255 Veh_StandStill_Req_OPD 0;
BA_ "GenSigTimeoutTime_ECM" SG_ 255 Veh_StandStill_Req_OPD 0;
BA_ "GenSigTimeoutTime_ESL" SG_ 255 Veh_StandStill_Req_OPD 0;
BA_ "GenSigTimeoutTime_IPC" SG_ 255 Veh_StandStill_Req_OPD 0;
BA_ "GenSigTimeoutTime_RFHM" SG_ 255 Veh_StandStill_Req_OPD 0;
BA_ "GenSigTimeoutTime_SGW" SG_ 255 Veh_StandStill_Req_OPD 0;
BA_ "GenSigTimeoutTime_TCM" SG_ 255 Veh_StandStill_Req_OPD 0;
BA_ "GenSigTimeoutTime_EVCU2" SG_ 255 MessageCounter_PT_TORQUE_FD_1 0;
BA_ "GenSigTimeoutTime_VDCM" SG_ 255 MessageCounter_PT_TORQUE_FD_1 0;
BA_ "GenSigTimeoutTime_BCM" SG_ 255 MessageCounter_PT_TORQUE_FD_1 0;
BA_ "GenSigTimeoutTime_ADCAM" SG_ 255 SumTorque_DrvReqMod 0;
BA_ "GenSigTimeoutTime_EVCU2" SG_ 255 SumTorque_DrvReqMod 0;
BA_ "GenSigTimeoutTime_VDCM" SG_ 255 SumTorque_DrvReqMod 0;
BA_ "GenSigTimeoutTime_BSM" SG_ 255 SumTorque_DrvReqMod 0;
BA_ "GenSigTimeoutTime_TCM" SG_ 255 SumTorque_DrvReqMod 0;
BA_ "GenSigTimeoutTime_ADCAM" SG_ 255 SumTorqueExp 0;
BA_ "GenSigTimeoutTime_EVCU2" SG_ 255 SumTorqueExp 0;
BA_ "GenSigTimeoutTime_VDCM" SG_ 255 SumTorqueExp 0;
BA_ "GenSigTimeoutTime_ADCAM" SG_ 255 SumTorqueMax 0;
BA_ "GenSigTimeoutTime_EVCU2" SG_ 255 SumTorqueMax 0;
BA_ "GenSigTimeoutTime_VDCM" SG_ 255 SumTorqueMax 0;
BA_ "GenSigTimeoutTime_BCM" SG_ 255 SumTorqueMax 0;
BA_ "GenSigTimeoutTime_BSM" SG_ 255 SumTorqueMax 0;
BA_ "GenSigTimeoutTime_TCM" SG_ 255 SumTorqueMax 0;
BA_ "GenSigTimeoutTime_ADCAM" SG_ 255 SumTorqueMin 0;
BA_ "GenSigTimeoutTime_EVCU2" SG_ 255 SumTorqueMin 0;
BA_ "GenSigTimeoutTime_VDCM" SG_ 255 SumTorqueMin 0;
BA_ "GenSigTimeoutTime_BSM" SG_ 255 SumTorqueMin 0;
BA_ "GenSigTimeoutTime_TCM" SG_ 255 SumTorqueMin 0;
BA_ "GenSigTimeoutTime_ADCAM" SG_ 255 ESC_TrqEnblRq_Allowed 0;
BA_ "GenSigTimeoutTime_EVCU2" SG_ 255 ESC_TrqEnblRq_Allowed 0;
BA_ "GenSigTimeoutTime_VDCM" SG_ 255 ESC_TrqEnblRq_Allowed 0;
BA_ "GenSigTimeoutTime_EVCU2" SG_ 255 CRC_PT_TORQUE_FD_1 0;
BA_ "GenSigTimeoutTime_VDCM" SG_ 255 CRC_PT_TORQUE_FD_1 0;
BA_ "GenSigTimeoutTime_BCM" SG_ 255 CRC_PT_TORQUE_FD_1 0;
BA_ "GenSigTimeoutTime_ADCAM" SG_ 255 Total_AxleTorque_Static 0;
BA_ "GenSigTimeoutTime_EVCU2" SG_ 255 Total_AxleTorque_Static 0;
BA_ "GenSigTimeoutTime_VDCM" SG_ 255 Total_AxleTorque_Static 0;
BA_ "GenSigTimeoutTime_ADCAM" SG_ 255 ACC_NCC_TrqEnblRq_Allowed 0;
BA_ "GenSigTimeoutTime_EVCU2" SG_ 255 ACC_NCC_TrqEnblRq_Allowed 0;
BA_ "GenSigTimeoutTime_VDCM" SG_ 255 ACC_NCC_TrqEnblRq_Allowed 0;
BA_ "GenSigTimeoutTime_BSM" SG_ 255 ACC_NCC_TrqEnblRq_Allowed 0;
BA_ "GenSigTimeoutTime_EVCU2" SG_ 255 Accel_Pedal_Override 0;
BA_ "GenSigTimeoutTime_VDCM" SG_ 255 Accel_Pedal_Override 0;
BA_ "GenSigTimeoutTime_ADCAM" SG_ 255 SumTorqueSel_D_TTC 0;
BA_ "GenSigTimeoutTime_EVCU2" SG_ 255 SumTorqueSel_D_TTC 0;
BA_ "GenSigTimeoutTime_VDCM" SG_ 255 SumTorqueSel_D_TTC 0;
BA_ "GenSigTimeoutTime_BSM" SG_ 255 SumTorqueSel_D_TTC 0;
BA_ "GenSigTimeoutTime_TCM" SG_ 255 SumTorqueSel_D_TTC 0;
BA_ "GenSigTimeoutTime_ADCAM" SG_ 255 SumTorqueStatic 0;
BA_ "GenSigTimeoutTime_EVCU2" SG_ 255 SumTorqueStatic 0;
BA_ "GenSigTimeoutTime_VDCM" SG_ 255 SumTorqueStatic 0;
BA_ "GenSigTimeoutTime_BSM" SG_ 255 SumTorqueStatic 0;
BA_ "GenSigTimeoutTime_TCM" SG_ 255 SumTorqueStatic 0;
BA_ "GenSigTimeoutTime_ADCAM" SG_ 255 SumTorqueStatic_SEM 0;
BA_ "GenSigTimeoutTime_EVCU2" SG_ 255 SumTorqueStatic_SEM 0;
BA_ "GenSigTimeoutTime_VDCM" SG_ 255 SumTorqueStatic_SEM 0;
BA_ "GenSigTimeoutTime_BCM" SG_ 255 SumTorqueStatic_SEM 0;
BA_ "GenSigTimeoutTime_TCM" SG_ 255 SumTorqueStatic_SEM 0;
BA_ "GenSigTimeoutTime_ADCAM" SG_ 255 SumTorqueTgt_SEM 0;
BA_ "GenSigTimeoutTime_EVCU2" SG_ 255 SumTorqueTgt_SEM 0;
BA_ "GenSigTimeoutTime_VDCM" SG_ 255 SumTorqueTgt_SEM 0;
BA_ "GenSigTimeoutTime_TCM" SG_ 255 SumTorqueTgt_SEM 0;
BA_ "GenSigTimeoutTime_AGSM" SG_ 255 MessageCounter_PT_TORQUE_FD_1 0;
BA_ "GenSigTimeoutTime_ASBS" SG_ 255 MessageCounter_PT_TORQUE_FD_1 0;
BA_ "GenSigTimeoutTime_CADM" SG_ 255 MessageCounter_PT_TORQUE_FD_1 0;
BA_ "GenSigTimeoutTime_DMSM" SG_ 255 MessageCounter_PT_TORQUE_FD_1 0;
BA_ "GenSigTimeoutTime_ECM" SG_ 255 MessageCounter_PT_TORQUE_FD_1 0;
BA_ "GenSigTimeoutTime_ELSDM" SG_ 255 MessageCounter_PT_TORQUE_FD_1 0;
BA_ "GenSigTimeoutTime_ESL" SG_ 255 MessageCounter_PT_TORQUE_FD_1 0;
BA_ "GenSigTimeoutTime_GNMM" SG_ 255 MessageCounter_PT_TORQUE_FD_1 0;
BA_ "GenSigTimeoutTime_HCP" SG_ 255 MessageCounter_PT_TORQUE_FD_1 0;
BA_ "GenSigTimeoutTime_IPC" SG_ 255 MessageCounter_PT_TORQUE_FD_1 0;
BA_ "GenSigTimeoutTime_RFHM" SG_ 255 MessageCounter_PT_TORQUE_FD_1 0;
BA_ "GenSigTimeoutTime_SGW" SG_ 255 MessageCounter_PT_TORQUE_FD_1 0;
BA_ "GenSigStartValue" SG_ 255 MotorB_Speed 49152;
BA_ "GenSigTimeoutTime_AGSM" SG_ 255 MotorB_Speed 0;
BA_ "GenSigTimeoutTime_ASBS" SG_ 255 MotorB_Speed 0;
BA_ "GenSigTimeoutTime_BCM" SG_ 255 MotorB_Speed 0;
BA_ "GenSigTimeoutTime_CADM" SG_ 255 MotorB_Speed 0;
BA_ "GenSigTimeoutTime_DMSM" SG_ 255 MotorB_Speed 0;
BA_ "GenSigTimeoutTime_ECM" SG_ 255 MotorB_Speed 0;
BA_ "GenSigTimeoutTime_ELSDM" SG_ 255 MotorB_Speed 0;
BA_ "GenSigTimeoutTime_ESL" SG_ 255 MotorB_Speed 0;
BA_ "GenSigTimeoutTime_GNMM" SG_ 255 MotorB_Speed 0;
BA_ "GenSigTimeoutTime_HCP" SG_ 255 MotorB_Speed 0;
BA_ "GenSigTimeoutTime_IPC" SG_ 255 MotorB_Speed 0;
BA_ "GenSigTimeoutTime_RFHM" SG_ 255 MotorB_Speed 0;
BA_ "GenSigTimeoutTime_SGW" SG_ 255 MotorB_Speed 0;
BA_ "GenSigTimeoutTime_AGSM" SG_ 255 SumTorque_DrvReqMod 0;
BA_ "GenSigTimeoutTime_ASBS" SG_ 255 SumTorque_DrvReqMod 0;
BA_ "GenSigTimeoutTime_CADM" SG_ 255 SumTorque_DrvReqMod 0;
BA_ "GenSigTimeoutTime_DMSM" SG_ 255 SumTorque_DrvReqMod 0;
BA_ "GenSigTimeoutTime_ECM" SG_ 255 SumTorque_DrvReqMod 0;
BA_ "GenSigTimeoutTime_ELSDM" SG_ 255 SumTorque_DrvReqMod 0;
BA_ "GenSigTimeoutTime_ESL" SG_ 255 SumTorque_DrvReqMod 0;
BA_ "GenSigTimeoutTime_GNMM" SG_ 255 SumTorque_DrvReqMod 0;
BA_ "GenSigTimeoutTime_HCP" SG_ 255 SumTorque_DrvReqMod 0;
BA_ "GenSigTimeoutTime_IPC" SG_ 255 SumTorque_DrvReqMod 0;
BA_ "GenSigTimeoutTime_RFHM" SG_ 255 SumTorque_DrvReqMod 0;
BA_ "GenSigTimeoutTime_SGW" SG_ 255 SumTorque_DrvReqMod 0;
BA_ "GenSigTimeoutTime_AGSM" SG_ 255 SumTorqueExp 0;
BA_ "GenSigTimeoutTime_ASBS" SG_ 255 SumTorqueExp 0;
BA_ "GenSigTimeoutTime_BCM" SG_ 255 SumTorqueExp 0;
BA_ "GenSigTimeoutTime_CADM" SG_ 255 SumTorqueExp 0;
BA_ "GenSigTimeoutTime_DMSM" SG_ 255 SumTorqueExp 0;
BA_ "GenSigTimeoutTime_DTCM" SG_ 255 SumTorqueExp 0;
BA_ "GenSigTimeoutTime_ECM" SG_ 255 SumTorqueExp 0;
BA_ "GenSigTimeoutTime_ELSDM" SG_ 255 SumTorqueExp 0;
BA_ "GenSigTimeoutTime_ESL" SG_ 255 SumTorqueExp 0;
BA_ "GenSigTimeoutTime_GNMM" SG_ 255 SumTorqueExp 0;
BA_ "GenSigTimeoutTime_HCP" SG_ 255 SumTorqueExp 0;
BA_ "GenSigTimeoutTime_IPC" SG_ 255 SumTorqueExp 0;
BA_ "GenSigTimeoutTime_RFHM" SG_ 255 SumTorqueExp 0;
BA_ "GenSigTimeoutTime_SGW" SG_ 255 SumTorqueExp 0;
BA_ "GenSigTimeoutTime_TCM" SG_ 255 SumTorqueExp 0;
BA_ "GenSigTimeoutTime_AGSM" SG_ 255 SumTorqueMax 0;
BA_ "GenSigTimeoutTime_ASBS" SG_ 255 SumTorqueMax 0;
BA_ "GenSigTimeoutTime_CADM" SG_ 255 SumTorqueMax 0;
BA_ "GenSigTimeoutTime_DMSM" SG_ 255 SumTorqueMax 0;
BA_ "GenSigTimeoutTime_ECM" SG_ 255 SumTorqueMax 0;
BA_ "GenSigTimeoutTime_ELSDM" SG_ 255 SumTorqueMax 0;
BA_ "GenSigTimeoutTime_ESL" SG_ 255 SumTorqueMax 0;
BA_ "GenSigTimeoutTime_GNMM" SG_ 255 SumTorqueMax 0;
BA_ "GenSigTimeoutTime_HCP" SG_ 255 SumTorqueMax 0;
BA_ "GenSigTimeoutTime_IPC" SG_ 255 SumTorqueMax 0;
BA_ "GenSigTimeoutTime_RFHM" SG_ 255 SumTorqueMax 0;
BA_ "GenSigTimeoutTime_SGW" SG_ 255 SumTorqueMax 0;
BA_ "GenSigTimeoutTime_AGSM" SG_ 255 SumTorqueMin 0;
BA_ "GenSigTimeoutTime_ASBS" SG_ 255 SumTorqueMin 0;
BA_ "GenSigTimeoutTime_BCM" SG_ 255 SumTorqueMin 0;
BA_ "GenSigTimeoutTime_CADM" SG_ 255 SumTorqueMin 0;
BA_ "GenSigTimeoutTime_DMSM" SG_ 255 SumTorqueMin 0;
BA_ "GenSigTimeoutTime_ECM" SG_ 255 SumTorqueMin 0;
BA_ "GenSigTimeoutTime_ELSDM" SG_ 255 SumTorqueMin 0;
BA_ "GenSigTimeoutTime_ESL" SG_ 255 SumTorqueMin 0;
BA_ "GenSigTimeoutTime_GNMM" SG_ 255 SumTorqueMin 0;
BA_ "GenSigTimeoutTime_HCP" SG_ 255 SumTorqueMin 0;
BA_ "GenSigTimeoutTime_IPC" SG_ 255 SumTorqueMin 0;
BA_ "GenSigTimeoutTime_RFHM" SG_ 255 SumTorqueMin 0;
BA_ "GenSigTimeoutTime_SGW" SG_ 255 SumTorqueMin 0;
BA_ "GenSigTimeoutTime_AGSM" SG_ 255 ESC_TrqEnblRq_Allowed 0;
BA_ "GenSigTimeoutTime_ASBS" SG_ 255 ESC_TrqEnblRq_Allowed 0;
BA_ "GenSigTimeoutTime_BCM" SG_ 255 ESC_TrqEnblRq_Allowed 0;
BA_ "GenSigTimeoutTime_CADM" SG_ 255 ESC_TrqEnblRq_Allowed 0;
BA_ "GenSigTimeoutTime_DMSM" SG_ 255 ESC_TrqEnblRq_Allowed 0;
BA_ "GenSigTimeoutTime_DTCM" SG_ 255 ESC_TrqEnblRq_Allowed 0;
BA_ "GenSigTimeoutTime_ECM" SG_ 255 ESC_TrqEnblRq_Allowed 0;
BA_ "GenSigTimeoutTime_ELSDM" SG_ 255 ESC_TrqEnblRq_Allowed 0;
BA_ "GenSigTimeoutTime_ESL" SG_ 255 ESC_TrqEnblRq_Allowed 0;
BA_ "GenSigTimeoutTime_GNMM" SG_ 255 ESC_TrqEnblRq_Allowed 0;
BA_ "GenSigTimeoutTime_HCP" SG_ 255 ESC_TrqEnblRq_Allowed 0;
BA_ "GenSigTimeoutTime_IPC" SG_ 255 ESC_TrqEnblRq_Allowed 0;
BA_ "GenSigTimeoutTime_RFHM" SG_ 255 ESC_TrqEnblRq_Allowed 0;
BA_ "GenSigTimeoutTime_SGW" SG_ 255 ESC_TrqEnblRq_Allowed 0;
BA_ "GenSigTimeoutTime_TCM" SG_ 255 ESC_TrqEnblRq_Allowed 0;
BA_ "GenSigTimeoutTime_AGSM" SG_ 255 SSC_TrqEnblRq_Allowed 0;
BA_ "GenSigTimeoutTime_ASBS" SG_ 255 SSC_TrqEnblRq_Allowed 0;
BA_ "GenSigTimeoutTime_BCM" SG_ 255 SSC_TrqEnblRq_Allowed 0;
BA_ "GenSigTimeoutTime_CADM" SG_ 255 SSC_TrqEnblRq_Allowed 0;
BA_ "GenSigTimeoutTime_DMSM" SG_ 255 SSC_TrqEnblRq_Allowed 0;
BA_ "GenSigTimeoutTime_DTCM" SG_ 255 SSC_TrqEnblRq_Allowed 0;
BA_ "GenSigTimeoutTime_ECM" SG_ 255 SSC_TrqEnblRq_Allowed 0;
BA_ "GenSigTimeoutTime_ELSDM" SG_ 255 SSC_TrqEnblRq_Allowed 0;
BA_ "GenSigTimeoutTime_ESL" SG_ 255 SSC_TrqEnblRq_Allowed 0;
BA_ "GenSigTimeoutTime_GNMM" SG_ 255 SSC_TrqEnblRq_Allowed 0;
BA_ "GenSigTimeoutTime_HCP" SG_ 255 SSC_TrqEnblRq_Allowed 0;
BA_ "GenSigTimeoutTime_IPC" SG_ 255 SSC_TrqEnblRq_Allowed 0;
BA_ "GenSigTimeoutTime_RFHM" SG_ 255 SSC_TrqEnblRq_Allowed 0;
BA_ "GenSigTimeoutTime_SGW" SG_ 255 SSC_TrqEnblRq_Allowed 0;
BA_ "GenSigTimeoutTime_TCM" SG_ 255 SSC_TrqEnblRq_Allowed 0;
BA_ "GenSigTimeoutTime_AGSM" SG_ 255 CRC_PT_TORQUE_FD_1 0;
BA_ "GenSigTimeoutTime_ASBS" SG_ 255 CRC_PT_TORQUE_FD_1 0;
BA_ "GenSigTimeoutTime_CADM" SG_ 255 CRC_PT_TORQUE_FD_1 0;
BA_ "GenSigTimeoutTime_DMSM" SG_ 255 CRC_PT_TORQUE_FD_1 0;
BA_ "GenSigTimeoutTime_ECM" SG_ 255 CRC_PT_TORQUE_FD_1 0;
BA_ "GenSigTimeoutTime_ELSDM" SG_ 255 CRC_PT_TORQUE_FD_1 0;
BA_ "GenSigTimeoutTime_ESL" SG_ 255 CRC_PT_TORQUE_FD_1 0;
BA_ "GenSigTimeoutTime_GNMM" SG_ 255 CRC_PT_TORQUE_FD_1 0;
BA_ "GenSigTimeoutTime_HCP" SG_ 255 CRC_PT_TORQUE_FD_1 0;
BA_ "GenSigTimeoutTime_IPC" SG_ 255 CRC_PT_TORQUE_FD_1 0;
BA_ "GenSigTimeoutTime_RFHM" SG_ 255 CRC_PT_TORQUE_FD_1 0;
BA_ "GenSigTimeoutTime_SGW" SG_ 255 CRC_PT_TORQUE_FD_1 0;
BA_ "GenSigStartValue" SG_ 255 Total_AxleTorque_Static 32767;
BA_ "GenSigTimeoutTime_AGSM" SG_ 255 Total_AxleTorque_Static 0;
BA_ "GenSigTimeoutTime_ASBS" SG_ 255 Total_AxleTorque_Static 0;
BA_ "GenSigTimeoutTime_BCM" SG_ 255 Total_AxleTorque_Static 0;
BA_ "GenSigTimeoutTime_CADM" SG_ 255 Total_AxleTorque_Static 0;
BA_ "GenSigTimeoutTime_DMSM" SG_ 255 Total_AxleTorque_Static 0;
BA_ "GenSigTimeoutTime_DTCM" SG_ 255 Total_AxleTorque_Static 0;
BA_ "GenSigTimeoutTime_ECM" SG_ 255 Total_AxleTorque_Static 0;
BA_ "GenSigTimeoutTime_ELSDM" SG_ 255 Total_AxleTorque_Static 0;
BA_ "GenSigTimeoutTime_ESL" SG_ 255 Total_AxleTorque_Static 0;
BA_ "GenSigTimeoutTime_GNMM" SG_ 255 Total_AxleTorque_Static 0;
BA_ "GenSigTimeoutTime_HCP" SG_ 255 Total_AxleTorque_Static 0;
BA_ "GenSigTimeoutTime_IPC" SG_ 255 Total_AxleTorque_Static 0;
BA_ "GenSigTimeoutTime_RFHM" SG_ 255 Total_AxleTorque_Static 0;
BA_ "GenSigTimeoutTime_SGW" SG_ 255 Total_AxleTorque_Static 0;
BA_ "GenSigTimeoutTime_TCM" SG_ 255 Total_AxleTorque_Static 0;
BA_ "GenSigTimeoutTime_AGSM" SG_ 255 ACC_NCC_TrqEnblRq_Allowed 0;
BA_ "GenSigTimeoutTime_ASBS" SG_ 255 ACC_NCC_TrqEnblRq_Allowed 0;
BA_ "GenSigTimeoutTime_BCM" SG_ 255 ACC_NCC_TrqEnblRq_Allowed 0;
BA_ "GenSigTimeoutTime_CADM" SG_ 255 ACC_NCC_TrqEnblRq_Allowed 0;
BA_ "GenSigTimeoutTime_DMSM" SG_ 255 ACC_NCC_TrqEnblRq_Allowed 0;
BA_ "GenSigTimeoutTime_DTCM" SG_ 255 ACC_NCC_TrqEnblRq_Allowed 0;
BA_ "GenSigTimeoutTime_ECM" SG_ 255 ACC_NCC_TrqEnblRq_Allowed 0;
BA_ "GenSigTimeoutTime_ELSDM" SG_ 255 ACC_NCC_TrqEnblRq_Allowed 0;
BA_ "GenSigTimeoutTime_ESL" SG_ 255 ACC_NCC_TrqEnblRq_Allowed 0;
BA_ "GenSigTimeoutTime_GNMM" SG_ 255 ACC_NCC_TrqEnblRq_Allowed 0;
BA_ "GenSigTimeoutTime_HCP" SG_ 255 ACC_NCC_TrqEnblRq_Allowed 0;
BA_ "GenSigTimeoutTime_IPC" SG_ 255 ACC_NCC_TrqEnblRq_Allowed 0;
BA_ "GenSigTimeoutTime_RFHM" SG_ 255 ACC_NCC_TrqEnblRq_Allowed 0;
BA_ "GenSigTimeoutTime_SGW" SG_ 255 ACC_NCC_TrqEnblRq_Allowed 0;
BA_ "GenSigTimeoutTime_TCM" SG_ 255 ACC_NCC_TrqEnblRq_Allowed 0;
BA_ "GenSigTimeoutTime_AGSM" SG_ 255 Accel_Pedal_Override 0;
BA_ "GenSigTimeoutTime_ASBS" SG_ 255 Accel_Pedal_Override 0;
BA_ "GenSigTimeoutTime_DMSM" SG_ 255 Accel_Pedal_Override 0;
BA_ "GenSigTimeoutTime_ECM" SG_ 255 Accel_Pedal_Override 0;
BA_ "GenSigTimeoutTime_ELSDM" SG_ 255 Accel_Pedal_Override 0;
BA_ "GenSigTimeoutTime_ESL" SG_ 255 Accel_Pedal_Override 0;
BA_ "GenSigTimeoutTime_GNMM" SG_ 255 Accel_Pedal_Override 0;
BA_ "GenSigTimeoutTime_HCP" SG_ 255 Accel_Pedal_Override 0;
BA_ "GenSigTimeoutTime_IPC" SG_ 255 Accel_Pedal_Override 0;
BA_ "GenSigTimeoutTime_RFHM" SG_ 255 Accel_Pedal_Override 0;
BA_ "GenSigTimeoutTime_SGW" SG_ 255 Accel_Pedal_Override 0;
BA_ "GenSigTimeoutTime_AGSM" SG_ 255 SumTorqueSel_D_TTC 0;
BA_ "GenSigTimeoutTime_ASBS" SG_ 255 SumTorqueSel_D_TTC 0;
BA_ "GenSigTimeoutTime_CADM" SG_ 255 SumTorqueSel_D_TTC 0;
BA_ "GenSigTimeoutTime_DMSM" SG_ 255 SumTorqueSel_D_TTC 0;
BA_ "GenSigTimeoutTime_ECM" SG_ 255 SumTorqueSel_D_TTC 0;
BA_ "GenSigTimeoutTime_ELSDM" SG_ 255 SumTorqueSel_D_TTC 0;
BA_ "GenSigTimeoutTime_ESL" SG_ 255 SumTorqueSel_D_TTC 0;
BA_ "GenSigTimeoutTime_GNMM" SG_ 255 SumTorqueSel_D_TTC 0;
BA_ "GenSigTimeoutTime_HCP" SG_ 255 SumTorqueSel_D_TTC 0;
BA_ "GenSigTimeoutTime_IPC" SG_ 255 SumTorqueSel_D_TTC 0;
BA_ "GenSigTimeoutTime_RFHM" SG_ 255 SumTorqueSel_D_TTC 0;
BA_ "GenSigTimeoutTime_SGW" SG_ 255 SumTorqueSel_D_TTC 0;
BA_ "GenSigTimeoutTime_AGSM" SG_ 255 SumTorqueStatic 0;
BA_ "GenSigTimeoutTime_ASBS" SG_ 255 SumTorqueStatic 0;
BA_ "GenSigTimeoutTime_CADM" SG_ 255 SumTorqueStatic 0;
BA_ "GenSigTimeoutTime_DMSM" SG_ 255 SumTorqueStatic 0;
BA_ "GenSigTimeoutTime_ECM" SG_ 255 SumTorqueStatic 0;
BA_ "GenSigTimeoutTime_ELSDM" SG_ 255 SumTorqueStatic 0;
BA_ "GenSigTimeoutTime_RFHM" SG_ 159 CruiseControlOnOffSts 0;
BA_ "GenSigTimeoutTime_ADCAM" SG_ 1051 FUEL_VOLT 0;
BA_ "GenSigTimeoutTime_EVCU2" SG_ 1051 FUEL_VOLT 0;
BA_ "GenSigTimeoutTime_VDCM" SG_ 1051 FUEL_VOLT 0;
BA_ "GenSigTimeoutTime_AGSM" SG_ 1051 AM_ECM_Trace 0;
BA_ "GenSigTimeoutTime_ASBS" SG_ 1051 AM_ECM_Trace 0;
BA_ "GenSigTimeoutTime_BCM" SG_ 1051 AM_ECM_Trace 0;
BA_ "GenSigTimeoutTime_BSM" SG_ 1051 AM_ECM_Trace 0;
BA_ "GenSigTimeoutTime_CADM" SG_ 1051 AM_ECM_Trace 0;
BA_ "GenSigTimeoutTime_DMSM" SG_ 1051 AM_ECM_Trace 0;
BA_ "GenSigTimeoutTime_DTCM" SG_ 1051 AM_ECM_Trace 0;
BA_ "GenSigTimeoutTime_ELSDM" SG_ 1051 AM_ECM_Trace 0;
BA_ "GenSigTimeoutTime_ESL" SG_ 1051 AM_ECM_Trace 0;
BA_ "GenSigTimeoutTime_GNMM" SG_ 1051 AM_ECM_Trace 0;
BA_ "GenSigTimeoutTime_HCP" SG_ 1051 AM_ECM_Trace 0;
BA_ "GenSigTimeoutTime_IPC" SG_ 1051 AM_ECM_Trace 0;
BA_ "GenSigTimeoutTime_RFHM" SG_ 1051 AM_ECM_Trace 0;
BA_ "GenSigTimeoutTime_SGW" SG_ 1051 AM_ECM_Trace 0;
BA_ "GenSigTimeoutTime_TCM" SG_ 1051 AM_ECM_Trace 0;
BA_ "GenSigTimeoutTime_AGSM" SG_ 1051 BCMSAMFailSts 0;
BA_ "GenSigTimeoutTime_ASBS" SG_ 1051 BCMSAMFailSts 0;
BA_ "GenSigTimeoutTime_BCM" SG_ 1051 BCMSAMFailSts 0;
BA_ "GenSigTimeoutTime_BSM" SG_ 1051 BCMSAMFailSts 0;
BA_ "GenSigTimeoutTime_CADM" SG_ 1051 BCMSAMFailSts 0;
BA_ "GenSigTimeoutTime_DMSM" SG_ 1051 BCMSAMFailSts 0;
BA_ "GenSigTimeoutTime_DTCM" SG_ 1051 BCMSAMFailSts 0;
BA_ "GenSigTimeoutTime_ELSDM" SG_ 1051 BCMSAMFailSts 0;
BA_ "GenSigTimeoutTime_ESL" SG_ 1051 BCMSAMFailSts 0;
BA_ "GenSigTimeoutTime_GNMM" SG_ 1051 BCMSAMFailSts 0;
BA_ "GenSigTimeoutTime_HCP" SG_ 1051 BCMSAMFailSts 0;
BA_ "GenSigTimeoutTime_IPC" SG_ 1051 BCMSAMFailSts 0;
BA_ "GenSigTimeoutTime_RFHM" SG_ 1051 BCMSAMFailSts 0;
BA_ "GenSigTimeoutTime_SGW" SG_ 1051 BCMSAMFailSts 0;
BA_ "GenSigTimeoutTime_TCM" SG_ 1051 BCMSAMFailSts 0;
BA_ "GenSigStartValue" SG_ 1051 FUEL_VOLT2 255;
BA_ "GenSigTimeoutTime_AGSM" SG_ 1051 FUEL_VOLT2 0;
BA_ "GenSigTimeoutTime_ASBS" SG_ 1051 FUEL_VOLT2 0;
BA_ "GenSigTimeoutTime_BCM" SG_ 1051 FUEL_VOLT2 0;
BA_ "GenSigTimeoutTime_BSM" SG_ 1051 FUEL_VOLT2 0;
BA_ "GenSigTimeoutTime_CADM" SG_ 1051 FUEL_VOLT2 0;
BA_ "GenSigTimeoutTime_DMSM" SG_ 1051 FUEL_VOLT2 0;
BA_ "GenSigTimeoutTime_DTCM" SG_ 1051 FUEL_VOLT2 0;
BA_ "GenSigTimeoutTime_ELSDM" SG_ 1051 FUEL_VOLT2 0;
BA_ "GenSigTimeoutTime_ESL" SG_ 1051 FUEL_VOLT2 0;
BA_ "GenSigTimeoutTime_GNMM" SG_ 1051 FUEL_VOLT2 0;
BA_ "GenSigTimeoutTime_HCP" SG_ 1051 FUEL_VOLT2 0;
BA_ "GenSigTimeoutTime_IPC" SG_ 1051 FUEL_VOLT2 0;
BA_ "GenSigTimeoutTime_RFHM" SG_ 1051 FUEL_VOLT2 0;
BA_ "GenSigTimeoutTime_SGW" SG_ 1051 FUEL_VOLT2 0;
BA_ "GenSigTimeoutTime_TCM" SG_ 1051 FUEL_VOLT2 0;
BA_ "GenSigTimeoutTime_AGSM" SG_ 1051 VoltageMax 0;
BA_ "GenSigTimeoutTime_ASBS" SG_ 1051 VoltageMax 0;
BA_ "GenSigTimeoutTime_BCM" SG_ 1051 VoltageMax 0;
BA_ "GenSigTimeoutTime_BSM" SG_ 1051 VoltageMax 0;
BA_ "GenSigTimeoutTime_CADM" SG_ 1051 VoltageMax 0;
BA_ "GenSigTimeoutTime_DMSM" SG_ 1051 VoltageMax 0;
BA_ "GenSigTimeoutTime_DTCM" SG_ 1051 VoltageMax 0;
BA_ "GenSigTimeoutTime_ELSDM" SG_ 1051 VoltageMax 0;
BA_ "GenSigTimeoutTime_ESL" SG_ 1051 VoltageMax 0;
BA_ "GenSigTimeoutTime_GNMM" SG_ 1051 VoltageMax 0;
BA_ "GenSigTimeoutTime_HCP" SG_ 1051 VoltageMax 0;
BA_ "GenSigTimeoutTime_IPC" SG_ 1051 VoltageMax 0;
BA_ "GenSigTimeoutTime_RFHM" SG_ 1051 VoltageMax 0;
BA_ "GenSigTimeoutTime_SGW" SG_ 1051 VoltageMax 0;
BA_ "GenSigTimeoutTime_TCM" SG_ 1051 VoltageMax 0;
BA_ "GenSigTimeoutTime_AGSM" SG_ 1051 VoltageMin 0;
BA_ "GenSigTimeoutTime_ASBS" SG_ 1051 VoltageMin 0;
BA_ "GenSigTimeoutTime_BCM" SG_ 1051 VoltageMin 0;
BA_ "GenSigTimeoutTime_BSM" SG_ 1051 VoltageMin 0;
BA_ "GenSigTimeoutTime_CADM" SG_ 1051 VoltageMin 0;
BA_ "GenSigTimeoutTime_DMSM" SG_ 1051 VoltageMin 0;
BA_ "GenSigTimeoutTime_DTCM" SG_ 1051 VoltageMin 0;
BA_ "GenSigTimeoutTime_ELSDM" SG_ 1051 VoltageMin 0;
BA_ "GenSigTimeoutTime_ESL" SG_ 1051 VoltageMin 0;
BA_ "GenSigTimeoutTime_GNMM" SG_ 1051 VoltageMin 0;
BA_ "GenSigTimeoutTime_HCP" SG_ 1051 VoltageMin 0;
BA_ "GenSigTimeoutTime_IPC" SG_ 1051 VoltageMin 0;
BA_ "GenSigTimeoutTime_RFHM" SG_ 1051 VoltageMin 0;
BA_ "GenSigTimeoutTime_SGW" SG_ 1051 VoltageMin 0;
BA_ "GenSigTimeoutTime_TCM" SG_ 1051 VoltageMin 0;
BA_ "GenSigStartValue" SG_ 1051 ExternalTemperatureAD_Voltage 255;
BA_ "GenSigTimeoutTime_AGSM" SG_ 1051 ExternalTemperatureAD_Voltage 0;
BA_ "GenSigTimeoutTime_ASBS" SG_ 1051 ExternalTemperatureAD_Voltage 0;
BA_ "GenSigTimeoutTime_BCM" SG_ 1051 ExternalTemperatureAD_Voltage 0;
BA_ "GenSigTimeoutTime_BSM" SG_ 1051 ExternalTemperatureAD_Voltage 0;
BA_ "GenSigTimeoutTime_CADM" SG_ 1051 ExternalTemperatureAD_Voltage 0;
BA_ "GenSigTimeoutTime_DMSM" SG_ 1051 ExternalTemperatureAD_Voltage 0;
BA_ "GenSigTimeoutTime_DTCM" SG_ 1051 ExternalTemperatureAD_Voltage 0;
BA_ "GenSigTimeoutTime_ELSDM" SG_ 1051 ExternalTemperatureAD_Voltage 0;
BA_ "GenSigTimeoutTime_ESL" SG_ 1051 ExternalTemperatureAD_Voltage 0;
BA_ "GenSigTimeoutTime_GNMM" SG_ 1051 ExternalTemperatureAD_Voltage 0;
BA_ "GenSigTimeoutTime_IPC" SG_ 1051 ExternalTemperatureAD_Voltage 0;
BA_ "GenSigTimeoutTime_RFHM" SG_ 1051 ExternalTemperatureAD_Voltage 0;
BA_ "GenSigTimeoutTime_SGW" SG_ 1051 ExternalTemperatureAD_Voltage 0;
BA_ "GenSigTimeoutTime_TCM" SG_ 1051 ExternalTemperatureAD_Voltage 0;
BA_ "GenSigStartValue" SG_ 1051 FUEL_VOLT 255;
BA_ "GenSigTimeoutTime_AGSM" SG_ 1051 FUEL_VOLT 0;
BA_ "GenSigTimeoutTime_ASBS" SG_ 1051 FUEL_VOLT 0;
BA_ "GenSigTimeoutTime_BCM" SG_ 1051 FUEL_VOLT 0;
BA_ "GenSigTimeoutTime_BSM" SG_ 1051 FUEL_VOLT 0;
BA_ "GenSigTimeoutTime_CADM" SG_ 1051 FUEL_VOLT 0;
BA_ "GenSigTimeoutTime_DMSM" SG_ 1051 FUEL_VOLT 0;
BA_ "GenSigTimeoutTime_DTCM" SG_ 1051 FUEL_VOLT 0;
BA_ "GenSigTimeoutTime_ELSDM" SG_ 1051 FUEL_VOLT 0;
BA_ "GenSigTimeoutTime_ESL" SG_ 1051 FUEL_VOLT 0;
BA_ "GenSigTimeoutTime_GNMM" SG_ 1051 FUEL_VOLT 0;
BA_ "GenSigTimeoutTime_HCP" SG_ 1051 FUEL_VOLT 0;
BA_ "GenSigTimeoutTime_IPC" SG_ 1051 FUEL_VOLT 0;
BA_ "GenSigTimeoutTime_RFHM" SG_ 1051 FUEL_VOLT 0;
BA_ "GenSigTimeoutTime_SGW" SG_ 1051 FUEL_VOLT 0;
BA_ "GenSigTimeoutTime_TCM" SG_ 1051 FUEL_VOLT 0;
BA_ "GenSigTimeoutTime_ADCAM" SG_ 1375 ChkFuelLevelSts 0;
BA_ "GenSigTimeoutTime_EVCU2" SG_ 1375 ChkFuelLevelSts 0;
BA_ "GenSigTimeoutTime_VDCM" SG_ 1375 ChkFuelLevelSts 0;
BA_ "GenSigTimeoutTime_AGSM" SG_ 1375 ChkFuelLevelSts2 0;
BA_ "GenSigTimeoutTime_ASBS" SG_ 1375 ChkFuelLevelSts2 0;
BA_ "GenSigTimeoutTime_BCM" SG_ 1375 ChkFuelLevelSts2 0;
BA_ "GenSigTimeoutTime_BSM" SG_ 1375 ChkFuelLevelSts2 0;
BA_ "GenSigTimeoutTime_CADM" SG_ 1375 ChkFuelLevelSts2 0;
BA_ "GenSigTimeoutTime_DMSM" SG_ 1375 ChkFuelLevelSts2 0;
BA_ "GenSigTimeoutTime_DTCM" SG_ 1375 ChkFuelLevelSts2 0;
BA_ "GenSigTimeoutTime_ELSDM" SG_ 1375 ChkFuelLevelSts2 0;
BA_ "GenSigTimeoutTime_ESL" SG_ 1375 ChkFuelLevelSts2 0;
BA_ "GenSigTimeoutTime_GNMM" SG_ 1375 ChkFuelLevelSts2 0;
BA_ "GenSigTimeoutTime_HCP" SG_ 1375 ChkFuelLevelSts2 0;
BA_ "GenSigTimeoutTime_RFHM" SG_ 1375 ChkFuelLevelSts2 0;
BA_ "GenSigTimeoutTime_SGW" SG_ 1375 ChkFuelLevelSts2 0;
BA_ "GenSigTimeoutTime_TCM" SG_ 1375 ChkFuelLevelSts2 0;
BA_ "GenSigTimeoutTime_AGSM" SG_ 1375 ChkFuelLevelSts 0;
BA_ "GenSigTimeoutTime_ASBS" SG_ 1375 ChkFuelLevelSts 0;
BA_ "GenSigTimeoutTime_BCM" SG_ 1375 ChkFuelLevelSts 0;
BA_ "GenSigTimeoutTime_BSM" SG_ 1375 ChkFuelLevelSts 0;
BA_ "GenSigTimeoutTime_EVCU2" SG_ 159 DeceleratorSts 0;
BA_ "GenSigTimeoutTime_VDCM" SG_ 159 DeceleratorSts 0;
BA_ "GenSigTimeoutTime_EVCU2" SG_ 159 ResumeSwitch 0;
BA_ "GenSigTimeoutTime_VDCM" SG_ 159 ResumeSwitch 0;
BA_ "GenSigTimeoutTime_AGSM" SG_ 159 CRC_BCM13 0;
BA_ "GenSigTimeoutTime_ASBS" SG_ 159 CRC_BCM13 0;
BA_ "GenSigTimeoutTime_BCM" SG_ 159 CRC_BCM13 0;
BA_ "GenSigTimeoutTime_DMSM" SG_ 159 CRC_BCM13 0;
BA_ "GenSigTimeoutTime_DTCM" SG_ 159 CRC_BCM13 0;
BA_ "GenSigTimeoutTime_ELSDM" SG_ 159 CRC_BCM13 0;
BA_ "GenSigTimeoutTime_ESL" SG_ 159 CRC_BCM13 0;
BA_ "GenSigTimeoutTime_GNMM" SG_ 159 CRC_BCM13 0;
BA_ "GenSigTimeoutTime_HCP" SG_ 159 CRC_BCM13 0;
BA_ "GenSigTimeoutTime_IPC" SG_ 159 CRC_BCM13 0;
BA_ "GenSigTimeoutTime_RFHM" SG_ 159 CRC_BCM13 0;
BA_ "GenSigTimeoutTime_SGW" SG_ 159 CRC_BCM13 0;
BA_ "GenSigTimeoutTime_TCM" SG_ 159 CRC_BCM13 0;
BA_ "GenSigTimeoutTime_AGSM" SG_ 159 MessageCounter_BCM13 0;
BA_ "GenSigTimeoutTime_ASBS" SG_ 159 MessageCounter_BCM13 0;
BA_ "GenSigTimeoutTime_BCM" SG_ 159 MessageCounter_BCM13 0;
BA_ "GenSigTimeoutTime_DMSM" SG_ 159 MessageCounter_BCM13 0;
BA_ "GenSigTimeoutTime_DTCM" SG_ 159 MessageCounter_BCM13 0;
BA_ "GenSigTimeoutTime_ELSDM" SG_ 159 MessageCounter_BCM13 0;
BA_ "GenSigTimeoutTime_ESL" SG_ 159 MessageCounter_BCM13 0;
BA_ "GenSigTimeoutTime_GNMM" SG_ 159 MessageCounter_BCM13 0;
BA_ "GenSigTimeoutTime_HCP" SG_ 159 MessageCounter_BCM13 0;
BA_ "GenSigTimeoutTime_IPC" SG_ 159 MessageCounter_BCM13 0;
BA_ "GenSigTimeoutTime_RFHM" SG_ 159 MessageCounter_BCM13 0;
BA_ "GenSigTimeoutTime_SGW" SG_ 159 MessageCounter_BCM13 0;
BA_ "GenSigTimeoutTime_TCM" SG_ 159 MessageCounter_BCM13 0;
BA_ "GenSigTimeoutTime_AGSM" SG_ 159 AcceleratorSts 0;
BA_ "GenSigTimeoutTime_ASBS" SG_ 159 AcceleratorSts 0;
BA_ "GenSigTimeoutTime_BCM" SG_ 159 AcceleratorSts 0;
BA_ "GenSigTimeoutTime_DMSM" SG_ 159 AcceleratorSts 0;
BA_ "GenSigTimeoutTime_DTCM" SG_ 159 AcceleratorSts 0;
BA_ "GenSigTimeoutTime_ELSDM" SG_ 159 AcceleratorSts 0;
BA_ "GenSigTimeoutTime_ESL" SG_ 159 AcceleratorSts 0;
BA_ "GenSigTimeoutTime_GNMM" SG_ 159 AcceleratorSts 0;
BA_ "GenSigTimeoutTime_HCP" SG_ 159 AcceleratorSts 0;
BA_ "GenSigTimeoutTime_IPC" SG_ 159 AcceleratorSts 0;
BA_ "GenSigTimeoutTime_RFHM" SG_ 159 AcceleratorSts 0;
BA_ "GenSigTimeoutTime_TCM" SG_ 159 AcceleratorSts 0;
BA_ "GenSigTimeoutTime_AGSM" SG_ 159 CruiseControlFailSts 0;
BA_ "GenSigTimeoutTime_ASBS" SG_ 159 CruiseControlFailSts 0;
BA_ "GenSigTimeoutTime_BCM" SG_ 159 CruiseControlFailSts 0;
BA_ "GenSigTimeoutTime_BSM" SG_ 159 CruiseControlFailSts 0;
BA_ "GenSigTimeoutTime_DMSM" SG_ 159 CruiseControlFailSts 0;
BA_ "GenSigTimeoutTime_DTCM" SG_ 159 CruiseControlFailSts 0;
BA_ "GenSigTimeoutTime_ELSDM" SG_ 159 CruiseControlFailSts 0;
BA_ "GenSigTimeoutTime_ESL" SG_ 159 CruiseControlFailSts 0;
BA_ "GenSigTimeoutTime_GNMM" SG_ 159 CruiseControlFailSts 0;
BA_ "GenSigTimeoutTime_HCP" SG_ 159 CruiseControlFailSts 0;
BA_ "GenSigTimeoutTime_IPC" SG_ 159 CruiseControlFailSts 0;
BA_ "GenSigTimeoutTime_RFHM" SG_ 159 CruiseControlFailSts 0;
BA_ "GenSigTimeoutTime_SGW" SG_ 159 CruiseControlFailSts 0;
BA_ "GenSigTimeoutTime_TCM" SG_ 159 CruiseControlFailSts 0;
BA_ "GenSigTimeoutTime_AGSM" SG_ 159 CruiseControlOnOffSts 0;
BA_ "GenSigTimeoutTime_ASBS" SG_ 159 CruiseControlOnOffSts 0;
BA_ "GenSigTimeoutTime_BCM" SG_ 159 CruiseControlOnOffSts 0;
BA_ "GenSigTimeoutTime_DMSM" SG_ 159 CruiseControlOnOffSts 0;
BA_ "GenSigTimeoutTime_DTCM" SG_ 159 CruiseControlOnOffSts 0;
BA_ "GenSigTimeoutTime_ELSDM" SG_ 159 CruiseControlOnOffSts 0;
BA_ "GenSigTimeoutTime_ESL" SG_ 159 CruiseControlOnOffSts 0;
BA_ "GenSigTimeoutTime_GNMM" SG_ 159 CruiseControlOnOffSts 0;
BA_ "GenSigTimeoutTime_HCP" SG_ 159 CruiseControlOnOffSts 0;
BA_ "GenSigTimeoutTime_IPC" SG_ 159 CruiseControlOnOffSts 0;
BA_ "GenSigTimeoutTime_CADM" SG_ 1375 ChkFuelLevelSts 0;
BA_ "GenSigTimeoutTime_DMSM" SG_ 1375 ChkFuelLevelSts 0;
BA_ "GenSigTimeoutTime_DTCM" SG_ 1375 ChkFuelLevelSts 0;
BA_ "GenSigTimeoutTime_ELSDM" SG_ 1375 ChkFuelLevelSts 0;
BA_ "GenSigTimeoutTime_ESL" SG_ 1375 ChkFuelLevelSts 0;
BA_ "GenSigTimeoutTime_GNMM" SG_ 1375 ChkFuelLevelSts 0;
BA_ "GenSigTimeoutTime_HCP" SG_ 1375 ChkFuelLevelSts 0;
BA_ "GenSigTimeoutTime_RFHM" SG_ 1375 ChkFuelLevelSts 0;
BA_ "GenSigTimeoutTime_TCM" SG_ 1375 ChkFuelLevelSts 0;
BA_ "GenSigTimeoutTime_VDCM" SG_ 1827 IgnitionOnCounter 0;
BA_ "GenSigTimeoutTime_ESL" SG_ 1827 IgnitionOnCounter 0;
BA_ "GenSigTimeoutTime_BCM" SG_ 1827 IgnitionOnCounter 0;
BA_ "GenSigTimeoutTime_ADCAM" SG_ 1066 BonnetSts 0;
BA_ "GenSigSendType" SG_ 1066 BonnetSts 3;
BA_ "GenSigTimeoutTime_AGSM" SG_ 1066 BonnetSts 0;
BA_ "GenSigTimeoutTime_BCM" SG_ 1066 BonnetSts 0;
BA_ "GenSigTimeoutTime_DTCM" SG_ 1066 BonnetSts 0;
BA_ "GenSigTimeoutTime_ESL" SG_ 1066 BonnetSts 0;
BA_ "GenSigTimeoutTime_RFHM" SG_ 1066 BonnetSts 0;
BA_ "GenSigTimeoutTime_TCM" SG_ 1066 BonnetSts 0;
BA_ "GenSigTimeoutTime_ADCAM" SG_ 1066 ParkBrakeSts 0;
BA_ "GenSigTimeoutTime_VDCM" SG_ 1066 ParkBrakeSts 0;
BA_ "GenSigSendType" SG_ 1066 ParkBrakeSts 3;
BA_ "GenSigTimeoutTime_AGSM" SG_ 1066 ParkBrakeSts 0;
BA_ "GenSigTimeoutTime_BCM" SG_ 1066 ParkBrakeSts 0;
BA_ "GenSigTimeoutTime_BSM" SG_ 1066 ParkBrakeSts 0;
BA_ "GenSigTimeoutTime_DTCM" SG_ 1066 ParkBrakeSts 0;
BA_ "GenSigTimeoutTime_ESL" SG_ 1066 ParkBrakeSts 0;
BA_ "GenSigTimeoutTime_RFHM" SG_ 1066 ParkBrakeSts 0;
BA_ "GenSigTimeoutTime_TCM" SG_ 1066 ParkBrakeSts 0;
BA_ "GenSigTimeoutTime_ADCAM" SG_ 1066 PsngrDoorSts 0;
BA_ "GenSigSendType" SG_ 1066 PsngrDoorSts 3;
BA_ "GenSigTimeoutTime_AGSM" SG_ 1066 PsngrDoorSts 0;
BA_ "GenSigTimeoutTime_BCM" SG_ 1066 PsngrDoorSts 0;
BA_ "GenSigTimeoutTime_BSM" SG_ 1066 PsngrDoorSts 0;
BA_ "GenSigTimeoutTime_DTCM" SG_ 1066 PsngrDoorSts 0;
BA_ "GenSigTimeoutTime_ESL" SG_ 1066 PsngrDoorSts 0;
BA_ "GenSigTimeoutTime_TCM" SG_ 1066 PsngrDoorSts 0;
BA_ "GenSigTimeoutTime_ADCAM" SG_ 1066 RHatchSts 0;
BA_ "GenSigSendType" SG_ 1066 RHatchSts 3;
BA_ "GenSigTimeoutTime_AGSM" SG_ 1066 RHatchSts 0;
BA_ "GenSigTimeoutTime_BCM" SG_ 1066 RHatchSts 0;
BA_ "GenSigTimeoutTime_BSM" SG_ 1066 RHatchSts 0;
BA_ "GenSigTimeoutTime_DTCM" SG_ 1066 RHatchSts 0;
BA_ "GenSigTimeoutTime_ESL" SG_ 1066 RHatchSts 0;
BA_ "GenSigTimeoutTime_TCM" SG_ 1066 RHatchSts 0;
BA_ "GenSigTimeoutTime_ADCAM" SG_ 1066 RHRDoorSts 0;
BA_ "GenSigSendType" SG_ 1066 RHRDoorSts 3;
BA_ "GenSigTimeoutTime_AGSM" SG_ 1066 RHRDoorSts 0;
BA_ "GenSigTimeoutTime_BCM" SG_ 1066 RHRDoorSts 0;
BA_ "GenSigTimeoutTime_BSM" SG_ 1066 RHRDoorSts 0;
BA_ "GenSigTimeoutTime_DTCM" SG_ 1066 RHRDoorSts 0;
BA_ "GenSigTimeoutTime_ESL" SG_ 1066 RHRDoorSts 0;
BA_ "GenSigTimeoutTime_TCM" SG_ 1066 RHRDoorSts 0;
BA_ "GenSigTimeoutTime_ADCAM" SG_ 1066 LHRDoorSts 0;
BA_ "GenSigSendType" SG_ 1066 LHRDoorSts 3;
BA_ "GenSigTimeoutTime_AGSM" SG_ 1066 LHRDoorSts 0;
BA_ "GenSigTimeoutTime_BCM" SG_ 1066 LHRDoorSts 0;
BA_ "GenSigTimeoutTime_BSM" SG_ 1066 LHRDoorSts 0;
BA_ "GenSigTimeoutTime_DTCM" SG_ 1066 LHRDoorSts 0;
BA_ "GenSigTimeoutTime_ESL" SG_ 1066 LHRDoorSts 0;
BA_ "GenSigTimeoutTime_TCM" SG_ 1066 LHRDoorSts 0;
BA_ "GenSigTimeoutTime_ADCAM" SG_ 1066 FuelLevel2 0;
BA_ "GenSigTimeoutTime_EVCU2" SG_ 1066 FuelLevel2 0;
BA_ "GenSigTimeoutTime_VDCM" SG_ 1066 FuelLevel2 0;
BA_ "GenSigTimeoutTime_VDCM" SG_ 1066 CRC_BCM9 0;
BA_ "GenSigTimeoutTime_VDCM" SG_ 1066 FrontWiperMoveSts 0;
BA_ "GenSigTimeoutTime_VDCM" SG_ 1066 MessageCounter_BCM9 0;
BA_ "GenSigTimeoutTime_AGSM" SG_ 1066 FuelLevel2 0;
BA_ "GenSigTimeoutTime_ASBS" SG_ 1066 FuelLevel2 0;
BA_ "GenSigTimeoutTime_BCM" SG_ 1066 FuelLevel2 0;
BA_ "GenSigTimeoutTime_BSM" SG_ 1066 FuelLevel2 0;
BA_ "GenSigTimeoutTime_CADM" SG_ 1066 FuelLevel2 0;
BA_ "GenSigTimeoutTime_DMSM" SG_ 1066 FuelLevel2 0;
BA_ "GenSigTimeoutTime_DTCM" SG_ 1066 FuelLevel2 0;
BA_ "GenSigTimeoutTime_ELSDM" SG_ 1066 FuelLevel2 0;
BA_ "GenSigTimeoutTime_ESL" SG_ 1066 FuelLevel2 0;
BA_ "GenSigTimeoutTime_GNMM" SG_ 1066 FuelLevel2 0;
BA_ "GenSigTimeoutTime_HCP" SG_ 1066 FuelLevel2 0;
BA_ "GenSigTimeoutTime_RFHM" SG_ 1066 FuelLevel2 0;
BA_ "GenSigTimeoutTime_TCM" SG_ 1066 FuelLevel2 0;
BA_ "GenSigTimeoutTime_AGSM" SG_ 1066 CRC_BCM9 0;
BA_ "GenSigTimeoutTime_ASBS" SG_ 1066 CRC_BCM9 0;
BA_ "GenSigTimeoutTime_BCM" SG_ 1066 CRC_BCM9 0;
BA_ "GenSigTimeoutTime_DMSM" SG_ 1066 CRC_BCM9 0;
BA_ "GenSigTimeoutTime_ELSDM" SG_ 1066 CRC_BCM9 0;
BA_ "GenSigTimeoutTime_ESL" SG_ 1066 CRC_BCM9 0;
BA_ "GenSigTimeoutTime_RFHM" SG_ 1066 CRC_BCM9 0;
BA_ "GenSigTimeoutTime_SGW" SG_ 1066 CRC_BCM9 0;
BA_ "GenSigSendType" SG_ 1066 DriverDoorSts 3;
BA_ "GenSigTimeoutTime_AGSM" SG_ 1066 DriverDoorSts 0;
BA_ "GenSigTimeoutTime_ASBS" SG_ 1066 DriverDoorSts 0;
BA_ "GenSigTimeoutTime_BCM" SG_ 1066 DriverDoorSts 0;
BA_ "GenSigTimeoutTime_DMSM" SG_ 1066 DriverDoorSts 0;
BA_ "GenSigTimeoutTime_DTCM" SG_ 1066 DriverDoorSts 0;
BA_ "GenSigTimeoutTime_ELSDM" SG_ 1066 DriverDoorSts 0;
BA_ "GenSigTimeoutTime_ESL" SG_ 1066 DriverDoorSts 0;
BA_ "GenSigTimeoutTime_GNMM" SG_ 1066 DriverDoorSts 0;
BA_ "GenSigTimeoutTime_AGSM" SG_ 1066 FrontWiperMoveSts 0;
BA_ "GenSigTimeoutTime_ASBS" SG_ 1066 FrontWiperMoveSts 0;
BA_ "GenSigTimeoutTime_BCM" SG_ 1066 FrontWiperMoveSts 0;
BA_ "GenSigTimeoutTime_BSM" SG_ 1066 FrontWiperMoveSts 0;
BA_ "GenSigTimeoutTime_DMSM" SG_ 1066 FrontWiperMoveSts 0;
BA_ "GenSigTimeoutTime_ELSDM" SG_ 1066 FrontWiperMoveSts 0;
BA_ "GenSigTimeoutTime_ESL" SG_ 1066 FrontWiperMoveSts 0;
BA_ "GenSigTimeoutTime_GNMM" SG_ 1066 FrontWiperMoveSts 0;
BA_ "GenSigTimeoutTime_HCP" SG_ 1066 FrontWiperMoveSts 0;
BA_ "GenSigTimeoutTime_IPC" SG_ 1066 FrontWiperMoveSts 0;
BA_ "GenSigTimeoutTime_RFHM" SG_ 1066 FrontWiperMoveSts 0;
BA_ "GenSigTimeoutTime_SGW" SG_ 1066 FrontWiperMoveSts 0;
BA_ "GenSigTimeoutTime_TCM" SG_ 1066 FrontWiperMoveSts 0;
BA_ "GenSigSendType" SG_ 1066 LowFuelWarningSts 3;
BA_ "GenSigTimeoutTime_AGSM" SG_ 1066 LowFuelWarningSts 0;
BA_ "GenSigTimeoutTime_ASBS" SG_ 1066 LowFuelWarningSts 0;
BA_ "GenSigTimeoutTime_BCM" SG_ 1066 LowFuelWarningSts 0;
BA_ "GenSigTimeoutTime_BSM" SG_ 1066 LowFuelWarningSts 0;
BA_ "GenSigTimeoutTime_CADM" SG_ 1066 LowFuelWarningSts 0;
BA_ "GenSigTimeoutTime_DMSM" SG_ 1066 LowFuelWarningSts 0;
BA_ "GenSigTimeoutTime_DTCM" SG_ 1066 LowFuelWarningSts 0;
BA_ "GenSigTimeoutTime_ELSDM" SG_ 1066 LowFuelWarningSts 0;
BA_ "GenSigTimeoutTime_ESL" SG_ 1066 LowFuelWarningSts 0;
BA_ "GenSigTimeoutTime_GNMM" SG_ 1066 LowFuelWarningSts 0;
BA_ "GenSigTimeoutTime_HCP" SG_ 1066 LowFuelWarningSts 0;
BA_ "GenSigTimeoutTime_RFHM" SG_ 1066 LowFuelWarningSts 0;
BA_ "GenSigTimeoutTime_TCM" SG_ 1066 LowFuelWarningSts 0;
BA_ "GenSigTimeoutTime_AGSM" SG_ 1066 MessageCounter_BCM9 0;
BA_ "GenSigTimeoutTime_ASBS" SG_ 1066 MessageCounter_BCM9 0;
BA_ "GenSigTimeoutTime_BCM" SG_ 1066 MessageCounter_BCM9 0;
BA_ "GenSigTimeoutTime_DMSM" SG_ 1066 MessageCounter_BCM9 0;
BA_ "GenSigTimeoutTime_ELSDM" SG_ 1066 MessageCounter_BCM9 0;
BA_ "GenSigTimeoutTime_ESL" SG_ 1066 MessageCounter_BCM9 0;
BA_ "GenSigTimeoutTime_RFHM" SG_ 1066 MessageCounter_BCM9 0;
BA_ "GenSigTimeoutTime_SGW" SG_ 1066 MessageCounter_BCM9 0;
BA_ "GenSigTimeoutTime_AGSM" SG_ 1066 FuelLevel 0;
BA_ "GenSigTimeoutTime_ASBS" SG_ 1066 FuelLevel 0;
BA_ "GenSigTimeoutTime_BCM" SG_ 1066 FuelLevel 0;
BA_ "GenSigTimeoutTime_BSM" SG_ 1066 FuelLevel 0;
BA_ "GenSigTimeoutTime_CADM" SG_ 1066 FuelLevel 0;
BA_ "GenSigTimeoutTime_DMSM" SG_ 1066 FuelLevel 0;
BA_ "GenSigTimeoutTime_DTCM" SG_ 1066 FuelLevel 0;
BA_ "GenSigTimeoutTime_ELSDM" SG_ 1066 FuelLevel 0;
BA_ "GenSigTimeoutTime_ESL" SG_ 1066 FuelLevel 0;
BA_ "GenSigTimeoutTime_GNMM" SG_ 1066 FuelLevel 0;
BA_ "GenSigTimeoutTime_HCP" SG_ 1066 FuelLevel 0;
BA_ "GenSigTimeoutTime_RFHM" SG_ 1066 FuelLevel 0;
BA_ "GenSigTimeoutTime_TCM" SG_ 1066 FuelLevel 0;
BA_ "GenSigTimeoutTime_AGSM" SG_ 1066 PowerModeSts 0;
BA_ "GenSigTimeoutTime_ASBS" SG_ 1066 PowerModeSts 0;
BA_ "GenSigTimeoutTime_BCM" SG_ 1066 PowerModeSts 0;
BA_ "GenSigTimeoutTime_DMSM" SG_ 1066 PowerModeSts 0;
BA_ "GenSigTimeoutTime_DTCM" SG_ 1066 PowerModeSts 0;
BA_ "GenSigTimeoutTime_ELSDM" SG_ 1066 PowerModeSts 0;
BA_ "GenSigTimeoutTime_ESL" SG_ 1066 PowerModeSts 0;
BA_ "GenSigTimeoutTime_TCM" SG_ 1066 PowerModeSts 0;
BA_ "GenSigTimeoutTime_ADCAM" SG_ 513 EngSpdInterv 0;
BA_ "GenSigTimeoutTime_EVCU2" SG_ 513 EngSpdInterv 0;
BA_ "GenSigTimeoutTime_VDCM" SG_ 513 EngSpdInterv 0;
BA_ "GenSigStartValue" SG_ 513 EngSpdInterv 65535;
BA_ "GenSigTimeoutTime_AGSM" SG_ 513 EngSpdInterv 0;
BA_ "GenSigTimeoutTime_BCM" SG_ 513 EngSpdInterv 0;
BA_ "GenSigTimeoutTime_BSM" SG_ 513 EngSpdInterv 0;
BA_ "GenSigTimeoutTime_DTCM" SG_ 513 EngSpdInterv 0;
BA_ "GenSigTimeoutTime_ESL" SG_ 513 EngSpdInterv 0;
BA_ "GenSigTimeoutTime_IPC" SG_ 513 EngSpdInterv 0;
BA_ "GenSigTimeoutTime_RFHM" SG_ 513 EngSpdInterv 0;
BA_ "GenSigTimeoutTime_SGW" SG_ 513 EngSpdInterv 0;
BA_ "GenSigTimeoutTime_TCM" SG_ 513 EngSpdInterv 0;
BA_ "GenSigTimeoutTime_ADCAM" SG_ 513 VehicleStandStillSts 0;
BA_ "GenSigTimeoutTime_VDCM" SG_ 513 VehicleStandStillSts 0;
BA_ "GenSigStartValue" SG_ 513 VehicleStandStillSts 1;
BA_ "GenSigTimeoutTime_AGSM" SG_ 513 VehicleStandStillSts 0;
BA_ "GenSigTimeoutTime_BCM" SG_ 513 VehicleStandStillSts 0;
BA_ "GenSigTimeoutTime_BSM" SG_ 513 VehicleStandStillSts 0;
BA_ "GenSigTimeoutTime_DTCM" SG_ 513 VehicleStandStillSts 0;
BA_ "GenSigTimeoutTime_AGSM" SG_ 2654339184 DES_FD08_SGW 0;
BA_ "GenSigTimeoutTime_ASBS" SG_ 2654339184 DES_FD08_SGW 0;
BA_ "GenSigTimeoutTime_BCM" SG_ 2654339184 DES_FD08_SGW 0;
BA_ "GenSigTimeoutTime_BSM" SG_ 2654339184 DES_FD08_SGW 0;
BA_ "GenSigTimeoutTime_CADM" SG_ 2654339184 DES_FD08_SGW 0;
BA_ "GenSigTimeoutTime_DMSM" SG_ 2654339184 DES_FD08_SGW 0;
BA_ "GenSigTimeoutTime_DTCM" SG_ 2654339184 DES_FD08_SGW 0;
BA_ "GenSigTimeoutTime_ELSDM" SG_ 2654339184 DES_FD08_SGW 0;
BA_ "GenSigTimeoutTime_ESL" SG_ 2654339184 DES_FD08_SGW 0;
BA_ "GenSigTimeoutTime_GNMM" SG_ 2654339184 DES_FD08_SGW 0;
BA_ "GenSigTimeoutTime_HCP" SG_ 2654339184 DES_FD08_SGW 0;
BA_ "GenSigTimeoutTime_IPC" SG_ 2654339184 DES_FD08_SGW 0;
BA_ "GenSigTimeoutTime_RFHM" SG_ 2654339184 DES_FD08_SGW 0;
BA_ "GenSigTimeoutTime_SGW" SG_ 2654339184 DES_FD08_SGW 0;
BA_ "GenSigTimeoutTime_TCM" SG_ 2654339184 DES_FD08_SGW 0;
BA_ "GenSigTimeoutTime_AGSM" SG_ 2654339184 DES_FD11_SGW 0;
BA_ "GenSigTimeoutTime_ASBS" SG_ 2654339184 DES_FD11_SGW 0;
BA_ "GenSigTimeoutTime_BCM" SG_ 2654339184 DES_FD11_SGW 0;
BA_ "GenSigTimeoutTime_BSM" SG_ 2654339184 DES_FD11_SGW 0;
BA_ "GenSigTimeoutTime_CADM" SG_ 2654339184 DES_FD11_SGW 0;
BA_ "GenSigTimeoutTime_DMSM" SG_ 2654339184 DES_FD11_SGW 0;
BA_ "GenSigTimeoutTime_DTCM" SG_ 2654339184 DES_FD11_SGW 0;
BA_ "GenSigTimeoutTime_ELSDM" SG_ 2654339184 DES_FD11_SGW 0;
BA_ "GenSigTimeoutTime_ESL" SG_ 2654339184 DES_FD11_SGW 0;
BA_ "GenSigTimeoutTime_GNMM" SG_ 2654339184 DES_FD11_SGW 0;
BA_ "GenSigTimeoutTime_HCP" SG_ 2654339184 DES_FD11_SGW 0;
BA_ "GenSigTimeoutTime_IPC" SG_ 2654339184 DES_FD11_SGW 0;
BA_ "GenSigTimeoutTime_RFHM" SG_ 2654339184 DES_FD11_SGW 0;
BA_ "GenSigTimeoutTime_SGW" SG_ 2654339184 DES_FD11_SGW 0;
BA_ "GenSigTimeoutTime_TCM" SG_ 2654339184 DES_FD11_SGW 0;
BA_ "GenSigTimeoutTime_AGSM" SG_ 2654339184 PreviousCanNMState_FD01_SGW 0;
BA_ "GenSigTimeoutTime_ASBS" SG_ 2654339184 PreviousCanNMState_FD01_SGW 0;
BA_ "GenSigTimeoutTime_BCM" SG_ 2654339184 PreviousCanNMState_FD01_SGW 0;
BA_ "GenSigTimeoutTime_BSM" SG_ 2654339184 PreviousCanNMState_FD01_SGW 0;
BA_ "GenSigTimeoutTime_CADM" SG_ 2654339184 PreviousCanNMState_FD01_SGW 0;
BA_ "GenSigTimeoutTime_DMSM" SG_ 2654339184 PreviousCanNMState_FD01_SGW 0;
BA_ "GenSigTimeoutTime_DTCM" SG_ 2654339184 PreviousCanNMState_FD01_SGW 0;
BA_ "GenSigTimeoutTime_ELSDM" SG_ 2654339184 PreviousCanNMState_FD01_SGW 0;
BA_ "GenSigTimeoutTime_ESL" SG_ 2654339184 PreviousCanNMState_FD01_SGW 0;
BA_ "GenSigTimeoutTime_GNMM" SG_ 2654339184 PreviousCanNMState_FD01_SGW 0;
BA_ "GenSigTimeoutTime_HCP" SG_ 2654339184 PreviousCanNMState_FD01_SGW 0;
BA_ "GenSigTimeoutTime_IPC" SG_ 2654339184 PreviousCanNMState_FD01_SGW 0;
BA_ "GenSigTimeoutTime_RFHM" SG_ 2654339184 PreviousCanNMState_FD01_SGW 0;
BA_ "GenSigTimeoutTime_SGW" SG_ 2654339184 PreviousCanNMState_FD01_SGW 0;
BA_ "GenSigTimeoutTime_TCM" SG_ 2654339184 PreviousCanNMState_FD01_SGW 0;
BA_ "GenSigTimeoutTime_AGSM" SG_ 2654339184 PreviousCanNMState_FD02_SGW 0;
BA_ "GenSigTimeoutTime_ASBS" SG_ 2654339184 PreviousCanNMState_FD02_SGW 0;
BA_ "GenSigTimeoutTime_BCM" SG_ 2654339184 PreviousCanNMState_FD02_SGW 0;
BA_ "GenSigTimeoutTime_BSM" SG_ 2654339184 PreviousCanNMState_FD02_SGW 0;
BA_ "GenSigTimeoutTime_CADM" SG_ 2654339184 PreviousCanNMState_FD02_SGW 0;
BA_ "GenSigTimeoutTime_DMSM" SG_ 2654339184 PreviousCanNMState_FD02_SGW 0;
BA_ "GenSigTimeoutTime_DTCM" SG_ 2654339184 PreviousCanNMState_FD02_SGW 0;
BA_ "GenSigTimeoutTime_ELSDM" SG_ 2654339184 PreviousCanNMState_FD02_SGW 0;
BA_ "GenSigTimeoutTime_ESL" SG_ 2654339184 PreviousCanNMState_FD02_SGW 0;
BA_ "GenSigTimeoutTime_GNMM" SG_ 2654339184 PreviousCanNMState_FD02_SGW 0;
BA_ "GenSigTimeoutTime_HCP" SG_ 2654339184 PreviousCanNMState_FD02_SGW 0;
BA_ "GenSigTimeoutTime_IPC" SG_ 2654339184 PreviousCanNMState_FD02_SGW 0;
BA_ "GenSigTimeoutTime_RFHM" SG_ 2654339184 PreviousCanNMState_FD02_SGW 0;
BA_ "GenSigTimeoutTime_SGW" SG_ 2654339184 PreviousCanNMState_FD02_SGW 0;
BA_ "GenSigTimeoutTime_TCM" SG_ 2654339184 PreviousCanNMState_FD02_SGW 0;
BA_ "GenSigTimeoutTime_AGSM" SG_ 2654339184 PreviousCanNMState_FD03_SGW 0;
BA_ "GenSigTimeoutTime_ASBS" SG_ 2654339184 PreviousCanNMState_FD03_SGW 0;
BA_ "GenSigTimeoutTime_BCM" SG_ 2654339184 PreviousCanNMState_FD03_SGW 0;
BA_ "GenSigTimeoutTime_BSM" SG_ 2654339184 PreviousCanNMState_FD03_SGW 0;
BA_ "GenSigTimeoutTime_CADM" SG_ 2654339184 PreviousCanNMState_FD03_SGW 0;
BA_ "GenSigTimeoutTime_DMSM" SG_ 2654339184 PreviousCanNMState_FD03_SGW 0;
BA_ "GenSigTimeoutTime_DTCM" SG_ 2654339184 PreviousCanNMState_FD03_SGW 0;
BA_ "GenSigTimeoutTime_ELSDM" SG_ 2654339184 PreviousCanNMState_FD03_SGW 0;
BA_ "GenSigTimeoutTime_ESL" SG_ 2654339184 PreviousCanNMState_FD03_SGW 0;
BA_ "GenSigTimeoutTime_GNMM" SG_ 2654339184 PreviousCanNMState_FD03_SGW 0;
BA_ "GenSigTimeoutTime_HCP" SG_ 2654339184 PreviousCanNMState_FD03_SGW 0;
BA_ "GenSigTimeoutTime_IPC" SG_ 2654339184 PreviousCanNMState_FD03_SGW 0;
BA_ "GenSigTimeoutTime_RFHM" SG_ 2654339184 PreviousCanNMState_FD03_SGW 0;
BA_ "GenSigTimeoutTime_SGW" SG_ 2654339184 PreviousCanNMState_FD03_SGW 0;
BA_ "GenSigTimeoutTime_TCM" SG_ 2654339184 PreviousCanNMState_FD03_SGW 0;
BA_ "GenSigTimeoutTime_AGSM" SG_ 2654339184 PreviousCanNMState_FD08_SGW 0;
BA_ "GenSigTimeoutTime_ASBS" SG_ 2654339184 PreviousCanNMState_FD08_SGW 0;
BA_ "GenSigTimeoutTime_BCM" SG_ 2654339184 PreviousCanNMState_FD08_SGW 0;
BA_ "GenSigTimeoutTime_BSM" SG_ 2654339184 PreviousCanNMState_FD08_SGW 0;
BA_ "GenSigTimeoutTime_CADM" SG_ 2654339184 PreviousCanNMState_FD08_SGW 0;
BA_ "GenSigTimeoutTime_DMSM" SG_ 2654339184 PreviousCanNMState_FD08_SGW 0;
BA_ "GenSigTimeoutTime_DTCM" SG_ 2654339184 PreviousCanNMState_FD08_SGW 0;
BA_ "GenSigTimeoutTime_ELSDM" SG_ 2654339184 PreviousCanNMState_FD08_SGW 0;
BA_ "GenSigTimeoutTime_ESL" SG_ 2654339184 PreviousCanNMState_FD08_SGW 0;
BA_ "GenSigTimeoutTime_GNMM" SG_ 2654339184 PreviousCanNMState_FD08_SGW 0;
BA_ "GenSigTimeoutTime_HCP" SG_ 2654339184 PreviousCanNMState_FD08_SGW 0;
BA_ "GenSigTimeoutTime_IPC" SG_ 2654339184 PreviousCanNMState_FD08_SGW 0;
BA_ "GenSigTimeoutTime_RFHM" SG_ 2654339184 PreviousCanNMState_FD08_SGW 0;
BA_ "GenSigTimeoutTime_SGW" SG_ 2654339184 PreviousCanNMState_FD08_SGW 0;
BA_ "GenSigTimeoutTime_TCM" SG_ 2654339184 PreviousCanNMState_FD08_SGW 0;
BA_ "GenSigTimeoutTime_AGSM" SG_ 2654339184 CurrentCanNMState_FD03_SGW 0;
BA_ "GenSigTimeoutTime_ASBS" SG_ 2654339184 CurrentCanNMState_FD03_SGW 0;
BA_ "GenSigTimeoutTime_BCM" SG_ 2654339184 CurrentCanNMState_FD03_SGW 0;
BA_ "GenSigTimeoutTime_BSM" SG_ 2654339184 CurrentCanNMState_FD03_SGW 0;
BA_ "GenSigTimeoutTime_CADM" SG_ 2654339184 CurrentCanNMState_FD03_SGW 0;
BA_ "GenSigTimeoutTime_DMSM" SG_ 2654339184 CurrentCanNMState_FD03_SGW 0;
BA_ "GenSigTimeoutTime_DTCM" SG_ 2654339184 CurrentCanNMState_FD03_SGW 0;
BA_ "GenSigTimeoutTime_ELSDM" SG_ 2654339184 CurrentCanNMState_FD03_SGW 0;
BA_ "GenSigTimeoutTime_ESL" SG_ 2654339184 CurrentCanNMState_FD03_SGW 0;
BA_ "GenSigTimeoutTime_GNMM" SG_ 2654339184 CurrentCanNMState_FD03_SGW 0;
BA_ "GenSigTimeoutTime_HCP" SG_ 2654339184 CurrentCanNMState_FD03_SGW 0;
BA_ "GenSigTimeoutTime_IPC" SG_ 2654339184 CurrentCanNMState_FD03_SGW 0;
BA_ "GenSigTimeoutTime_RFHM" SG_ 2654339184 CurrentCanNMState_FD03_SGW 0;
BA_ "GenSigTimeoutTime_SGW" SG_ 2654339184 CurrentCanNMState_FD03_SGW 0;
BA_ "GenSigTimeoutTime_TCM" SG_ 2654339184 CurrentCanNMState_FD03_SGW 0;
BA_ "GenSigTimeoutTime_AGSM" SG_ 2654339184 CurrentCanNMState_FD08_SGW 0;
BA_ "GenSigTimeoutTime_ASBS" SG_ 2654339184 CurrentCanNMState_FD08_SGW 0;
BA_ "GenSigTimeoutTime_BCM" SG_ 2654339184 CurrentCanNMState_FD08_SGW 0;
BA_ "GenSigTimeoutTime_BSM" SG_ 2654339184 CurrentCanNMState_FD08_SGW 0;
BA_ "GenSigTimeoutTime_CADM" SG_ 2654339184 CurrentCanNMState_FD08_SGW 0;
BA_ "GenSigTimeoutTime_DMSM" SG_ 2654339184 CurrentCanNMState_FD08_SGW 0;
BA_ "GenSigTimeoutTime_DTCM" SG_ 2654339184 CurrentCanNMState_FD08_SGW 0;
BA_ "GenSigTimeoutTime_ELSDM" SG_ 2654339184 CurrentCanNMState_FD08_SGW 0;
BA_ "GenSigTimeoutTime_ESL" SG_ 2654339184 CurrentCanNMState_FD08_SGW 0;
BA_ "GenSigTimeoutTime_GNMM" SG_ 2654339184 CurrentCanNMState_FD08_SGW 0;
BA_ "GenSigTimeoutTime_HCP" SG_ 2654339184 CurrentCanNMState_FD08_SGW 0;
BA_ "GenSigTimeoutTime_IPC" SG_ 2654339184 CurrentCanNMState_FD08_SGW 0;
BA_ "GenSigTimeoutTime_RFHM" SG_ 2654339184 CurrentCanNMState_FD08_SGW 0;
BA_ "GenSigTimeoutTime_SGW" SG_ 2654339184 CurrentCanNMState_FD08_SGW 0;
BA_ "GenSigTimeoutTime_TCM" SG_ 2654339184 CurrentCanNMState_FD08_SGW 0;
BA_ "GenSigTimeoutTime_AGSM" SG_ 2654339184 CurrentCanNMState_FD11_SGW 0;
BA_ "GenSigTimeoutTime_ASBS" SG_ 2654339184 CurrentCanNMState_FD11_SGW 0;
BA_ "GenSigTimeoutTime_BCM" SG_ 2654339184 CurrentCanNMState_FD11_SGW 0;
BA_ "GenSigTimeoutTime_BSM" SG_ 2654339184 CurrentCanNMState_FD11_SGW 0;
BA_ "GenSigTimeoutTime_CADM" SG_ 2654339184 CurrentCanNMState_FD11_SGW 0;
BA_ "GenSigTimeoutTime_DMSM" SG_ 2654339184 CurrentCanNMState_FD11_SGW 0;
BA_ "GenSigTimeoutTime_DTCM" SG_ 2654339184 CurrentCanNMState_FD11_SGW 0;
BA_ "GenSigTimeoutTime_ELSDM" SG_ 2654339184 CurrentCanNMState_FD11_SGW 0;
BA_ "GenSigTimeoutTime_ESL" SG_ 2654339184 CurrentCanNMState_FD11_SGW 0;
BA_ "GenSigTimeoutTime_GNMM" SG_ 2654339184 CurrentCanNMState_FD11_SGW 0;
BA_ "GenSigTimeoutTime_HCP" SG_ 2654339184 CurrentCanNMState_FD11_SGW 0;
BA_ "GenSigTimeoutTime_IPC" SG_ 2654339184 CurrentCanNMState_FD11_SGW 0;
BA_ "GenSigTimeoutTime_RFHM" SG_ 2654339184 CurrentCanNMState_FD11_SGW 0;
BA_ "GenSigTimeoutTime_SGW" SG_ 2654339184 CurrentCanNMState_FD11_SGW 0;
BA_ "GenSigTimeoutTime_TCM" SG_ 2654339184 CurrentCanNMState_FD11_SGW 0;
BA_ "GenSigTimeoutTime_AGSM" SG_ 2654339184 DES_FD01_SGW 0;
BA_ "GenSigTimeoutTime_ASBS" SG_ 2654339184 DES_FD01_SGW 0;
BA_ "GenSigTimeoutTime_BCM" SG_ 2654339184 DES_FD01_SGW 0;
BA_ "GenSigTimeoutTime_TCM" SG_ 159 CruiseControlOnOffSts 0;
BA_ "GenSigTimeoutTime_AGSM" SG_ 159 DeceleratorSts 0;
BA_ "GenSigTimeoutTime_ASBS" SG_ 159 DeceleratorSts 0;
BA_ "GenSigTimeoutTime_BCM" SG_ 159 DeceleratorSts 0;
BA_ "GenSigTimeoutTime_DMSM" SG_ 159 DeceleratorSts 0;
BA_ "GenSigTimeoutTime_DTCM" SG_ 159 DeceleratorSts 0;
BA_ "GenSigTimeoutTime_ELSDM" SG_ 159 DeceleratorSts 0;
BA_ "GenSigTimeoutTime_ESL" SG_ 159 DeceleratorSts 0;
BA_ "GenSigTimeoutTime_GNMM" SG_ 159 DeceleratorSts 0;
BA_ "GenSigTimeoutTime_HCP" SG_ 159 DeceleratorSts 0;
BA_ "GenSigTimeoutTime_IPC" SG_ 159 DeceleratorSts 0;
BA_ "GenSigTimeoutTime_RFHM" SG_ 159 DeceleratorSts 0;
BA_ "GenSigTimeoutTime_TCM" SG_ 159 DeceleratorSts 0;
BA_ "GenSigTimeoutTime_AGSM" SG_ 159 ResumeSwitch 0;
BA_ "GenSigTimeoutTime_ASBS" SG_ 159 ResumeSwitch 0;
BA_ "GenSigTimeoutTime_BCM" SG_ 159 ResumeSwitch 0;
BA_ "GenSigTimeoutTime_DMSM" SG_ 159 ResumeSwitch 0;
BA_ "GenSigTimeoutTime_DTCM" SG_ 159 ResumeSwitch 0;
BA_ "GenSigTimeoutTime_ELSDM" SG_ 159 ResumeSwitch 0;
BA_ "GenSigTimeoutTime_ESL" SG_ 159 ResumeSwitch 0;
BA_ "GenSigTimeoutTime_GNMM" SG_ 159 ResumeSwitch 0;
BA_ "GenSigTimeoutTime_HCP" SG_ 159 ResumeSwitch 0;
BA_ "GenSigTimeoutTime_IPC" SG_ 159 ResumeSwitch 0;
BA_ "GenSigTimeoutTime_RFHM" SG_ 159 ResumeSwitch 0;
BA_ "GenSigTimeoutTime_TCM" SG_ 159 ResumeSwitch 0;
BA_ "GenSigSendType" SG_ 159 ACC_On 1;
BA_ "GenSigTimeoutTime_AGSM" SG_ 159 ACC_On 0;
BA_ "GenSigTimeoutTime_ASBS" SG_ 159 ACC_On 0;
BA_ "GenSigTimeoutTime_BCM" SG_ 159 ACC_On 0;
BA_ "GenSigTimeoutTime_DMSM" SG_ 159 ACC_On 0;
BA_ "GenSigTimeoutTime_DTCM" SG_ 159 ACC_On 0;
BA_ "GenSigTimeoutTime_ELSDM" SG_ 159 ACC_On 0;
BA_ "GenSigTimeoutTime_ESL" SG_ 159 ACC_On 0;
BA_ "GenSigTimeoutTime_GNMM" SG_ 159 ACC_On 0;
BA_ "GenSigTimeoutTime_HCP" SG_ 159 ACC_On 0;
BA_ "GenSigTimeoutTime_IPC" SG_ 159 ACC_On 0;
BA_ "GenSigTimeoutTime_RFHM" SG_ 159 ACC_On 0;
BA_ "GenSigTimeoutTime_TCM" SG_ 159 ACC_On 0;
BA_ "GenSigStartValue" SG_ 159 CRC_CSWC_1 255;
BA_ "GenSigTimeoutTime_AGSM" SG_ 159 CRC_CSWC_1 0;
BA_ "GenSigTimeoutTime_ASBS" SG_ 159 CRC_CSWC_1 0;
BA_ "GenSigTimeoutTime_BCM" SG_ 159 CRC_CSWC_1 0;
BA_ "GenSigTimeoutTime_BSM" SG_ 159 CRC_CSWC_1 0;
BA_ "GenSigTimeoutTime_CADM" SG_ 159 CRC_CSWC_1 0;
BA_ "GenSigTimeoutTime_DMSM" SG_ 159 CRC_CSWC_1 0;
BA_ "GenSigTimeoutTime_DTCM" SG_ 159 CRC_CSWC_1 0;
BA_ "GenSigTimeoutTime_ELSDM" SG_ 159 CRC_CSWC_1 0;
BA_ "GenSigTimeoutTime_ESL" SG_ 159 CRC_CSWC_1 0;
BA_ "GenSigTimeoutTime_GNMM" SG_ 159 CRC_CSWC_1 0;
BA_ "GenSigTimeoutTime_HCP" SG_ 159 CRC_CSWC_1 0;
BA_ "GenSigTimeoutTime_IPC" SG_ 159 CRC_CSWC_1 0;
BA_ "GenSigTimeoutTime_RFHM" SG_ 159 CRC_CSWC_1 0;
BA_ "GenSigTimeoutTime_SGW" SG_ 159 CRC_CSWC_1 0;
BA_ "GenSigTimeoutTime_TCM" SG_ 159 CRC_CSWC_1 0;
BA_ "GenSigSendType" SG_ 159 CrusCnclSwitch 3;
BA_ "GenSigTimeoutTime_AGSM" SG_ 159 CrusCnclSwitch 0;
BA_ "GenSigTimeoutTime_ASBS" SG_ 159 CrusCnclSwitch 0;
BA_ "GenSigTimeoutTime_BCM" SG_ 159 CrusCnclSwitch 0;
BA_ "GenSigTimeoutTime_DMSM" SG_ 159 CrusCnclSwitch 0;
BA_ "GenSigTimeoutTime_DTCM" SG_ 159 CrusCnclSwitch 0;
BA_ "GenSigTimeoutTime_ELSDM" SG_ 159 CrusCnclSwitch 0;
BA_ "GenSigTimeoutTime_ESL" SG_ 159 CrusCnclSwitch 0;
BA_ "GenSigTimeoutTime_GNMM" SG_ 159 CrusCnclSwitch 0;
BA_ "GenSigTimeoutTime_HCP" SG_ 159 CrusCnclSwitch 0;
BA_ "GenSigTimeoutTime_IPC" SG_ 159 CrusCnclSwitch 0;
BA_ "GenSigTimeoutTime_RFHM" SG_ 159 CrusCnclSwitch 0;
BA_ "GenSigTimeoutTime_TCM" SG_ 159 CrusCnclSwitch 0;
BA_ "GenSigTimeoutTime_AGSM" SG_ 159 MC_CSWC_1 0;
BA_ "GenSigTimeoutTime_ASBS" SG_ 159 MC_CSWC_1 0;
BA_ "GenSigTimeoutTime_BCM" SG_ 159 MC_CSWC_1 0;
BA_ "GenSigTimeoutTime_BSM" SG_ 159 MC_CSWC_1 0;
BA_ "GenSigTimeoutTime_CADM" SG_ 159 MC_CSWC_1 0;
BA_ "GenSigTimeoutTime_DMSM" SG_ 159 MC_CSWC_1 0;
BA_ "GenSigTimeoutTime_DTCM" SG_ 159 MC_CSWC_1 0;
BA_ "GenSigTimeoutTime_ELSDM" SG_ 159 MC_CSWC_1 0;
BA_ "GenSigTimeoutTime_ESL" SG_ 159 MC_CSWC_1 0;
BA_ "GenSigTimeoutTime_GNMM" SG_ 159 MC_CSWC_1 0;
BA_ "GenSigTimeoutTime_HCP" SG_ 159 MC_CSWC_1 0;
BA_ "GenSigTimeoutTime_IPC" SG_ 159 MC_CSWC_1 0;
BA_ "GenSigTimeoutTime_RFHM" SG_ 159 MC_CSWC_1 0;
BA_ "GenSigTimeoutTime_SGW" SG_ 159 MC_CSWC_1 0;
BA_ "GenSigTimeoutTime_TCM" SG_ 159 MC_CSWC_1 0;
BA_ "GenSigSendType" SG_ 159 SpeedLimiterOnOffSts 3;
BA_ "GenSigTimeoutTime_AGSM" SG_ 159 SpeedLimiterOnOffSts 0;
BA_ "GenSigTimeoutTime_ASBS" SG_ 159 SpeedLimiterOnOffSts 0;
BA_ "GenSigTimeoutTime_BCM" SG_ 159 SpeedLimiterOnOffSts 0;
BA_ "GenSigTimeoutTime_BSM" SG_ 159 SpeedLimiterOnOffSts 0;
BA_ "GenSigTimeoutTime_DMSM" SG_ 159 SpeedLimiterOnOffSts 0;
BA_ "GenSigTimeoutTime_DTCM" SG_ 159 SpeedLimiterOnOffSts 0;
BA_ "GenSigTimeoutTime_ELSDM" SG_ 159 SpeedLimiterOnOffSts 0;
BA_ "GenSigTimeoutTime_ESL" SG_ 159 SpeedLimiterOnOffSts 0;
BA_ "GenSigTimeoutTime_GNMM" SG_ 159 SpeedLimiterOnOffSts 0;
BA_ "GenSigTimeoutTime_HCP" SG_ 159 SpeedLimiterOnOffSts 0;
BA_ "GenSigTimeoutTime_IPC" SG_ 159 SpeedLimiterOnOffSts 0;
BA_ "GenSigTimeoutTime_RFHM" SG_ 159 SpeedLimiterOnOffSts 0;
BA_ "GenSigTimeoutTime_SGW" SG_ 159 SpeedLimiterOnOffSts 0;
BA_ "GenSigTimeoutTime_TCM" SG_ 159 SpeedLimiterOnOffSts 0;
BA_ "GenSigTimeoutTime_ADCAM" SG_ 512 BonnetAjarRawValSts_8 0;
BA_ "GenSigTimeoutTime_VDCM" SG_ 512 BonnetAjarRawValSts_8 0;
BA_ "GenSigTimeoutTime_AGSM" SG_ 512 BonnetAjarRawValSts_8 0;
BA_ "GenSigTimeoutTime_ASBS" SG_ 512 BonnetAjarRawValSts_8 0;
BA_ "GenSigTimeoutTime_BCM" SG_ 512 BonnetAjarRawValSts_8 0;
BA_ "GenSigTimeoutTime_CADM" SG_ 512 BonnetAjarRawValSts_8 0;
BA_ "GenSigTimeoutTime_DMSM" SG_ 512 BonnetAjarRawValSts_8 0;
BA_ "GenSigTimeoutTime_DTCM" SG_ 512 BonnetAjarRawValSts_8 0;
BA_ "GenSigTimeoutTime_ELSDM" SG_ 512 BonnetAjarRawValSts_8 0;
BA_ "GenSigTimeoutTime_ESL" SG_ 512 BonnetAjarRawValSts_8 0;
BA_ "GenSigTimeoutTime_GNMM" SG_ 512 BonnetAjarRawValSts_8 0;
BA_ "GenSigTimeoutTime_IPC" SG_ 512 BonnetAjarRawValSts_8 0;
BA_ "GenSigTimeoutTime_RFHM" SG_ 512 BonnetAjarRawValSts_8 0;
BA_ "GenSigTimeoutTime_SGW" SG_ 512 BonnetAjarRawValSts_8 0;
BA_ "GenSigTimeoutTime_TCM" SG_ 512 BonnetAjarRawValSts_8 0;
BA_ "GenSigTimeoutTime_AGSM" SG_ 512 DriverDoor2AjarRawValSts_8 0;
BA_ "GenSigTimeoutTime_ASBS" SG_ 512 DriverDoor2AjarRawValSts_8 0;
BA_ "GenSigTimeoutTime_BCM" SG_ 512 DriverDoor2AjarRawValSts_8 0;
BA_ "GenSigTimeoutTime_CADM" SG_ 512 DriverDoor2AjarRawValSts_8 0;
BA_ "GenSigTimeoutTime_DMSM" SG_ 512 DriverDoor2AjarRawValSts_8 0;
BA_ "GenSigTimeoutTime_DTCM" SG_ 512 DriverDoor2AjarRawValSts_8 0;
BA_ "GenSigTimeoutTime_ELSDM" SG_ 512 DriverDoor2AjarRawValSts_8 0;
BA_ "GenSigTimeoutTime_ESL" SG_ 512 DriverDoor2AjarRawValSts_8 0;
BA_ "GenSigTimeoutTime_GNMM" SG_ 512 DriverDoor2AjarRawValSts_8 0;
BA_ "GenSigTimeoutTime_HCP" SG_ 512 DriverDoor2AjarRawValSts_8 0;
BA_ "GenSigTimeoutTime_IPC" SG_ 512 DriverDoor2AjarRawValSts_8 0;
BA_ "GenSigTimeoutTime_RFHM" SG_ 512 DriverDoor2AjarRawValSts_8 0;
BA_ "GenSigTimeoutTime_SGW" SG_ 512 DriverDoor2AjarRawValSts_8 0;
BA_ "GenSigTimeoutTime_AGSM" SG_ 512 DriverDoorAjarRawValSts_8 0;
BA_ "GenSigTimeoutTime_ASBS" SG_ 512 DriverDoorAjarRawValSts_8 0;
BA_ "GenSigTimeoutTime_BCM" SG_ 512 DriverDoorAjarRawValSts_8 0;
BA_ "GenSigTimeoutTime_CADM" SG_ 512 DriverDoorAjarRawValSts_8 0;
BA_ "GenSigTimeoutTime_DMSM" SG_ 512 DriverDoorAjarRawValSts_8 0;
BA_ "GenSigTimeoutTime_DTCM" SG_ 512 DriverDoorAjarRawValSts_8 0;
BA_ "GenSigTimeoutTime_ELSDM" SG_ 512 DriverDoorAjarRawValSts_8 0;
BA_ "GenSigTimeoutTime_ESL" SG_ 512 DriverDoorAjarRawValSts_8 0;
BA_ "GenSigTimeoutTime_GNMM" SG_ 512 DriverDoorAjarRawValSts_8 0;
BA_ "GenSigTimeoutTime_HCP" SG_ 512 DriverDoorAjarRawValSts_8 0;
BA_ "GenSigTimeoutTime_BSM" SG_ 2654339184 DES_FD01_SGW 0;
BA_ "GenSigTimeoutTime_AGSM" SG_ 256 MessageCounter_BCM2 0;
BA_ "GenSigTimeoutTime_VDCM" SG_ 1153 SpSt_Pad1 0;
BA_ "GenSigTimeoutTime_ESL" SG_ 513 VehicleStandStillSts 0;
BA_ "GenSigTimeoutTime_RFHM" SG_ 513 VehicleStandStillSts 0;
BA_ "GenSigTimeoutTime_SGW" SG_ 513 VehicleStandStillSts 0;
BA_ "GenSigTimeoutTime_TCM" SG_ 513 VehicleStandStillSts 0;
BA_ "GenSigTimeoutTime_ADCAM" SG_ 513 EngSpdIntervReq 0;
BA_ "GenSigTimeoutTime_EVCU2" SG_ 513 EngSpdIntervReq 0;
BA_ "GenSigTimeoutTime_VDCM" SG_ 513 EngSpdIntervReq 0;
BA_ "GenSigTimeoutTime_AGSM" SG_ 513 EngSpdIntervReq 0;
BA_ "GenSigTimeoutTime_BCM" SG_ 513 EngSpdIntervReq 0;
BA_ "GenSigTimeoutTime_BSM" SG_ 513 EngSpdIntervReq 0;
BA_ "GenSigTimeoutTime_DTCM" SG_ 513 EngSpdIntervReq 0;
BA_ "GenSigTimeoutTime_ESL" SG_ 513 EngSpdIntervReq 0;
BA_ "GenSigTimeoutTime_IPC" SG_ 513 EngSpdIntervReq 0;
BA_ "GenSigTimeoutTime_RFHM" SG_ 513 EngSpdIntervReq 0;
BA_ "GenSigTimeoutTime_SGW" SG_ 513 EngSpdIntervReq 0;
BA_ "GenSigTimeoutTime_TCM" SG_ 513 EngSpdIntervReq 0;
BA_ "GenSigTimeoutTime_ADCAM" SG_ 513 BrkTrq 0;
BA_ "GenSigTimeoutTime_ADCAM" SG_ 513 BrkTrq_Driver 0;
BA_ "GenSigTimeoutTime_AGSM" SG_ 513 SelectSpdSts 0;
BA_ "GenSigTimeoutTime_ASBS" SG_ 513 SelectSpdSts 0;
BA_ "GenSigTimeoutTime_BCM" SG_ 513 SelectSpdSts 0;
BA_ "GenSigTimeoutTime_BSM" SG_ 513 SelectSpdSts 0;
BA_ "GenSigTimeoutTime_CADM" SG_ 513 SelectSpdSts 0;
BA_ "GenSigTimeoutTime_DMSM" SG_ 513 SelectSpdSts 0;
BA_ "GenSigTimeoutTime_DTCM" SG_ 513 SelectSpdSts 0;
BA_ "GenSigTimeoutTime_ELSDM" SG_ 513 SelectSpdSts 0;
BA_ "GenSigTimeoutTime_ESL" SG_ 513 SelectSpdSts 0;
BA_ "GenSigTimeoutTime_GNMM" SG_ 513 SelectSpdSts 0;
BA_ "GenSigTimeoutTime_HCP" SG_ 513 SelectSpdSts 0;
BA_ "GenSigTimeoutTime_RFHM" SG_ 513 SelectSpdSts 0;
BA_ "GenSigTimeoutTime_AGSM" SG_ 513 HILL_DES_STAT 0;
BA_ "GenSigTimeoutTime_ASBS" SG_ 513 HILL_DES_STAT 0;
BA_ "GenSigTimeoutTime_BSM" SG_ 513 HILL_DES_STAT 0;
BA_ "GenSigTimeoutTime_CADM" SG_ 513 HILL_DES_STAT 0;
BA_ "GenSigTimeoutTime_DMSM" SG_ 513 HILL_DES_STAT 0;
BA_ "GenSigTimeoutTime_DTCM" SG_ 513 HILL_DES_STAT 0;
BA_ "GenSigTimeoutTime_ELSDM" SG_ 513 HILL_DES_STAT 0;
BA_ "GenSigTimeoutTime_ESL" SG_ 513 HILL_DES_STAT 0;
BA_ "GenSigTimeoutTime_GNMM" SG_ 513 HILL_DES_STAT 0;
BA_ "GenSigTimeoutTime_HCP" SG_ 513 HILL_DES_STAT 0;
BA_ "GenSigTimeoutTime_RFHM" SG_ 513 HILL_DES_STAT 0;
BA_ "GenSigTimeoutTime_AGSM" SG_ 513 CRC_BRAKE1 0;
BA_ "GenSigTimeoutTime_ASBS" SG_ 513 CRC_BRAKE1 0;
BA_ "GenSigTimeoutTime_BSM" SG_ 513 CRC_BRAKE1 0;
BA_ "GenSigTimeoutTime_DMSM" SG_ 513 CRC_BRAKE1 0;
BA_ "GenSigTimeoutTime_ELSDM" SG_ 513 CRC_BRAKE1 0;
BA_ "GenSigTimeoutTime_ESL" SG_ 513 CRC_BRAKE1 0;
BA_ "GenSigTimeoutTime_GNMM" SG_ 513 CRC_BRAKE1 0;
BA_ "GenSigTimeoutTime_IPC" SG_ 513 CRC_BRAKE1 0;
BA_ "GenSigTimeoutTime_RFHM" SG_ 513 CRC_BRAKE1 0;
BA_ "GenSigTimeoutTime_SGW" SG_ 513 CRC_BRAKE1 0;
BA_ "GenSigTimeoutTime_AGSM" SG_ 513 MessageCounter_BRAKE1 0;
BA_ "GenSigTimeoutTime_ASBS" SG_ 513 MessageCounter_BRAKE1 0;
BA_ "GenSigTimeoutTime_BSM" SG_ 513 MessageCounter_BRAKE1 0;
BA_ "GenSigTimeoutTime_DMSM" SG_ 513 MessageCounter_BRAKE1 0;
BA_ "GenSigTimeoutTime_ELSDM" SG_ 513 MessageCounter_BRAKE1 0;
BA_ "GenSigTimeoutTime_ESL" SG_ 513 MessageCounter_BRAKE1 0;
BA_ "GenSigTimeoutTime_GNMM" SG_ 513 MessageCounter_BRAKE1 0;
BA_ "GenSigTimeoutTime_IPC" SG_ 513 MessageCounter_BRAKE1 0;
BA_ "GenSigTimeoutTime_RFHM" SG_ 513 MessageCounter_BRAKE1 0;
BA_ "GenSigTimeoutTime_SGW" SG_ 513 MessageCounter_BRAKE1 0;
BA_ "GenSigStartValue" SG_ 513 REF_VEH_SPEED 1023;
BA_ "GenSigTimeoutTime_AGSM" SG_ 513 REF_VEH_SPEED 0;
BA_ "GenSigTimeoutTime_ASBS" SG_ 513 REF_VEH_SPEED 0;
BA_ "GenSigTimeoutTime_BSM" SG_ 513 REF_VEH_SPEED 0;
BA_ "GenSigTimeoutTime_CADM" SG_ 513 REF_VEH_SPEED 0;
BA_ "GenSigTimeoutTime_DMSM" SG_ 513 REF_VEH_SPEED 0;
BA_ "GenSigTimeoutTime_ADCAM" SG_ 1153 CompressorACReqSts 0;
BA_ "GenSigTimeoutTime_VDCM" SG_ 1153 CompressorACReqSts 0;
BA_ "GenSigTimeoutTime_ASBS" SG_ 1153 CRC_BCM10 0;
BA_ "GenSigTimeoutTime_BCM" SG_ 1153 CRC_BCM10 0;
BA_ "GenSigTimeoutTime_DTCM" SG_ 1153 CRC_BCM10 0;
BA_ "GenSigTimeoutTime_ELSDM" SG_ 1153 CRC_BCM10 0;
BA_ "GenSigTimeoutTime_ESL" SG_ 1153 CRC_BCM10 0;
BA_ "GenSigTimeoutTime_IPC" SG_ 1153 CRC_BCM10 0;
BA_ "GenSigTimeoutTime_SGW" SG_ 1153 CRC_BCM10 0;
BA_ "GenSigTimeoutTime_ASBS" SG_ 1153 MessageCounter_BCM10 0;
BA_ "GenSigTimeoutTime_BCM" SG_ 1153 MessageCounter_BCM10 0;
BA_ "GenSigTimeoutTime_DTCM" SG_ 1153 MessageCounter_BCM10 0;
BA_ "GenSigTimeoutTime_ELSDM" SG_ 1153 MessageCounter_BCM10 0;
BA_ "GenSigTimeoutTime_ESL" SG_ 1153 MessageCounter_BCM10 0;
BA_ "GenSigTimeoutTime_IPC" SG_ 1153 MessageCounter_BCM10 0;
BA_ "GenSigTimeoutTime_SGW" SG_ 1153 MessageCounter_BCM10 0;
BA_ "GenSigSendType" SG_ 1153 SpSt_Pad1 3;
BA_ "GenSigTimeoutTime_AGSM" SG_ 1153 SpSt_Pad1 0;
BA_ "GenSigTimeoutTime_ASBS" SG_ 1153 SpSt_Pad1 0;
BA_ "GenSigTimeoutTime_BCM" SG_ 1153 SpSt_Pad1 0;
BA_ "GenSigTimeoutTime_BSM" SG_ 1153 SpSt_Pad1 0;
BA_ "GenSigTimeoutTime_CADM" SG_ 1153 SpSt_Pad1 0;
BA_ "GenSigTimeoutTime_DMSM" SG_ 1153 SpSt_Pad1 0;
BA_ "GenSigTimeoutTime_DTCM" SG_ 1153 SpSt_Pad1 0;
BA_ "GenSigTimeoutTime_ELSDM" SG_ 1153 SpSt_Pad1 0;
BA_ "GenSigTimeoutTime_ESL" SG_ 1153 SpSt_Pad1 0;
BA_ "GenSigTimeoutTime_GNMM" SG_ 1153 SpSt_Pad1 0;
BA_ "GenSigTimeoutTime_IPC" SG_ 1153 SpSt_Pad1 0;
BA_ "GenSigTimeoutTime_RFHM" SG_ 1153 SpSt_Pad1 0;
BA_ "GenSigTimeoutTime_TCM" SG_ 1153 SpSt_Pad1 0;
BA_ "GenSigSendType" SG_ 1153 CmdIgnSts 3;
BA_ "GenSigTimeoutTime_BCM" SG_ 1153 CmdIgnSts 0;
BA_ "GenSigSendType" SG_ 1153 CompressorACReqSts 3;
BA_ "GenSigTimeoutTime_AGSM" SG_ 1153 CompressorACReqSts 0;
BA_ "GenSigTimeoutTime_ASBS" SG_ 1153 CompressorACReqSts 0;
BA_ "GenSigTimeoutTime_BCM" SG_ 1153 CompressorACReqSts 0;
BA_ "GenSigTimeoutTime_BSM" SG_ 1153 CompressorACReqSts 0;
BA_ "GenSigTimeoutTime_CADM" SG_ 1153 CompressorACReqSts 0;
BA_ "GenSigTimeoutTime_DMSM" SG_ 1153 CompressorACReqSts 0;
BA_ "GenSigTimeoutTime_DTCM" SG_ 1153 CompressorACReqSts 0;
BA_ "GenSigTimeoutTime_ELSDM" SG_ 1153 CompressorACReqSts 0;
BA_ "GenSigTimeoutTime_ESL" SG_ 1153 CompressorACReqSts 0;
BA_ "GenSigTimeoutTime_GNMM" SG_ 1153 CompressorACReqSts 0;
BA_ "GenSigTimeoutTime_IPC" SG_ 1153 CompressorACReqSts 0;
BA_ "GenSigTimeoutTime_RFHM" SG_ 1153 CompressorACReqSts 0;
BA_ "GenSigTimeoutTime_SGW" SG_ 1153 CompressorACReqSts 0;
BA_ "GenSigTimeoutTime_TCM" SG_ 1153 CompressorACReqSts 0;
BA_ "GenSigTimeoutTime_ADCAM" SG_ 1430 AcOutputCurrentSts 0;
BA_ "GenSigTimeoutTime_EVCU2" SG_ 1430 AcOutputCurrentSts 0;
BA_ "GenSigTimeoutTime_VDCM" SG_ 1430 AcOutputCurrentSts 0;
BA_ "GenSigTimeoutTime_ADCAM" SG_ 1430 Parallel_Prk_Ast_Pad1 0;
BA_ "GenSigTimeoutTime_EVCU2" SG_ 1430 Parallel_Prk_Ast_Pad1 0;
BA_ "GenSigTimeoutTime_VDCM" SG_ 1430 Parallel_Prk_Ast_Pad1 0;
BA_ "GenSigSendType" SG_ 1430 StopStartClimateInfo 3;
BA_ "GenSigTimeoutTime_AGSM" SG_ 1430 StopStartClimateInfo 0;
BA_ "GenSigTimeoutTime_ASBS" SG_ 1430 StopStartClimateInfo 0;
BA_ "GenSigTimeoutTime_BCM" SG_ 1430 StopStartClimateInfo 0;
BA_ "GenSigTimeoutTime_BSM" SG_ 1430 StopStartClimateInfo 0;
BA_ "GenSigTimeoutTime_CADM" SG_ 1430 StopStartClimateInfo 0;
BA_ "GenSigTimeoutTime_DMSM" SG_ 1430 StopStartClimateInfo 0;
BA_ "GenSigTimeoutTime_DTCM" SG_ 1430 StopStartClimateInfo 0;
BA_ "GenSigTimeoutTime_ELSDM" SG_ 1430 StopStartClimateInfo 0;
BA_ "GenSigTimeoutTime_ESL" SG_ 1430 StopStartClimateInfo 0;
BA_ "GenSigTimeoutTime_GNMM" SG_ 1430 StopStartClimateInfo 0;
BA_ "GenSigTimeoutTime_HCP" SG_ 1430 StopStartClimateInfo 0;
BA_ "GenSigTimeoutTime_IPC" SG_ 1430 StopStartClimateInfo 0;
BA_ "GenSigTimeoutTime_RFHM" SG_ 1430 StopStartClimateInfo 0;
BA_ "GenSigTimeoutTime_TCM" SG_ 1430 StopStartClimateInfo 0;
BA_ "GenSigSendType" SG_ 1430 AcOutputCurrentSts 3;
BA_ "GenSigTimeoutTime_AGSM" SG_ 1430 AcOutputCurrentSts 0;
BA_ "GenSigTimeoutTime_ASBS" SG_ 1430 AcOutputCurrentSts 0;
BA_ "GenSigTimeoutTime_BCM" SG_ 1430 AcOutputCurrentSts 0;
BA_ "GenSigTimeoutTime_BSM" SG_ 1430 AcOutputCurrentSts 0;
BA_ "GenSigTimeoutTime_CADM" SG_ 1430 AcOutputCurrentSts 0;
BA_ "GenSigTimeoutTime_DMSM" SG_ 1430 AcOutputCurrentSts 0;
BA_ "GenSigTimeoutTime_DTCM" SG_ 1430 AcOutputCurrentSts 0;
BA_ "GenSigTimeoutTime_ELSDM" SG_ 1430 AcOutputCurrentSts 0;
BA_ "GenSigTimeoutTime_ESL" SG_ 1430 AcOutputCurrentSts 0;
BA_ "GenSigTimeoutTime_GNMM" SG_ 1430 AcOutputCurrentSts 0;
BA_ "GenSigTimeoutTime_HCP" SG_ 1430 AcOutputCurrentSts 0;
BA_ "GenSigTimeoutTime_IPC" SG_ 1430 AcOutputCurrentSts 0;
BA_ "GenSigTimeoutTime_RFHM" SG_ 1430 AcOutputCurrentSts 0;
BA_ "GenSigTimeoutTime_SGW" SG_ 1430 AcOutputCurrentSts 0;
BA_ "GenSigTimeoutTime_TCM" SG_ 1430 AcOutputCurrentSts 0;
BA_ "GenSigSendType" SG_ 1430 Parallel_Prk_Ast_Pad1 3;
BA_ "GenSigTimeoutTime_AGSM" SG_ 1430 Parallel_Prk_Ast_Pad1 0;
BA_ "GenSigTimeoutTime_ASBS" SG_ 1430 Parallel_Prk_Ast_Pad1 0;
BA_ "GenSigTimeoutTime_BCM" SG_ 1430 Parallel_Prk_Ast_Pad1 0;
BA_ "GenSigTimeoutTime_BSM" SG_ 1430 Parallel_Prk_Ast_Pad1 0;
BA_ "GenSigTimeoutTime_CADM" SG_ 1430 Parallel_Prk_Ast_Pad1 0;
BA_ "GenSigTimeoutTime_DMSM" SG_ 1430 Parallel_Prk_Ast_Pad1 0;
BA_ "GenSigTimeoutTime_DTCM" SG_ 1430 Parallel_Prk_Ast_Pad1 0;
BA_ "GenSigTimeoutTime_ELSDM" SG_ 1430 Parallel_Prk_Ast_Pad1 0;
BA_ "GenSigTimeoutTime_ESL" SG_ 1430 Parallel_Prk_Ast_Pad1 0;
BA_ "GenSigTimeoutTime_GNMM" SG_ 1430 Parallel_Prk_Ast_Pad1 0;
BA_ "GenSigTimeoutTime_HCP" SG_ 1430 Parallel_Prk_Ast_Pad1 0;
BA_ "GenSigTimeoutTime_IPC" SG_ 1430 Parallel_Prk_Ast_Pad1 0;
BA_ "GenSigTimeoutTime_RFHM" SG_ 1430 Parallel_Prk_Ast_Pad1 0;
BA_ "GenSigTimeoutTime_SGW" SG_ 1430 Parallel_Prk_Ast_Pad1 0;
BA_ "GenSigTimeoutTime_TCM" SG_ 1430 Parallel_Prk_Ast_Pad1 0;
BA_ "GenSigTimeoutTime_ADCAM" SG_ 1431 Launch_Hard_Btn 0;
BA_ "GenSigTimeoutTime_VDCM" SG_ 1431 Launch_Hard_Btn 0;
BA_ "GenSigTimeoutTime_AGSM" SG_ 1431 Launch_Hard_Btn 0;
BA_ "GenSigTimeoutTime_BCM" SG_ 1431 Launch_Hard_Btn 0;
BA_ "GenSigTimeoutTime_BSM" SG_ 1431 Launch_Hard_Btn 0;
BA_ "GenSigTimeoutTime_DTCM" SG_ 1431 Launch_Hard_Btn 0;
BA_ "GenSigTimeoutTime_ESL" SG_ 1431 Launch_Hard_Btn 0;
BA_ "GenSigTimeoutTime_IPC" SG_ 1431 Launch_Hard_Btn 0;
BA_ "GenSigTimeoutTime_RFHM" SG_ 1431 Launch_Hard_Btn 0;
BA_ "GenSigTimeoutTime_SGW" SG_ 1431 Launch_Hard_Btn 0;
BA_ "GenSigTimeoutTime_TCM" SG_ 1431 Launch_Hard_Btn 0;
BA_ "GenSigTimeoutTime_ADCAM" SG_ 1431 Right_Button_BCM 0;
BA_ "GenSigTimeoutTime_VDCM" SG_ 1431 Right_Button_BCM 0;
BA_ "GenSigSendType" SG_ 1431 Right_Button_BCM 3;
BA_ "GenSigTimeoutTime_AGSM" SG_ 1431 Right_Button_BCM 0;
BA_ "GenSigTimeoutTime_BCM" SG_ 1431 Right_Button_BCM 0;
BA_ "GenSigTimeoutTime_BSM" SG_ 1431 Right_Button_BCM 0;
BA_ "GenSigTimeoutTime_DTCM" SG_ 1431 Right_Button_BCM 0;
BA_ "GenSigTimeoutTime_ESL" SG_ 1431 Right_Button_BCM 0;
BA_ "GenSigTimeoutTime_IPC" SG_ 1431 Right_Button_BCM 0;
BA_ "GenSigTimeoutTime_RFHM" SG_ 1431 Right_Button_BCM 0;
BA_ "GenSigTimeoutTime_SGW" SG_ 1431 Right_Button_BCM 0;
BA_ "GenSigTimeoutTime_TCM" SG_ 1431 Right_Button_BCM 0;
BA_ "GenSigTimeoutTime_ADCAM" SG_ 1431 TerrainModeInterfaceButton_BCM 0;
BA_ "GenSigTimeoutTime_VDCM" SG_ 1431 TerrainModeInterfaceButton_BCM 0;
BA_ "GenSigSendType" SG_ 1431 TerrainModeInterfaceButton_BCM 3;
BA_ "GenSigTimeoutTime_AGSM" SG_ 1431 TerrainModeInterfaceButton_BCM 0;
BA_ "GenSigTimeoutTime_BCM" SG_ 1431 TerrainModeInterfaceButton_BCM 0;
BA_ "GenSigTimeoutTime_BSM" SG_ 1431 TerrainModeInterfaceButton_BCM 0;
BA_ "GenSigTimeoutTime_DTCM" SG_ 1431 TerrainModeInterfaceButton_BCM 0;
BA_ "GenSigTimeoutTime_ESL" SG_ 1431 TerrainModeInterfaceButton_BCM 0;
BA_ "GenSigTimeoutTime_IPC" SG_ 1431 TerrainModeInterfaceButton_BCM 0;
BA_ "GenSigTimeoutTime_RFHM" SG_ 1431 TerrainModeInterfaceButton_BCM 0;
BA_ "GenSigTimeoutTime_SGW" SG_ 1431 TerrainModeInterfaceButton_BCM 0;
BA_ "GenSigTimeoutTime_TCM" SG_ 1431 TerrainModeInterfaceButton_BCM 0;
BA_ "GenSigTimeoutTime_ADCAM" SG_ 1431 Left_Button_BCM 0;
BA_ "GenSigTimeoutTime_VDCM" SG_ 1431 Left_Button_BCM 0;
BA_ "GenSigSendType" SG_ 1431 Left_Button_BCM 3;
BA_ "GenSigTimeoutTime_AGSM" SG_ 1431 Left_Button_BCM 0;
BA_ "GenSigTimeoutTime_BCM" SG_ 1431 Left_Button_BCM 0;
BA_ "GenSigTimeoutTime_BSM" SG_ 1431 Left_Button_BCM 0;
BA_ "GenSigTimeoutTime_DTCM" SG_ 1431 Left_Button_BCM 0;
BA_ "GenSigTimeoutTime_ESL" SG_ 1431 Left_Button_BCM 0;
BA_ "GenSigTimeoutTime_IPC" SG_ 1431 Left_Button_BCM 0;
BA_ "GenSigTimeoutTime_RFHM" SG_ 1431 Left_Button_BCM 0;
BA_ "GenSigTimeoutTime_SGW" SG_ 1431 Left_Button_BCM 0;
BA_ "GenSigTimeoutTime_TCM" SG_ 1431 Left_Button_BCM 0;
BA_ "GenSigSendType" SG_ 1431 Sport_Request 3;
BA_ "GenSigTimeoutTime_AGSM" SG_ 1431 Sport_Request 0;
BA_ "GenSigTimeoutTime_ASBS" SG_ 1431 Sport_Request 0;
BA_ "GenSigTimeoutTime_BCM" SG_ 1431 Sport_Request 0;
BA_ "GenSigTimeoutTime_BSM" SG_ 1431 Sport_Request 0;
BA_ "GenSigTimeoutTime_CADM" SG_ 1431 Sport_Request 0;
BA_ "GenSigTimeoutTime_DMSM" SG_ 1431 Sport_Request 0;
BA_ "GenSigTimeoutTime_DTCM" SG_ 1431 Sport_Request 0;
BA_ "GenSigTimeoutTime_ELSDM" SG_ 1431 Sport_Request 0;
BA_ "GenSigTimeoutTime_ESL" SG_ 1431 Sport_Request 0;
BA_ "GenSigTimeoutTime_GNMM" SG_ 1431 Sport_Request 0;
BA_ "GenSigTimeoutTime_HCP" SG_ 1431 Sport_Request 0;
BA_ "GenSigTimeoutTime_IPC" SG_ 1431 Sport_Request 0;
BA_ "GenSigTimeoutTime_RFHM" SG_ 1431 Sport_Request 0;
BA_ "GenSigTimeoutTime_SGW" SG_ 1431 Sport_Request 0;
BA_ "GenSigTimeoutTime_TCM" SG_ 1431 Sport_Request 0;
BA_ "GenSigSendType" SG_ 1431 TerrainSwStat 3;
BA_ "GenSigTimeoutTime_AGSM" SG_ 1431 TerrainSwStat 0;
BA_ "GenSigTimeoutTime_ASBS" SG_ 1431 TerrainSwStat 0;
BA_ "GenSigTimeoutTime_BCM" SG_ 1431 TerrainSwStat 0;
BA_ "GenSigTimeoutTime_BSM" SG_ 1431 TerrainSwStat 0;
BA_ "GenSigTimeoutTime_CADM" SG_ 1431 TerrainSwStat 0;
BA_ "GenSigTimeoutTime_DMSM" SG_ 1431 TerrainSwStat 0;
BA_ "GenSigTimeoutTime_DTCM" SG_ 1431 TerrainSwStat 0;
BA_ "GenSigTimeoutTime_ELSDM" SG_ 1431 TerrainSwStat 0;
BA_ "GenSigTimeoutTime_ESL" SG_ 1431 TerrainSwStat 0;
BA_ "GenSigTimeoutTime_GNMM" SG_ 1431 TerrainSwStat 0;
BA_ "GenSigTimeoutTime_HCP" SG_ 1431 TerrainSwStat 0;
BA_ "GenSigTimeoutTime_IPC" SG_ 1431 TerrainSwStat 0;
BA_ "GenSigTimeoutTime_RFHM" SG_ 1431 TerrainSwStat 0;
BA_ "GenSigTimeoutTime_SGW" SG_ 1431 TerrainSwStat 0;
BA_ "GenSigTimeoutTime_TCM" SG_ 1431 TerrainSwStat 0;
BA_ "GenSigTimeoutTime_EVCU2" SG_ 159 CRC_BCM13 0;
BA_ "GenSigTimeoutTime_VDCM" SG_ 159 CRC_BCM13 0;
BA_ "GenSigTimeoutTime_EVCU2" SG_ 159 MessageCounter_BCM13 0;
BA_ "GenSigTimeoutTime_VDCM" SG_ 159 MessageCounter_BCM13 0;
BA_ "GenSigTimeoutTime_EVCU2" SG_ 159 AcceleratorSts 0;
BA_ "GenSigTimeoutTime_VDCM" SG_ 159 AcceleratorSts 0;
BA_ "GenSigTimeoutTime_ADCAM" SG_ 1465 RACE_CLDWN_ON_OFF_REQ 0;
BA_ "GenSigTimeoutTime_VDCM" SG_ 1465 RACE_CLDWN_ON_OFF_REQ 0;
BA_ "GenSigSendType" SG_ 1465 RACE_CLDWN_ON_OFF_REQ 3;
BA_ "GenSigTimeoutTime_AGSM" SG_ 1465 RACE_CLDWN_ON_OFF_REQ 0;
BA_ "GenSigTimeoutTime_BCM" SG_ 1465 RACE_CLDWN_ON_OFF_REQ 0;
BA_ "GenSigTimeoutTime_BSM" SG_ 1465 RACE_CLDWN_ON_OFF_REQ 0;
BA_ "GenSigTimeoutTime_DTCM" SG_ 1465 RACE_CLDWN_ON_OFF_REQ 0;
BA_ "GenSigTimeoutTime_ESL" SG_ 1465 RACE_CLDWN_ON_OFF_REQ 0;
BA_ "GenSigTimeoutTime_IPC" SG_ 1465 RACE_CLDWN_ON_OFF_REQ 0;
BA_ "GenSigTimeoutTime_RFHM" SG_ 1465 RACE_CLDWN_ON_OFF_REQ 0;
BA_ "GenSigTimeoutTime_SGW" SG_ 1465 RACE_CLDWN_ON_OFF_REQ 0;
BA_ "GenSigTimeoutTime_TCM" SG_ 1465 RACE_CLDWN_ON_OFF_REQ 0;
BA_ "GenSigTimeoutTime_ADCAM" SG_ 1465 PSI_Gr1_RPM_SET 0;
BA_ "GenSigTimeoutTime_EVCU2" SG_ 1465 PSI_Gr1_RPM_SET 0;
BA_ "GenSigTimeoutTime_VDCM" SG_ 1465 PSI_Gr1_RPM_SET 0;
BA_ "GenSigSendType" SG_ 1465 PSI_Gr1_RPM_SET 3;
BA_ "GenSigTimeoutTime_AGSM" SG_ 1465 PSI_Gr1_RPM_SET 0;
BA_ "GenSigTimeoutTime_BCM" SG_ 1465 PSI_Gr1_RPM_SET 0;
BA_ "GenSigTimeoutTime_BSM" SG_ 1465 PSI_Gr1_RPM_SET 0;
BA_ "GenSigTimeoutTime_DTCM" SG_ 1465 PSI_Gr1_RPM_SET 0;
BA_ "GenSigTimeoutTime_ESL" SG_ 1465 PSI_Gr1_RPM_SET 0;
BA_ "GenSigTimeoutTime_IPC" SG_ 1465 PSI_Gr1_RPM_SET 0;
BA_ "GenSigTimeoutTime_RFHM" SG_ 1465 PSI_Gr1_RPM_SET 0;
BA_ "GenSigTimeoutTime_SGW" SG_ 1465 PSI_Gr1_RPM_SET 0;
BA_ "GenSigTimeoutTime_TCM" SG_ 1465 PSI_Gr1_RPM_SET 0;
BA_ "GenSigTimeoutTime_ADCAM" SG_ 1465 PSI_Gr2_RPM_SET 0;
BA_ "GenSigTimeoutTime_EVCU2" SG_ 1465 PSI_Gr2_RPM_SET 0;
BA_ "GenSigTimeoutTime_VDCM" SG_ 1465 PSI_Gr2_RPM_SET 0;
BA_ "GenSigSendType" SG_ 1465 PSI_Gr2_RPM_SET 3;
BA_ "GenSigTimeoutTime_AGSM" SG_ 1465 PSI_Gr2_RPM_SET 0;
BA_ "GenSigTimeoutTime_BCM" SG_ 1465 PSI_Gr2_RPM_SET 0;
BA_ "GenSigTimeoutTime_BSM" SG_ 1465 PSI_Gr2_RPM_SET 0;
BA_ "GenSigTimeoutTime_DTCM" SG_ 1465 PSI_Gr2_RPM_SET 0;
BA_ "GenSigTimeoutTime_ESL" SG_ 1465 PSI_Gr2_RPM_SET 0;
BA_ "GenSigTimeoutTime_IPC" SG_ 1465 PSI_Gr2_RPM_SET 0;
BA_ "GenSigTimeoutTime_RFHM" SG_ 1465 PSI_Gr2_RPM_SET 0;
BA_ "GenSigTimeoutTime_SGW" SG_ 1465 PSI_Gr2_RPM_SET 0;
BA_ "GenSigTimeoutTime_TCM" SG_ 1465 PSI_Gr2_RPM_SET 0;
BA_ "GenSigTimeoutTime_ADCAM" SG_ 1465 PSI_Gr3_RPM_SET 0;
BA_ "GenSigTimeoutTime_EVCU2" SG_ 1465 PSI_Gr3_RPM_SET 0;
BA_ "GenSigTimeoutTime_VDCM" SG_ 1465 PSI_Gr3_RPM_SET 0;
BA_ "GenSigSendType" SG_ 1465 PSI_Gr3_RPM_SET 3;
BA_ "GenSigTimeoutTime_AGSM" SG_ 1465 PSI_Gr3_RPM_SET 0;
BA_ "GenSigTimeoutTime_BCM" SG_ 1465 PSI_Gr3_RPM_SET 0;
BA_ "GenSigTimeoutTime_BSM" SG_ 1465 PSI_Gr3_RPM_SET 0;
BA_ "GenSigTimeoutTime_DTCM" SG_ 1465 PSI_Gr3_RPM_SET 0;
BA_ "GenSigTimeoutTime_ESL" SG_ 1465 PSI_Gr3_RPM_SET 0;
BA_ "GenSigTimeoutTime_IPC" SG_ 1465 PSI_Gr3_RPM_SET 0;
BA_ "GenSigTimeoutTime_RFHM" SG_ 1465 PSI_Gr3_RPM_SET 0;
BA_ "GenSigTimeoutTime_SGW" SG_ 1465 PSI_Gr3_RPM_SET 0;
BA_ "GenSigTimeoutTime_TCM" SG_ 1465 PSI_Gr3_RPM_SET 0;
BA_ "GenSigTimeoutTime_ADCAM" SG_ 1465 PSI_Gr4_RPM_SET 0;
BA_ "GenSigTimeoutTime_EVCU2" SG_ 1465 PSI_Gr4_RPM_SET 0;
BA_ "GenSigTimeoutTime_VDCM" SG_ 1465 PSI_Gr4_RPM_SET 0;
BA_ "GenSigSendType" SG_ 1465 PSI_Gr4_RPM_SET 3;
BA_ "GenSigTimeoutTime_AGSM" SG_ 1465 PSI_Gr4_RPM_SET 0;
BA_ "GenSigTimeoutTime_BCM" SG_ 1465 PSI_Gr4_RPM_SET 0;
BA_ "GenSigTimeoutTime_BSM" SG_ 1465 PSI_Gr4_RPM_SET 0;
BA_ "GenSigTimeoutTime_DTCM" SG_ 1465 PSI_Gr4_RPM_SET 0;
BA_ "GenSigTimeoutTime_ESL" SG_ 1465 PSI_Gr4_RPM_SET 0;
BA_ "GenSigTimeoutTime_IPC" SG_ 1465 PSI_Gr4_RPM_SET 0;
BA_ "GenSigTimeoutTime_RFHM" SG_ 1465 PSI_Gr4_RPM_SET 0;
BA_ "GenSigTimeoutTime_SGW" SG_ 1465 PSI_Gr4_RPM_SET 0;
BA_ "GenSigTimeoutTime_TCM" SG_ 1465 PSI_Gr4_RPM_SET 0;
BA_ "GenSigTimeoutTime_ADCAM" SG_ 1465 PSI_Gr5_RPM_SET 0;
BA_ "GenSigTimeoutTime_EVCU2" SG_ 1465 PSI_Gr5_RPM_SET 0;
BA_ "GenSigTimeoutTime_VDCM" SG_ 1465 PSI_Gr5_RPM_SET 0;
BA_ "GenSigSendType" SG_ 1465 PSI_Gr5_RPM_SET 3;
BA_ "GenSigTimeoutTime_AGSM" SG_ 1465 PSI_Gr5_RPM_SET 0;
BA_ "GenSigTimeoutTime_BCM" SG_ 1465 PSI_Gr5_RPM_SET 0;
BA_ "GenSigTimeoutTime_BSM" SG_ 1465 PSI_Gr5_RPM_SET 0;
BA_ "GenSigTimeoutTime_DTCM" SG_ 1465 PSI_Gr5_RPM_SET 0;
BA_ "GenSigTimeoutTime_ESL" SG_ 1465 PSI_Gr5_RPM_SET 0;
BA_ "GenSigTimeoutTime_IPC" SG_ 1465 PSI_Gr5_RPM_SET 0;
BA_ "GenSigTimeoutTime_RFHM" SG_ 1465 PSI_Gr5_RPM_SET 0;
BA_ "GenSigTimeoutTime_SGW" SG_ 1465 PSI_Gr5_RPM_SET 0;
BA_ "GenSigTimeoutTime_TCM" SG_ 1465 PSI_Gr5_RPM_SET 0;
BA_ "GenSigTimeoutTime_ADCAM" SG_ 1465 PSI_RPM_Reset 0;
BA_ "GenSigTimeoutTime_EVCU2" SG_ 1465 PSI_RPM_Reset 0;
BA_ "GenSigTimeoutTime_VDCM" SG_ 1465 PSI_RPM_Reset 0;
BA_ "GenSigSendType" SG_ 1465 PSI_RPM_Reset 3;
BA_ "GenSigTimeoutTime_AGSM" SG_ 1465 PSI_RPM_Reset 0;
BA_ "GenSigTimeoutTime_BCM" SG_ 1465 PSI_RPM_Reset 0;
BA_ "GenSigTimeoutTime_BSM" SG_ 1465 PSI_RPM_Reset 0;
BA_ "GenSigTimeoutTime_DTCM" SG_ 1465 PSI_RPM_Reset 0;
BA_ "GenSigTimeoutTime_ESL" SG_ 1465 PSI_RPM_Reset 0;
BA_ "GenSigTimeoutTime_IPC" SG_ 1465 PSI_RPM_Reset 0;
BA_ "GenSigTimeoutTime_RFHM" SG_ 1465 PSI_RPM_Reset 0;
BA_ "GenSigTimeoutTime_SGW" SG_ 1465 PSI_RPM_Reset 0;
BA_ "GenSigTimeoutTime_TCM" SG_ 1465 PSI_RPM_Reset 0;
BA_ "GenSigTimeoutTime_ADCAM" SG_ 1465 PSI_Rq 0;
BA_ "GenSigTimeoutTime_EVCU2" SG_ 1465 PSI_Rq 0;
BA_ "GenSigTimeoutTime_VDCM" SG_ 1465 PSI_Rq 0;
BA_ "GenSigSendType" SG_ 1465 PSI_Rq 3;
BA_ "GenSigTimeoutTime_AGSM" SG_ 1465 PSI_Rq 0;
BA_ "GenSigTimeoutTime_BCM" SG_ 1465 PSI_Rq 0;
BA_ "GenSigTimeoutTime_BSM" SG_ 1465 PSI_Rq 0;
BA_ "GenSigTimeoutTime_DTCM" SG_ 1465 PSI_Rq 0;
BA_ "GenSigTimeoutTime_ESL" SG_ 1465 PSI_Rq 0;
BA_ "GenSigTimeoutTime_IPC" SG_ 1465 PSI_Rq 0;
BA_ "GenSigTimeoutTime_RFHM" SG_ 1465 PSI_Rq 0;
BA_ "GenSigTimeoutTime_SGW" SG_ 1465 PSI_Rq 0;
BA_ "GenSigTimeoutTime_TCM" SG_ 1465 PSI_Rq 0;
BA_ "GenSigTimeoutTime_ADCAM" SG_ 1465 Trns_DrvMdReq 0;
BA_ "GenSigTimeoutTime_VDCM" SG_ 1465 Trns_DrvMdReq 0;
BA_ "GenSigSendType" SG_ 1465 Trns_DrvMdReq 3;
BA_ "GenSigTimeoutTime_AGSM" SG_ 1465 Trns_DrvMdReq 0;
BA_ "GenSigTimeoutTime_BCM" SG_ 1465 Trns_DrvMdReq 0;
BA_ "GenSigTimeoutTime_BSM" SG_ 1465 Trns_DrvMdReq 0;
BA_ "GenSigTimeoutTime_DTCM" SG_ 1465 Trns_DrvMdReq 0;
BA_ "GenSigTimeoutTime_ESL" SG_ 1465 Trns_DrvMdReq 0;
BA_ "GenSigTimeoutTime_IPC" SG_ 1465 Trns_DrvMdReq 0;
BA_ "GenSigTimeoutTime_RFHM" SG_ 1465 Trns_DrvMdReq 0;
BA_ "GenSigTimeoutTime_SGW" SG_ 1465 Trns_DrvMdReq 0;
BA_ "GenSigTimeoutTime_TCM" SG_ 1465 Trns_DrvMdReq 0;
BA_ "GenSigTimeoutTime_VDCM" SG_ 736 Command_15Sts 0;
BA_ "GenSigSendType" SG_ 736 Command_15Sts 3;
BA_ "GenSigTimeoutTime_AGSM" SG_ 736 Command_15Sts 0;
BA_ "GenSigTimeoutTime_BCM" SG_ 736 Command_15Sts 0;
BA_ "GenSigTimeoutTime_DTCM" SG_ 736 Command_15Sts 0;
BA_ "GenSigTimeoutTime_ESL" SG_ 736 Command_15Sts 0;
BA_ "GenSigTimeoutTime_RFHM" SG_ 736 Command_15Sts 0;
BA_ "GenSigTimeoutTime_TCM" SG_ 736 Command_15Sts 0;
BA_ "GenSigTimeoutTime_IPC" SG_ 512 DriverDoorAjarRawValSts_8 0;
BA_ "GenSigTimeoutTime_RFHM" SG_ 512 DriverDoorAjarRawValSts_8 0;
BA_ "GenSigTimeoutTime_SGW" SG_ 512 DriverDoorAjarRawValSts_8 0;
BA_ "GenSigTimeoutTime_AGSM" SG_ 512 DriverDoor2AjarXtionSts 0;
BA_ "GenSigTimeoutTime_ASBS" SG_ 512 DriverDoor2AjarXtionSts 0;
BA_ "GenSigTimeoutTime_BCM" SG_ 512 DriverDoor2AjarXtionSts 0;
BA_ "GenSigTimeoutTime_BSM" SG_ 512 DriverDoor2AjarXtionSts 0;
BA_ "GenSigTimeoutTime_CADM" SG_ 512 DriverDoor2AjarXtionSts 0;
BA_ "GenSigTimeoutTime_DMSM" SG_ 512 DriverDoor2AjarXtionSts 0;
BA_ "GenSigTimeoutTime_DTCM" SG_ 512 DriverDoor2AjarXtionSts 0;
BA_ "GenSigTimeoutTime_ELSDM" SG_ 512 DriverDoor2AjarXtionSts 0;
BA_ "GenSigTimeoutTime_ESL" SG_ 512 DriverDoor2AjarXtionSts 0;
BA_ "GenSigTimeoutTime_GNMM" SG_ 512 DriverDoor2AjarXtionSts 0;
BA_ "GenSigTimeoutTime_HCP" SG_ 512 DriverDoor2AjarXtionSts 0;
BA_ "GenSigTimeoutTime_IPC" SG_ 512 DriverDoor2AjarXtionSts 0;
BA_ "GenSigTimeoutTime_RFHM" SG_ 512 DriverDoor2AjarXtionSts 0;
BA_ "GenSigTimeoutTime_SGW" SG_ 512 DriverDoor2AjarXtionSts 0;
BA_ "GenSigTimeoutTime_TCM" SG_ 512 DriverDoor2AjarXtionSts 0;
BA_ "GenSigTimeoutTime_AGSM" SG_ 512 DriverDoorAjarXtionSts 0;
BA_ "GenSigTimeoutTime_ASBS" SG_ 512 DriverDoorAjarXtionSts 0;
BA_ "GenSigTimeoutTime_BCM" SG_ 512 DriverDoorAjarXtionSts 0;
BA_ "GenSigTimeoutTime_BSM" SG_ 512 DriverDoorAjarXtionSts 0;
BA_ "GenSigTimeoutTime_CADM" SG_ 512 DriverDoorAjarXtionSts 0;
BA_ "GenSigTimeoutTime_DMSM" SG_ 512 DriverDoorAjarXtionSts 0;
BA_ "GenSigTimeoutTime_DTCM" SG_ 512 DriverDoorAjarXtionSts 0;
BA_ "GenSigTimeoutTime_ELSDM" SG_ 512 DriverDoorAjarXtionSts 0;
BA_ "GenSigTimeoutTime_ESL" SG_ 512 DriverDoorAjarXtionSts 0;
BA_ "GenSigTimeoutTime_GNMM" SG_ 512 DriverDoorAjarXtionSts 0;
BA_ "GenSigTimeoutTime_HCP" SG_ 512 DriverDoorAjarXtionSts 0;
BA_ "GenSigTimeoutTime_IPC" SG_ 512 DriverDoorAjarXtionSts 0;
BA_ "GenSigTimeoutTime_RFHM" SG_ 512 DriverDoorAjarXtionSts 0;
BA_ "GenSigTimeoutTime_SGW" SG_ 512 DriverDoorAjarXtionSts 0;
BA_ "GenSigTimeoutTime_TCM" SG_ 512 DriverDoorAjarXtionSts 0;
BA_ "GenSigTimeoutTime_AGSM" SG_ 512 FuelDrRelSwRawSt 0;
BA_ "GenSigTimeoutTime_ASBS" SG_ 512 FuelDrRelSwRawSt 0;
BA_ "GenSigTimeoutTime_BCM" SG_ 512 FuelDrRelSwRawSt 0;
BA_ "GenSigTimeoutTime_BSM" SG_ 512 FuelDrRelSwRawSt 0;
BA_ "GenSigTimeoutTime_CADM" SG_ 512 FuelDrRelSwRawSt 0;
BA_ "GenSigTimeoutTime_DMSM" SG_ 512 FuelDrRelSwRawSt 0;
BA_ "GenSigTimeoutTime_DTCM" SG_ 512 FuelDrRelSwRawSt 0;
BA_ "GenSigTimeoutTime_ELSDM" SG_ 512 FuelDrRelSwRawSt 0;
BA_ "GenSigTimeoutTime_ESL" SG_ 512 FuelDrRelSwRawSt 0;
BA_ "GenSigTimeoutTime_GNMM" SG_ 512 FuelDrRelSwRawSt 0;
BA_ "GenSigTimeoutTime_HCP" SG_ 512 FuelDrRelSwRawSt 0;
BA_ "GenSigTimeoutTime_IPC" SG_ 512 FuelDrRelSwRawSt 0;
BA_ "GenSigTimeoutTime_RFHM" SG_ 512 FuelDrRelSwRawSt 0;
BA_ "GenSigTimeoutTime_SGW" SG_ 512 FuelDrRelSwRawSt 0;
BA_ "GenSigTimeoutTime_TCM" SG_ 512 FuelDrRelSwRawSt 0;
BA_ "GenSigTimeoutTime_AGSM" SG_ 512 LeakCheckTimerExpired 0;
BA_ "GenSigTimeoutTime_ASBS" SG_ 512 LeakCheckTimerExpired 0;
BA_ "GenSigTimeoutTime_BCM" SG_ 512 LeakCheckTimerExpired 0;
BA_ "GenSigTimeoutTime_BSM" SG_ 512 LeakCheckTimerExpired 0;
BA_ "GenSigTimeoutTime_CADM" SG_ 512 LeakCheckTimerExpired 0;
BA_ "GenSigTimeoutTime_DMSM" SG_ 512 LeakCheckTimerExpired 0;
BA_ "GenSigTimeoutTime_DTCM" SG_ 512 LeakCheckTimerExpired 0;
BA_ "GenSigTimeoutTime_ELSDM" SG_ 512 LeakCheckTimerExpired 0;
BA_ "GenSigTimeoutTime_ESL" SG_ 512 LeakCheckTimerExpired 0;
BA_ "GenSigTimeoutTime_GNMM" SG_ 512 LeakCheckTimerExpired 0;
BA_ "GenSigTimeoutTime_HCP" SG_ 512 LeakCheckTimerExpired 0;
BA_ "GenSigTimeoutTime_IPC" SG_ 512 LeakCheckTimerExpired 0;
BA_ "GenSigTimeoutTime_RFHM" SG_ 512 LeakCheckTimerExpired 0;
BA_ "GenSigTimeoutTime_SGW" SG_ 512 LeakCheckTimerExpired 0;
BA_ "GenSigTimeoutTime_TCM" SG_ 512 LeakCheckTimerExpired 0;
BA_ "GenSigTimeoutTime_AGSM" SG_ 512 CRC_BCM18 0;
BA_ "GenSigTimeoutTime_ASBS" SG_ 512 CRC_BCM18 0;
BA_ "GenSigTimeoutTime_BCM" SG_ 512 CRC_BCM18 0;
BA_ "GenSigTimeoutTime_CADM" SG_ 512 CRC_BCM18 0;
BA_ "GenSigTimeoutTime_DMSM" SG_ 512 CRC_BCM18 0;
BA_ "GenSigTimeoutTime_DTCM" SG_ 512 CRC_BCM18 0;
BA_ "GenSigTimeoutTime_ELSDM" SG_ 512 CRC_BCM18 0;
BA_ "GenSigTimeoutTime_ESL" SG_ 512 CRC_BCM18 0;
BA_ "GenSigTimeoutTime_GNMM" SG_ 512 CRC_BCM18 0;
BA_ "GenSigTimeoutTime_IPC" SG_ 512 CRC_BCM18 0;
BA_ "GenSigTimeoutTime_RFHM" SG_ 512 CRC_BCM18 0;
BA_ "GenSigTimeoutTime_SGW" SG_ 512 CRC_BCM18 0;
BA_ "GenSigTimeoutTime_AGSM" SG_ 512 MessageCounter_BCM18 0;
BA_ "GenSigTimeoutTime_ASBS" SG_ 512 MessageCounter_BCM18 0;
BA_ "GenSigTimeoutTime_BCM" SG_ 512 MessageCounter_BCM18 0;
BA_ "GenSigTimeoutTime_CADM" SG_ 512 MessageCounter_BCM18 0;
BA_ "GenSigTimeoutTime_DMSM" SG_ 512 MessageCounter_BCM18 0;
BA_ "GenSigTimeoutTime_DTCM" SG_ 512 MessageCounter_BCM18 0;
BA_ "GenSigTimeoutTime_ELSDM" SG_ 512 MessageCounter_BCM18 0;
BA_ "GenSigTimeoutTime_ESL" SG_ 512 MessageCounter_BCM18 0;
BA_ "GenSigTimeoutTime_GNMM" SG_ 512 MessageCounter_BCM18 0;
BA_ "GenSigTimeoutTime_IPC" SG_ 512 MessageCounter_BCM18 0;
BA_ "GenSigTimeoutTime_RFHM" SG_ 512 MessageCounter_BCM18 0;
BA_ "GenSigTimeoutTime_SGW" SG_ 512 MessageCounter_BCM18 0;
BA_ "GenSigTimeoutTime_VDCM" SG_ 256 CRC_BCM2 0;
BA_ "GenSigTimeoutTime_VDCM" SG_ 256 MessageCounter_BCM2 0;
BA_ "GenSigTimeoutTime_ADCAM" SG_ 256 RemStActvSts_R 0;
BA_ "GenSigTimeoutTime_VDCM" SG_ 256 RemStActvSts_R 0;
BA_ "GenSigTimeoutTime_ADCAM" SG_ 256 EngineOffRequest 0;
BA_ "GenSigTimeoutTime_EVCU2" SG_ 256 EngineOffRequest 0;
BA_ "GenSigTimeoutTime_VDCM" SG_ 256 EngineOffRequest 0;
BA_ "GenSigTimeoutTime_DTCM" SG_ 256 OperationalModeSts 0;
BA_ "GenSigTimeoutTime_ADCAM" SG_ 256 StartRelayBCMFault 0;
BA_ "GenSigTimeoutTime_EVCU2" SG_ 256 StartRelayBCMFault 0;
BA_ "GenSigTimeoutTime_VDCM" SG_ 256 StartRelayBCMFault 0;
BA_ "GenSigTimeoutTime_ADCAM" SG_ 256 StartRelayBCMSts 0;
BA_ "GenSigTimeoutTime_EVCU2" SG_ 256 StartRelayBCMSts 0;
BA_ "GenSigTimeoutTime_VDCM" SG_ 256 StartRelayBCMSts 0;
BA_ "GenSigTimeoutTime_AGSM" SG_ 256 CRC_BCM2 0;
BA_ "GenSigTimeoutTime_ASBS" SG_ 256 CRC_BCM2 0;
BA_ "GenSigTimeoutTime_BCM" SG_ 256 CRC_BCM2 0;
BA_ "GenSigTimeoutTime_DTCM" SG_ 256 CRC_BCM2 0;
BA_ "GenSigTimeoutTime_ELSDM" SG_ 256 CRC_BCM2 0;
BA_ "GenSigTimeoutTime_ESL" SG_ 256 CRC_BCM2 0;
BA_ "GenSigTimeoutTime_GNMM" SG_ 256 CRC_BCM2 0;
BA_ "GenSigTimeoutTime_IPC" SG_ 256 CRC_BCM2 0;
BA_ "GenSigTimeoutTime_RFHM" SG_ 256 CRC_BCM2 0;
BA_ "GenSigTimeoutTime_SGW" SG_ 256 CRC_BCM2 0;
BA_ "GenSigTimeoutTime_DTCM" SG_ 513 REF_VEH_SPEED 0;
BA_ "GenSigTimeoutTime_ELSDM" SG_ 513 REF_VEH_SPEED 0;
BA_ "GenSigTimeoutTime_ESL" SG_ 513 REF_VEH_SPEED 0;
BA_ "GenSigTimeoutTime_GNMM" SG_ 513 REF_VEH_SPEED 0;
BA_ "GenSigTimeoutTime_HCP" SG_ 513 REF_VEH_SPEED 0;
BA_ "GenSigTimeoutTime_RFHM" SG_ 513 REF_VEH_SPEED 0;
BA_ "GenSigTimeoutTime_SGW" SG_ 513 REF_VEH_SPEED 0;
BA_ "GenSigTimeoutTime_TCM" SG_ 513 REF_VEH_SPEED 0;
BA_ "GenSigStartValue" SG_ 513 BrkTrq 32767;
BA_ "GenSigTimeoutTime_AGSM" SG_ 513 BrkTrq 0;
BA_ "GenSigTimeoutTime_ASBS" SG_ 513 BrkTrq 0;
BA_ "GenSigTimeoutTime_BSM" SG_ 513 BrkTrq 0;
BA_ "GenSigTimeoutTime_CADM" SG_ 513 BrkTrq 0;
BA_ "GenSigTimeoutTime_DMSM" SG_ 513 BrkTrq 0;
BA_ "GenSigTimeoutTime_ELSDM" SG_ 513 BrkTrq 0;
BA_ "GenSigTimeoutTime_ESL" SG_ 513 BrkTrq 0;
BA_ "GenSigTimeoutTime_GNMM" SG_ 513 BrkTrq 0;
BA_ "GenSigTimeoutTime_HCP" SG_ 513 BrkTrq 0;
BA_ "GenSigTimeoutTime_IPC" SG_ 513 BrkTrq 0;
BA_ "GenSigTimeoutTime_RFHM" SG_ 513 BrkTrq 0;
BA_ "GenSigStartValue" SG_ 513 BrkTrq_Driver 32767;
BA_ "GenSigTimeoutTime_AGSM" SG_ 513 BrkTrq_Driver 0;
BA_ "GenSigTimeoutTime_ASBS" SG_ 513 BrkTrq_Driver 0;
BA_ "GenSigTimeoutTime_BSM" SG_ 513 BrkTrq_Driver 0;
BA_ "GenSigTimeoutTime_CADM" SG_ 513 BrkTrq_Driver 0;
BA_ "GenSigTimeoutTime_DMSM" SG_ 513 BrkTrq_Driver 0;
BA_ "GenSigTimeoutTime_ELSDM" SG_ 513 BrkTrq_Driver 0;
BA_ "GenSigTimeoutTime_ESL" SG_ 513 BrkTrq_Driver 0;
BA_ "GenSigTimeoutTime_GNMM" SG_ 513 BrkTrq_Driver 0;
BA_ "GenSigTimeoutTime_HCP" SG_ 513 BrkTrq_Driver 0;
BA_ "GenSigTimeoutTime_IPC" SG_ 513 BrkTrq_Driver 0;
BA_ "GenSigTimeoutTime_RFHM" SG_ 513 BrkTrq_Driver 0;
BA_ "GenSigTimeoutTime_SGW" SG_ 513 BrkTrq_Driver 0;
BA_ "GenSigTimeoutTime_CADM" SG_ 2654339184 DES_FD01_SGW 0;
BA_ "GenSigTimeoutTime_DMSM" SG_ 2654339184 DES_FD01_SGW 0;
BA_ "GenSigTimeoutTime_DTCM" SG_ 2654339184 DES_FD01_SGW 0;
BA_ "GenSigTimeoutTime_ELSDM" SG_ 2654339184 DES_FD01_SGW 0;
BA_ "GenSigTimeoutTime_ESL" SG_ 2654339184 DES_FD01_SGW 0;
BA_ "GenSigTimeoutTime_GNMM" SG_ 2654339184 DES_FD01_SGW 0;
BA_ "GenSigTimeoutTime_HCP" SG_ 2654339184 DES_FD01_SGW 0;
BA_ "GenSigTimeoutTime_IPC" SG_ 2654339184 DES_FD01_SGW 0;
BA_ "GenSigTimeoutTime_RFHM" SG_ 2654339184 DES_FD01_SGW 0;
BA_ "GenSigTimeoutTime_SGW" SG_ 2654339184 DES_FD01_SGW 0;
BA_ "GenSigTimeoutTime_TCM" SG_ 2654339184 DES_FD01_SGW 0;
BA_ "GenSigTimeoutTime_AGSM" SG_ 2654339184 DES_FD02_SGW 0;
BA_ "GenSigTimeoutTime_ASBS" SG_ 2654339184 DES_FD02_SGW 0;
BA_ "GenSigTimeoutTime_BCM" SG_ 2654339184 DES_FD02_SGW 0;
BA_ "GenSigTimeoutTime_BSM" SG_ 2654339184 DES_FD02_SGW 0;
BA_ "GenSigTimeoutTime_CADM" SG_ 2654339184 DES_FD02_SGW 0;
BA_ "GenSigTimeoutTime_DMSM" SG_ 2654339184 DES_FD02_SGW 0;
BA_ "GenSigTimeoutTime_DTCM" SG_ 2654339184 DES_FD02_SGW 0;
BA_ "GenSigTimeoutTime_ELSDM" SG_ 2654339184 DES_FD02_SGW 0;
BA_ "GenSigTimeoutTime_ESL" SG_ 2654339184 DES_FD02_SGW 0;
BA_ "GenSigTimeoutTime_GNMM" SG_ 2654339184 DES_FD02_SGW 0;
BA_ "GenSigTimeoutTime_HCP" SG_ 2654339184 DES_FD02_SGW 0;
BA_ "GenSigTimeoutTime_IPC" SG_ 2654339184 DES_FD02_SGW 0;
BA_ "GenSigTimeoutTime_RFHM" SG_ 2654339184 DES_FD02_SGW 0;
BA_ "GenSigTimeoutTime_SGW" SG_ 2654339184 DES_FD02_SGW 0;
BA_ "GenSigTimeoutTime_TCM" SG_ 2654339184 DES_FD02_SGW 0;
BA_ "GenSigTimeoutTime_AGSM" SG_ 2654339184 DES_FD03_SGW 0;
BA_ "GenSigTimeoutTime_ASBS" SG_ 2654339184 DES_FD03_SGW 0;
BA_ "GenSigTimeoutTime_BCM" SG_ 2654339184 DES_FD03_SGW 0;
BA_ "GenSigTimeoutTime_BSM" SG_ 2654339184 DES_FD03_SGW 0;
BA_ "GenSigTimeoutTime_CADM" SG_ 2654339184 DES_FD03_SGW 0;
BA_ "GenSigTimeoutTime_DMSM" SG_ 2654339184 DES_FD03_SGW 0;
BA_ "GenSigTimeoutTime_DTCM" SG_ 2654339184 DES_FD03_SGW 0;
BA_ "GenSigTimeoutTime_ELSDM" SG_ 2654339184 DES_FD03_SGW 0;
BA_ "GenSigTimeoutTime_ESL" SG_ 2654339184 DES_FD03_SGW 0;
BA_ "GenSigTimeoutTime_GNMM" SG_ 2654339184 DES_FD03_SGW 0;
BA_ "GenSigTimeoutTime_HCP" SG_ 2654339184 DES_FD03_SGW 0;
BA_ "GenSigTimeoutTime_IPC" SG_ 2654339184 DES_FD03_SGW 0;
BA_ "GenSigTimeoutTime_RFHM" SG_ 2654339184 DES_FD03_SGW 0;
BA_ "GenSigTimeoutTime_SGW" SG_ 2654339184 DES_FD03_SGW 0;
BA_ "GenSigTimeoutTime_TCM" SG_ 2654339184 DES_FD03_SGW 0;
BA_ "GenSigTimeoutTime_AGSM" SG_ 2654339184 GenericFailSts_FD02_SGW 0;
BA_ "GenSigTimeoutTime_ASBS" SG_ 2654339184 GenericFailSts_FD02_SGW 0;
BA_ "GenSigTimeoutTime_BCM" SG_ 2654339184 GenericFailSts_FD02_SGW 0;
BA_ "GenSigTimeoutTime_BSM" SG_ 2654339184 GenericFailSts_FD02_SGW 0;
BA_ "GenSigTimeoutTime_CADM" SG_ 2654339184 GenericFailSts_FD02_SGW 0;
BA_ "GenSigTimeoutTime_DMSM" SG_ 2654339184 GenericFailSts_FD02_SGW 0;
BA_ "GenSigTimeoutTime_DTCM" SG_ 2654339184 GenericFailSts_FD02_SGW 0;
BA_ "GenSigTimeoutTime_ELSDM" SG_ 2654339184 GenericFailSts_FD02_SGW 0;
BA_ "GenSigTimeoutTime_ESL" SG_ 2654339184 GenericFailSts_FD02_SGW 0;
BA_ "GenSigTimeoutTime_GNMM" SG_ 2654339184 GenericFailSts_FD02_SGW 0;
BA_ "GenSigTimeoutTime_HCP" SG_ 2654339184 GenericFailSts_FD02_SGW 0;
BA_ "GenSigTimeoutTime_IPC" SG_ 2654339184 GenericFailSts_FD02_SGW 0;
BA_ "GenSigTimeoutTime_RFHM" SG_ 2654339184 GenericFailSts_FD02_SGW 0;
BA_ "GenSigTimeoutTime_SGW" SG_ 2654339184 GenericFailSts_FD02_SGW 0;
BA_ "GenSigTimeoutTime_TCM" SG_ 2654339184 GenericFailSts_FD02_SGW 0;
BA_ "GenSigTimeoutTime_AGSM" SG_ 2654339184 GenericFailSts_FD03_SGW 0;
BA_ "GenSigTimeoutTime_ASBS" SG_ 2654339184 GenericFailSts_FD03_SGW 0;
BA_ "GenSigTimeoutTime_BSM" SG_ 2654339184 GenericFailSts_FD03_SGW 0;
BA_ "GenSigTimeoutTime_CADM" SG_ 2654339184 GenericFailSts_FD03_SGW 0;
BA_ "GenSigTimeoutTime_DMSM" SG_ 2654339184 GenericFailSts_FD03_SGW 0;
BA_ "GenSigTimeoutTime_DTCM" SG_ 2654339184 GenericFailSts_FD03_SGW 0;
BA_ "GenSigTimeoutTime_ELSDM" SG_ 2654339184 GenericFailSts_FD03_SGW 0;
BA_ "GenSigTimeoutTime_ESL" SG_ 2654339184 GenericFailSts_FD03_SGW 0;
BA_ "GenSigTimeoutTime_GNMM" SG_ 2654339184 GenericFailSts_FD03_SGW 0;
BA_ "GenSigTimeoutTime_HCP" SG_ 2654339184 GenericFailSts_FD03_SGW 0;
BA_ "GenSigTimeoutTime_IPC" SG_ 2654339184 GenericFailSts_FD03_SGW 0;
BA_ "GenSigTimeoutTime_RFHM" SG_ 2654339184 GenericFailSts_FD03_SGW 0;
BA_ "GenSigTimeoutTime_SGW" SG_ 2654339184 GenericFailSts_FD03_SGW 0;
BA_ "GenSigTimeoutTime_TCM" SG_ 2654339184 GenericFailSts_FD03_SGW 0;
BA_ "GenSigTimeoutTime_AGSM" SG_ 2654339184 GenericFailSts_FD08_SGW 0;
BA_ "GenSigTimeoutTime_ASBS" SG_ 2654339184 GenericFailSts_FD08_SGW 0;
BA_ "GenSigTimeoutTime_BCM" SG_ 2654339184 GenericFailSts_FD08_SGW 0;
BA_ "GenSigTimeoutTime_BSM" SG_ 2654339184 GenericFailSts_FD08_SGW 0;
BA_ "GenSigTimeoutTime_CADM" SG_ 2654339184 GenericFailSts_FD08_SGW 0;
BA_ "GenSigTimeoutTime_DMSM" SG_ 2654339184 GenericFailSts_FD08_SGW 0;
BA_ "GenSigTimeoutTime_DTCM" SG_ 2654339184 GenericFailSts_FD08_SGW 0;
BA_ "GenSigTimeoutTime_ELSDM" SG_ 2654339184 GenericFailSts_FD08_SGW 0;
BA_ "GenSigTimeoutTime_ESL" SG_ 2654339184 GenericFailSts_FD08_SGW 0;
BA_ "GenSigTimeoutTime_GNMM" SG_ 2654339184 GenericFailSts_FD08_SGW 0;
BA_ "GenSigTimeoutTime_HCP" SG_ 2654339184 GenericFailSts_FD08_SGW 0;
BA_ "GenSigTimeoutTime_IPC" SG_ 2654339184 GenericFailSts_FD08_SGW 0;
BA_ "GenSigTimeoutTime_RFHM" SG_ 2654339184 GenericFailSts_FD08_SGW 0;
BA_ "GenSigTimeoutTime_SGW" SG_ 2654339184 GenericFailSts_FD08_SGW 0;
BA_ "GenSigTimeoutTime_TCM" SG_ 2654339184 GenericFailSts_FD08_SGW 0;
BA_ "GenSigTimeoutTime_AGSM" SG_ 2654339184 GenericFailSts_FD11_SGW 0;
BA_ "GenSigTimeoutTime_ASBS" SG_ 2654339184 GenericFailSts_FD11_SGW 0;
BA_ "GenSigTimeoutTime_BCM" SG_ 2654339184 GenericFailSts_FD11_SGW 0;
BA_ "GenSigTimeoutTime_BSM" SG_ 2654339184 GenericFailSts_FD11_SGW 0;
BA_ "GenSigTimeoutTime_CADM" SG_ 2654339184 GenericFailSts_FD11_SGW 0;
BA_ "GenSigTimeoutTime_DMSM" SG_ 2654339184 GenericFailSts_FD11_SGW 0;
BA_ "GenSigTimeoutTime_DTCM" SG_ 2654339184 GenericFailSts_FD11_SGW 0;
BA_ "GenSigTimeoutTime_ELSDM" SG_ 2654339184 GenericFailSts_FD11_SGW 0;
BA_ "GenSigTimeoutTime_ESL" SG_ 2654339184 GenericFailSts_FD11_SGW 0;
BA_ "GenSigTimeoutTime_GNMM" SG_ 2654339184 GenericFailSts_FD11_SGW 0;
BA_ "GenSigTimeoutTime_HCP" SG_ 2654339184 GenericFailSts_FD11_SGW 0;
BA_ "GenSigTimeoutTime_IPC" SG_ 2654339184 GenericFailSts_FD11_SGW 0;
BA_ "GenSigTimeoutTime_RFHM" SG_ 2654339184 GenericFailSts_FD11_SGW 0;
BA_ "GenSigTimeoutTime_SGW" SG_ 2654339184 GenericFailSts_FD11_SGW 0;
BA_ "GenSigTimeoutTime_TCM" SG_ 2654339184 GenericFailSts_FD11_SGW 0;
BA_ "GenSigTimeoutTime_AGSM" SG_ 2654339184 CurrentCanNMState_FD01_SGW 0;
BA_ "GenSigTimeoutTime_ASBS" SG_ 2654339184 CurrentCanNMState_FD01_SGW 0;
BA_ "GenSigTimeoutTime_BCM" SG_ 2654339184 CurrentCanNMState_FD01_SGW 0;
BA_ "GenSigTimeoutTime_BSM" SG_ 2654339184 CurrentCanNMState_FD01_SGW 0;
BA_ "GenSigTimeoutTime_CADM" SG_ 2654339184 CurrentCanNMState_FD01_SGW 0;
BA_ "GenSigTimeoutTime_DMSM" SG_ 2654339184 CurrentCanNMState_FD01_SGW 0;
BA_ "GenSigTimeoutTime_DTCM" SG_ 2654339184 CurrentCanNMState_FD01_SGW 0;
BA_ "GenSigTimeoutTime_ELSDM" SG_ 2654339184 CurrentCanNMState_FD01_SGW 0;
BA_ "GenSigTimeoutTime_ESL" SG_ 2654339184 CurrentCanNMState_FD01_SGW 0;
BA_ "GenSigTimeoutTime_GNMM" SG_ 2654339184 CurrentCanNMState_FD01_SGW 0;
BA_ "GenSigTimeoutTime_HCP" SG_ 2654339184 CurrentCanNMState_FD01_SGW 0;
BA_ "GenSigTimeoutTime_IPC" SG_ 2654339184 CurrentCanNMState_FD01_SGW 0;
BA_ "GenSigTimeoutTime_RFHM" SG_ 2654339184 CurrentCanNMState_FD01_SGW 0;
BA_ "GenSigTimeoutTime_SGW" SG_ 2654339184 CurrentCanNMState_FD01_SGW 0;
BA_ "GenSigTimeoutTime_TCM" SG_ 2654339184 CurrentCanNMState_FD01_SGW 0;
BA_ "GenSigTimeoutTime_AGSM" SG_ 2654339184 CurrentCanNMState_FD02_SGW 0;
BA_ "GenSigTimeoutTime_ASBS" SG_ 2654339184 CurrentCanNMState_FD02_SGW 0;
BA_ "GenSigTimeoutTime_BCM" SG_ 2654339184 CurrentCanNMState_FD02_SGW 0;
BA_ "GenSigTimeoutTime_BSM" SG_ 2654339184 CurrentCanNMState_FD02_SGW 0;
BA_ "GenSigTimeoutTime_CADM" SG_ 2654339184 CurrentCanNMState_FD02_SGW 0;
BA_ "GenSigTimeoutTime_DMSM" SG_ 2654339184 CurrentCanNMState_FD02_SGW 0;
BA_ "GenSigTimeoutTime_DTCM" SG_ 2654339184 CurrentCanNMState_FD02_SGW 0;
BA_ "GenSigTimeoutTime_ELSDM" SG_ 2654339184 CurrentCanNMState_FD02_SGW 0;
BA_ "GenSigTimeoutTime_ESL" SG_ 2654339184 CurrentCanNMState_FD02_SGW 0;
BA_ "GenSigTimeoutTime_GNMM" SG_ 2654339184 CurrentCanNMState_FD02_SGW 0;
BA_ "GenSigTimeoutTime_HCP" SG_ 2654339184 CurrentCanNMState_FD02_SGW 0;
BA_ "GenSigTimeoutTime_IPC" SG_ 2654339184 CurrentCanNMState_FD02_SGW 0;
BA_ "GenSigTimeoutTime_RFHM" SG_ 2654339184 CurrentCanNMState_FD02_SGW 0;
BA_ "GenSigTimeoutTime_SGW" SG_ 2654339184 CurrentCanNMState_FD02_SGW 0;
BA_ "GenSigTimeoutTime_TCM" SG_ 2654339184 CurrentCanNMState_FD02_SGW 0;
BA_ "GenSigTimeoutTime_AGSM" SG_ 2654339184 EOL_FD01_SGW 0;
BA_ "GenSigTimeoutTime_ASBS" SG_ 2654339184 EOL_FD01_SGW 0;
BA_ "GenSigTimeoutTime_BCM" SG_ 2654339184 EOL_FD01_SGW 0;
BA_ "GenSigTimeoutTime_BSM" SG_ 2654339184 EOL_FD01_SGW 0;
BA_ "GenSigTimeoutTime_CADM" SG_ 2654339184 EOL_FD01_SGW 0;
BA_ "GenSigTimeoutTime_DMSM" SG_ 2654339184 EOL_FD01_SGW 0;
BA_ "GenSigTimeoutTime_DTCM" SG_ 2654339184 EOL_FD01_SGW 0;
BA_ "GenSigTimeoutTime_ELSDM" SG_ 2654339184 EOL_FD01_SGW 0;
BA_ "GenSigTimeoutTime_ESL" SG_ 2654339184 EOL_FD01_SGW 0;
BA_ "GenSigTimeoutTime_GNMM" SG_ 2654339184 EOL_FD01_SGW 0;
BA_ "GenSigTimeoutTime_HCP" SG_ 2654339184 EOL_FD01_SGW 0;
BA_ "GenSigTimeoutTime_IPC" SG_ 2654339184 EOL_FD01_SGW 0;
BA_ "GenSigTimeoutTime_RFHM" SG_ 2654339184 EOL_FD01_SGW 0;
BA_ "GenSigTimeoutTime_SGW" SG_ 2654339184 EOL_FD01_SGW 0;
BA_ "GenSigTimeoutTime_TCM" SG_ 2654339184 EOL_FD01_SGW 0;
BA_ "GenSigTimeoutTime_AGSM" SG_ 2654339184 EOL_FD02_SGW 0;
BA_ "GenSigTimeoutTime_ASBS" SG_ 2654339184 EOL_FD02_SGW 0;
BA_ "GenSigTimeoutTime_BCM" SG_ 2654339184 EOL_FD02_SGW 0;
BA_ "GenSigTimeoutTime_BSM" SG_ 2654339184 EOL_FD02_SGW 0;
BA_ "GenSigTimeoutTime_CADM" SG_ 2654339184 EOL_FD02_SGW 0;
BA_ "GenSigTimeoutTime_DMSM" SG_ 2654339184 EOL_FD02_SGW 0;
BA_ "GenSigTimeoutTime_DTCM" SG_ 2654339184 EOL_FD02_SGW 0;
BA_ "GenSigTimeoutTime_ELSDM" SG_ 2654339184 EOL_FD02_SGW 0;
BA_ "GenSigTimeoutTime_ESL" SG_ 2654339184 EOL_FD02_SGW 0;
BA_ "GenSigTimeoutTime_GNMM" SG_ 2654339184 EOL_FD02_SGW 0;
BA_ "GenSigTimeoutTime_HCP" SG_ 2654339184 EOL_FD02_SGW 0;
BA_ "GenSigTimeoutTime_IPC" SG_ 2654339184 EOL_FD02_SGW 0;
BA_ "GenSigTimeoutTime_RFHM" SG_ 2654339184 EOL_FD02_SGW 0;
BA_ "GenSigTimeoutTime_SGW" SG_ 2654339184 EOL_FD02_SGW 0;
BA_ "GenSigTimeoutTime_TCM" SG_ 2654339184 EOL_FD02_SGW 0;
BA_ "GenSigTimeoutTime_AGSM" SG_ 2654339184 EOL_FD03_SGW 0;
BA_ "GenSigTimeoutTime_ASBS" SG_ 2654339184 EOL_FD03_SGW 0;
BA_ "GenSigTimeoutTime_BSM" SG_ 2654339184 EOL_FD03_SGW 0;
BA_ "GenSigTimeoutTime_CADM" SG_ 2654339184 EOL_FD03_SGW 0;
BA_ "GenSigTimeoutTime_DMSM" SG_ 2654339184 EOL_FD03_SGW 0;
BA_ "GenSigTimeoutTime_DTCM" SG_ 2654339184 EOL_FD03_SGW 0;
BA_ "GenSigTimeoutTime_ELSDM" SG_ 2654339184 EOL_FD03_SGW 0;
BA_ "GenSigTimeoutTime_ESL" SG_ 2654339184 EOL_FD03_SGW 0;
BA_ "GenSigTimeoutTime_GNMM" SG_ 2654339184 EOL_FD03_SGW 0;
BA_ "GenSigTimeoutTime_HCP" SG_ 2654339184 EOL_FD03_SGW 0;
BA_ "GenSigTimeoutTime_IPC" SG_ 2654339184 EOL_FD03_SGW 0;
BA_ "GenSigTimeoutTime_RFHM" SG_ 2654339184 EOL_FD03_SGW 0;
BA_ "GenSigTimeoutTime_SGW" SG_ 2654339184 EOL_FD03_SGW 0;
BA_ "GenSigTimeoutTime_TCM" SG_ 2654339184 EOL_FD03_SGW 0;
BA_ "GenSigTimeoutTime_AGSM" SG_ 2654339184 EOL_FD08_SGW 0;
BA_ "GenSigTimeoutTime_ASBS" SG_ 2654339184 EOL_FD08_SGW 0;
BA_ "GenSigTimeoutTime_BCM" SG_ 2654339184 EOL_FD08_SGW 0;
BA_ "GenSigTimeoutTime_BSM" SG_ 2654339184 EOL_FD08_SGW 0;
BA_ "GenSigTimeoutTime_CADM" SG_ 2654339184 EOL_FD08_SGW 0;
BA_ "GenSigTimeoutTime_DMSM" SG_ 2654339184 EOL_FD08_SGW 0;
BA_ "GenSigTimeoutTime_DTCM" SG_ 2654339184 EOL_FD08_SGW 0;
BA_ "GenSigTimeoutTime_ELSDM" SG_ 2654339184 EOL_FD08_SGW 0;
BA_ "GenSigTimeoutTime_ESL" SG_ 2654339184 EOL_FD08_SGW 0;
BA_ "GenSigTimeoutTime_GNMM" SG_ 2654339184 EOL_FD08_SGW 0;
BA_ "GenSigTimeoutTime_HCP" SG_ 2654339184 EOL_FD08_SGW 0;
BA_ "GenSigTimeoutTime_IPC" SG_ 2654339184 EOL_FD08_SGW 0;
BA_ "GenSigTimeoutTime_RFHM" SG_ 2654339184 EOL_FD08_SGW 0;
BA_ "GenSigTimeoutTime_SGW" SG_ 2654339184 EOL_FD08_SGW 0;
BA_ "GenSigTimeoutTime_TCM" SG_ 2654339184 EOL_FD08_SGW 0;
BA_ "GenSigTimeoutTime_AGSM" SG_ 2654339184 EOL_FD11_SGW 0;
BA_ "GenSigTimeoutTime_ASBS" SG_ 2654339184 EOL_FD11_SGW 0;
BA_ "GenSigTimeoutTime_BCM" SG_ 2654339184 EOL_FD11_SGW 0;
BA_ "GenSigTimeoutTime_BSM" SG_ 2654339184 EOL_FD11_SGW 0;
BA_ "GenSigTimeoutTime_CADM" SG_ 2654339184 EOL_FD11_SGW 0;
BA_ "GenSigTimeoutTime_DMSM" SG_ 2654339184 EOL_FD11_SGW 0;
BA_ "GenSigTimeoutTime_DTCM" SG_ 2654339184 EOL_FD11_SGW 0;
BA_ "GenSigTimeoutTime_ELSDM" SG_ 2654339184 EOL_FD11_SGW 0;
BA_ "GenSigTimeoutTime_ESL" SG_ 2654339184 EOL_FD11_SGW 0;
BA_ "GenSigTimeoutTime_GNMM" SG_ 2654339184 EOL_FD11_SGW 0;
BA_ "GenSigTimeoutTime_HCP" SG_ 2654339184 EOL_FD11_SGW 0;
BA_ "GenSigTimeoutTime_IPC" SG_ 2654339184 EOL_FD11_SGW 0;
BA_ "GenSigTimeoutTime_RFHM" SG_ 2654339184 EOL_FD11_SGW 0;
BA_ "GenSigTimeoutTime_SGW" SG_ 2654339184 EOL_FD11_SGW 0;
BA_ "GenSigTimeoutTime_TCM" SG_ 2654339184 EOL_FD11_SGW 0;
BA_ "GenSigTimeoutTime_AGSM" SG_ 2654339184 GenericFailSts_FD01_SGW 0;
BA_ "GenSigTimeoutTime_ASBS" SG_ 2654339184 GenericFailSts_FD01_SGW 0;
BA_ "GenSigTimeoutTime_BCM" SG_ 2654339184 GenericFailSts_FD01_SGW 0;
BA_ "GenSigTimeoutTime_BSM" SG_ 2654339184 GenericFailSts_FD01_SGW 0;
BA_ "GenSigTimeoutTime_CADM" SG_ 2654339184 GenericFailSts_FD01_SGW 0;
BA_ "GenSigTimeoutTime_DMSM" SG_ 2654339184 GenericFailSts_FD01_SGW 0;
BA_ "GenSigTimeoutTime_DTCM" SG_ 2654339184 GenericFailSts_FD01_SGW 0;
BA_ "GenSigTimeoutTime_ELSDM" SG_ 2654339184 GenericFailSts_FD01_SGW 0;
BA_ "GenSigTimeoutTime_ESL" SG_ 2654339184 GenericFailSts_FD01_SGW 0;
BA_ "GenSigTimeoutTime_GNMM" SG_ 2654339184 GenericFailSts_FD01_SGW 0;
BA_ "GenSigTimeoutTime_HCP" SG_ 2654339184 GenericFailSts_FD01_SGW 0;
BA_ "GenSigTimeoutTime_IPC" SG_ 2654339184 GenericFailSts_FD01_SGW 0;
BA_ "GenSigTimeoutTime_RFHM" SG_ 2654339184 GenericFailSts_FD01_SGW 0;
BA_ "GenSigTimeoutTime_SGW" SG_ 2654339184 GenericFailSts_FD01_SGW 0;
BA_ "GenSigTimeoutTime_TCM" SG_ 2654339184 GenericFailSts_FD01_SGW 0;
BA_ "GenSigTimeoutTime_AGSM" SG_ 2654339184 StayActiveSource_FD11_SGW 0;
BA_ "GenSigTimeoutTime_ASBS" SG_ 2654339184 StayActiveSource_FD11_SGW 0;
BA_ "GenSigTimeoutTime_BCM" SG_ 2654339184 StayActiveSource_FD11_SGW 0;
BA_ "GenSigTimeoutTime_BSM" SG_ 2654339184 StayActiveSource_FD11_SGW 0;
BA_ "GenSigTimeoutTime_CADM" SG_ 2654339184 StayActiveSource_FD11_SGW 0;
BA_ "GenSigTimeoutTime_DMSM" SG_ 2654339184 StayActiveSource_FD11_SGW 0;
BA_ "GenSigTimeoutTime_DTCM" SG_ 2654339184 StayActiveSource_FD11_SGW 0;
BA_ "GenSigTimeoutTime_ELSDM" SG_ 2654339184 StayActiveSource_FD11_SGW 0;
BA_ "GenSigTimeoutTime_ESL" SG_ 2654339184 StayActiveSource_FD11_SGW 0;
BA_ "GenSigTimeoutTime_GNMM" SG_ 2654339184 StayActiveSource_FD11_SGW 0;
BA_ "GenSigTimeoutTime_HCP" SG_ 2654339184 StayActiveSource_FD11_SGW 0;
BA_ "GenSigTimeoutTime_IPC" SG_ 2654339184 StayActiveSource_FD11_SGW 0;
BA_ "GenSigTimeoutTime_RFHM" SG_ 2654339184 StayActiveSource_FD11_SGW 0;
BA_ "GenSigTimeoutTime_SGW" SG_ 2654339184 StayActiveSource_FD11_SGW 0;
BA_ "GenSigTimeoutTime_TCM" SG_ 2654339184 StayActiveSource_FD11_SGW 0;
BA_ "GenSigTimeoutTime_AGSM" SG_ 2654339184 CurrentFailSts_FD01_SGW 0;
BA_ "GenSigTimeoutTime_ASBS" SG_ 2654339184 CurrentFailSts_FD01_SGW 0;
BA_ "GenSigTimeoutTime_BCM" SG_ 2654339184 CurrentFailSts_FD01_SGW 0;
BA_ "GenSigTimeoutTime_BSM" SG_ 2654339184 CurrentFailSts_FD01_SGW 0;
BA_ "GenSigTimeoutTime_CADM" SG_ 2654339184 CurrentFailSts_FD01_SGW 0;
BA_ "GenSigTimeoutTime_DMSM" SG_ 2654339184 CurrentFailSts_FD01_SGW 0;
BA_ "GenSigTimeoutTime_DTCM" SG_ 2654339184 CurrentFailSts_FD01_SGW 0;
BA_ "GenSigTimeoutTime_ELSDM" SG_ 2654339184 CurrentFailSts_FD01_SGW 0;
BA_ "GenSigTimeoutTime_ESL" SG_ 2654339184 CurrentFailSts_FD01_SGW 0;
BA_ "GenSigTimeoutTime_GNMM" SG_ 2654339184 CurrentFailSts_FD01_SGW 0;
BA_ "GenSigTimeoutTime_HCP" SG_ 2654339184 CurrentFailSts_FD01_SGW 0;
BA_ "GenSigTimeoutTime_IPC" SG_ 2654339184 CurrentFailSts_FD01_SGW 0;
BA_ "GenSigTimeoutTime_RFHM" SG_ 2654339184 CurrentFailSts_FD01_SGW 0;
BA_ "GenSigTimeoutTime_SGW" SG_ 2654339184 CurrentFailSts_FD01_SGW 0;
BA_ "GenSigTimeoutTime_TCM" SG_ 2654339184 CurrentFailSts_FD01_SGW 0;
BA_ "GenSigTimeoutTime_AGSM" SG_ 2654339184 CurrentFailSts_FD02_SGW 0;
BA_ "GenSigTimeoutTime_ASBS" SG_ 2654339184 CurrentFailSts_FD02_SGW 0;
BA_ "GenSigTimeoutTime_BCM" SG_ 2654339184 CurrentFailSts_FD02_SGW 0;
BA_ "GenSigTimeoutTime_BSM" SG_ 2654339184 CurrentFailSts_FD02_SGW 0;
BA_ "GenSigTimeoutTime_CADM" SG_ 2654339184 CurrentFailSts_FD02_SGW 0;
BA_ "GenSigTimeoutTime_DMSM" SG_ 2654339184 CurrentFailSts_FD02_SGW 0;
BA_ "GenSigTimeoutTime_DTCM" SG_ 2654339184 CurrentFailSts_FD02_SGW 0;
BA_ "GenSigTimeoutTime_ELSDM" SG_ 2654339184 CurrentFailSts_FD02_SGW 0;
BA_ "GenSigTimeoutTime_ESL" SG_ 2654339184 CurrentFailSts_FD02_SGW 0;
BA_ "GenSigTimeoutTime_GNMM" SG_ 2654339184 CurrentFailSts_FD02_SGW 0;
BA_ "GenSigTimeoutTime_HCP" SG_ 2654339184 CurrentFailSts_FD02_SGW 0;
BA_ "GenSigTimeoutTime_IPC" SG_ 2654339184 CurrentFailSts_FD02_SGW 0;
BA_ "GenSigTimeoutTime_RFHM" SG_ 2654339184 CurrentFailSts_FD02_SGW 0;
BA_ "GenSigTimeoutTime_SGW" SG_ 2654339184 CurrentFailSts_FD02_SGW 0;
BA_ "GenSigTimeoutTime_TCM" SG_ 2654339184 CurrentFailSts_FD02_SGW 0;
BA_ "GenSigTimeoutTime_AGSM" SG_ 2654339184 CurrentFailSts_FD03_SGW 0;
BA_ "GenSigTimeoutTime_ASBS" SG_ 2654339184 CurrentFailSts_FD03_SGW 0;
BA_ "GenSigTimeoutTime_BSM" SG_ 2654339184 CurrentFailSts_FD03_SGW 0;
BA_ "GenSigTimeoutTime_CADM" SG_ 2654339184 CurrentFailSts_FD03_SGW 0;
BA_ "GenSigTimeoutTime_DMSM" SG_ 2654339184 CurrentFailSts_FD03_SGW 0;
BA_ "GenSigTimeoutTime_DTCM" SG_ 2654339184 CurrentFailSts_FD03_SGW 0;
BA_ "GenSigTimeoutTime_ELSDM" SG_ 2654339184 CurrentFailSts_FD03_SGW 0;
BA_ "GenSigTimeoutTime_ESL" SG_ 2654339184 CurrentFailSts_FD03_SGW 0;
BA_ "GenSigTimeoutTime_GNMM" SG_ 2654339184 CurrentFailSts_FD03_SGW 0;
BA_ "GenSigTimeoutTime_HCP" SG_ 2654339184 CurrentFailSts_FD03_SGW 0;
BA_ "GenSigTimeoutTime_IPC" SG_ 2654339184 CurrentFailSts_FD03_SGW 0;
BA_ "GenSigTimeoutTime_RFHM" SG_ 2654339184 CurrentFailSts_FD03_SGW 0;
BA_ "GenSigTimeoutTime_SGW" SG_ 2654339184 CurrentFailSts_FD03_SGW 0;
BA_ "GenSigTimeoutTime_TCM" SG_ 2654339184 CurrentFailSts_FD03_SGW 0;
BA_ "GenSigTimeoutTime_AGSM" SG_ 2654339184 CurrentFailSts_FD08_SGW 0;
BA_ "GenSigTimeoutTime_ASBS" SG_ 2654339184 CurrentFailSts_FD08_SGW 0;
BA_ "GenSigTimeoutTime_BCM" SG_ 2654339184 CurrentFailSts_FD08_SGW 0;
BA_ "GenSigTimeoutTime_BSM" SG_ 2654339184 CurrentFailSts_FD08_SGW 0;
BA_ "GenSigTimeoutTime_CADM" SG_ 2654339184 CurrentFailSts_FD08_SGW 0;
BA_ "GenSigTimeoutTime_DMSM" SG_ 2654339184 CurrentFailSts_FD08_SGW 0;
BA_ "GenSigTimeoutTime_DTCM" SG_ 2654339184 CurrentFailSts_FD08_SGW 0;
BA_ "GenSigTimeoutTime_ELSDM" SG_ 2654339184 CurrentFailSts_FD08_SGW 0;
BA_ "GenSigTimeoutTime_ESL" SG_ 2654339184 CurrentFailSts_FD08_SGW 0;
BA_ "GenSigTimeoutTime_GNMM" SG_ 2654339184 CurrentFailSts_FD08_SGW 0;
BA_ "GenSigTimeoutTime_HCP" SG_ 2654339184 CurrentFailSts_FD08_SGW 0;
BA_ "GenSigTimeoutTime_IPC" SG_ 2654339184 CurrentFailSts_FD08_SGW 0;
BA_ "GenSigTimeoutTime_RFHM" SG_ 2654339184 CurrentFailSts_FD08_SGW 0;
BA_ "GenSigTimeoutTime_SGW" SG_ 2654339184 CurrentFailSts_FD08_SGW 0;
BA_ "GenSigTimeoutTime_TCM" SG_ 2654339184 CurrentFailSts_FD08_SGW 0;
BA_ "GenSigTimeoutTime_AGSM" SG_ 2654339184 CurrentFailSts_FD11_SGW 0;
BA_ "GenSigTimeoutTime_ASBS" SG_ 2654339184 CurrentFailSts_FD11_SGW 0;
BA_ "GenSigTimeoutTime_BCM" SG_ 2654339184 CurrentFailSts_FD11_SGW 0;
BA_ "GenSigTimeoutTime_BSM" SG_ 2654339184 CurrentFailSts_FD11_SGW 0;
BA_ "GenSigTimeoutTime_CADM" SG_ 2654339184 CurrentFailSts_FD11_SGW 0;
BA_ "GenSigTimeoutTime_DMSM" SG_ 2654339184 CurrentFailSts_FD11_SGW 0;
BA_ "GenSigTimeoutTime_DTCM" SG_ 2654339184 CurrentFailSts_FD11_SGW 0;
BA_ "GenSigTimeoutTime_ELSDM" SG_ 2654339184 CurrentFailSts_FD11_SGW 0;
BA_ "GenSigTimeoutTime_ESL" SG_ 2654339184 CurrentFailSts_FD11_SGW 0;
BA_ "GenSigTimeoutTime_GNMM" SG_ 2654339184 CurrentFailSts_FD11_SGW 0;
BA_ "GenSigTimeoutTime_HCP" SG_ 2654339184 CurrentFailSts_FD11_SGW 0;
BA_ "GenSigTimeoutTime_IPC" SG_ 2654339184 CurrentFailSts_FD11_SGW 0;
BA_ "GenSigTimeoutTime_RFHM" SG_ 2654339184 CurrentFailSts_FD11_SGW 0;
BA_ "GenSigTimeoutTime_SGW" SG_ 2654339184 CurrentFailSts_FD11_SGW 0;
BA_ "GenSigTimeoutTime_TCM" SG_ 2654339184 CurrentFailSts_FD11_SGW 0;
BA_ "GenSigTimeoutTime_AGSM" SG_ 2654339184 StayActiveSource_FD01_SGW 0;
BA_ "GenSigTimeoutTime_ASBS" SG_ 2654339184 StayActiveSource_FD01_SGW 0;
BA_ "GenSigTimeoutTime_BCM" SG_ 2654339184 StayActiveSource_FD01_SGW 0;
BA_ "GenSigTimeoutTime_BSM" SG_ 2654339184 StayActiveSource_FD01_SGW 0;
BA_ "GenSigTimeoutTime_CADM" SG_ 2654339184 StayActiveSource_FD01_SGW 0;
BA_ "GenSigTimeoutTime_DMSM" SG_ 2654339184 StayActiveSource_FD01_SGW 0;
BA_ "GenSigTimeoutTime_DTCM" SG_ 2654339184 StayActiveSource_FD01_SGW 0;
BA_ "GenSigTimeoutTime_ELSDM" SG_ 2654339184 StayActiveSource_FD01_SGW 0;
BA_ "GenSigTimeoutTime_ESL" SG_ 2654339184 StayActiveSource_FD01_SGW 0;
BA_ "GenSigTimeoutTime_GNMM" SG_ 2654339184 StayActiveSource_FD01_SGW 0;
BA_ "GenSigTimeoutTime_HCP" SG_ 2654339184 StayActiveSource_FD01_SGW 0;
BA_ "GenSigTimeoutTime_IPC" SG_ 2654339184 StayActiveSource_FD01_SGW 0;
BA_ "GenSigTimeoutTime_RFHM" SG_ 2654339184 StayActiveSource_FD01_SGW 0;
BA_ "GenSigTimeoutTime_SGW" SG_ 2654339184 StayActiveSource_FD01_SGW 0;
BA_ "GenSigTimeoutTime_TCM" SG_ 2654339184 StayActiveSource_FD01_SGW 0;
BA_ "GenSigTimeoutTime_AGSM" SG_ 2654339184 StayActiveSource_FD02_SGW 0;
BA_ "GenSigTimeoutTime_ASBS" SG_ 2654339184 StayActiveSource_FD02_SGW 0;
BA_ "GenSigTimeoutTime_BCM" SG_ 2654339184 StayActiveSource_FD02_SGW 0;
BA_ "GenSigTimeoutTime_BSM" SG_ 2654339184 StayActiveSource_FD02_SGW 0;
BA_ "GenSigTimeoutTime_CADM" SG_ 2654339184 StayActiveSource_FD02_SGW 0;
BA_ "GenSigTimeoutTime_DMSM" SG_ 2654339184 StayActiveSource_FD02_SGW 0;
BA_ "GenSigTimeoutTime_DTCM" SG_ 2654339184 StayActiveSource_FD02_SGW 0;
BA_ "GenSigTimeoutTime_ELSDM" SG_ 2654339184 StayActiveSource_FD02_SGW 0;
BA_ "GenSigTimeoutTime_ESL" SG_ 2654339184 StayActiveSource_FD02_SGW 0;
BA_ "GenSigTimeoutTime_GNMM" SG_ 2654339184 StayActiveSource_FD02_SGW 0;
BA_ "GenSigTimeoutTime_HCP" SG_ 2654339184 StayActiveSource_FD02_SGW 0;
BA_ "GenSigTimeoutTime_IPC" SG_ 2654339184 StayActiveSource_FD02_SGW 0;
BA_ "GenSigTimeoutTime_RFHM" SG_ 2654339184 StayActiveSource_FD02_SGW 0;
BA_ "GenSigTimeoutTime_SGW" SG_ 2654339184 StayActiveSource_FD02_SGW 0;
BA_ "GenSigTimeoutTime_TCM" SG_ 2654339184 StayActiveSource_FD02_SGW 0;
BA_ "GenSigTimeoutTime_AGSM" SG_ 2654339184 StayActiveSource_FD03_SGW 0;
BA_ "GenSigTimeoutTime_ASBS" SG_ 2654339184 StayActiveSource_FD03_SGW 0;
BA_ "GenSigTimeoutTime_BCM" SG_ 2654339184 StayActiveSource_FD03_SGW 0;
BA_ "GenSigTimeoutTime_BSM" SG_ 2654339184 StayActiveSource_FD03_SGW 0;
BA_ "GenSigTimeoutTime_CADM" SG_ 2654339184 StayActiveSource_FD03_SGW 0;
BA_ "GenSigTimeoutTime_DMSM" SG_ 2654339184 StayActiveSource_FD03_SGW 0;
BA_ "GenSigTimeoutTime_DTCM" SG_ 2654339184 StayActiveSource_FD03_SGW 0;
BA_ "GenSigTimeoutTime_ELSDM" SG_ 2654339184 StayActiveSource_FD03_SGW 0;
BA_ "GenSigTimeoutTime_ESL" SG_ 2654339184 StayActiveSource_FD03_SGW 0;
BA_ "GenSigTimeoutTime_GNMM" SG_ 2654339184 StayActiveSource_FD03_SGW 0;
BA_ "GenSigTimeoutTime_HCP" SG_ 2654339184 StayActiveSource_FD03_SGW 0;
BA_ "GenSigTimeoutTime_IPC" SG_ 2654339184 StayActiveSource_FD03_SGW 0;
BA_ "GenSigTimeoutTime_RFHM" SG_ 2654339184 StayActiveSource_FD03_SGW 0;
BA_ "GenSigTimeoutTime_SGW" SG_ 2654339184 StayActiveSource_FD03_SGW 0;
BA_ "GenSigTimeoutTime_TCM" SG_ 2654339184 StayActiveSource_FD03_SGW 0;
BA_ "GenSigTimeoutTime_AGSM" SG_ 2654339184 StayActiveSource_FD08_SGW 0;
BA_ "GenSigTimeoutTime_ASBS" SG_ 2654339184 StayActiveSource_FD08_SGW 0;
BA_ "GenSigTimeoutTime_BCM" SG_ 2654339184 StayActiveSource_FD08_SGW 0;
BA_ "GenSigTimeoutTime_BSM" SG_ 2654339184 StayActiveSource_FD08_SGW 0;
BA_ "GenSigTimeoutTime_CADM" SG_ 2654339184 StayActiveSource_FD08_SGW 0;
BA_ "GenSigTimeoutTime_DMSM" SG_ 2654339184 StayActiveSource_FD08_SGW 0;
BA_ "GenSigTimeoutTime_DTCM" SG_ 2654339184 StayActiveSource_FD08_SGW 0;
BA_ "GenSigTimeoutTime_ELSDM" SG_ 2654339184 StayActiveSource_FD08_SGW 0;
BA_ "GenSigTimeoutTime_ESL" SG_ 2654339184 StayActiveSource_FD08_SGW 0;
BA_ "GenSigTimeoutTime_GNMM" SG_ 2654339184 StayActiveSource_FD08_SGW 0;
BA_ "GenSigTimeoutTime_HCP" SG_ 2654339184 StayActiveSource_FD08_SGW 0;
BA_ "GenSigTimeoutTime_IPC" SG_ 2654339184 StayActiveSource_FD08_SGW 0;
BA_ "GenSigTimeoutTime_RFHM" SG_ 2654339184 StayActiveSource_FD08_SGW 0;
BA_ "GenSigTimeoutTime_SGW" SG_ 2654339184 StayActiveSource_FD08_SGW 0;
BA_ "GenSigTimeoutTime_TCM" SG_ 2654339184 StayActiveSource_FD08_SGW 0;
BA_ "GenSigTimeoutTime_AGSM" SG_ 2654339184 PreviousCanNMState_FD11_SGW 0;
BA_ "GenSigTimeoutTime_ASBS" SG_ 2654339184 PreviousCanNMState_FD11_SGW 0;
BA_ "GenSigTimeoutTime_BCM" SG_ 2654339184 PreviousCanNMState_FD11_SGW 0;
BA_ "GenSigTimeoutTime_BSM" SG_ 2654339184 PreviousCanNMState_FD11_SGW 0;
BA_ "GenSigTimeoutTime_CADM" SG_ 2654339184 PreviousCanNMState_FD11_SGW 0;
BA_ "GenSigTimeoutTime_DMSM" SG_ 2654339184 PreviousCanNMState_FD11_SGW 0;
BA_ "GenSigTimeoutTime_DTCM" SG_ 2654339184 PreviousCanNMState_FD11_SGW 0;
BA_ "GenSigTimeoutTime_ELSDM" SG_ 2654339184 PreviousCanNMState_FD11_SGW 0;
BA_ "GenSigTimeoutTime_ESL" SG_ 2654339184 PreviousCanNMState_FD11_SGW 0;
BA_ "GenSigTimeoutTime_GNMM" SG_ 2654339184 PreviousCanNMState_FD11_SGW 0;
BA_ "GenSigTimeoutTime_HCP" SG_ 2654339184 PreviousCanNMState_FD11_SGW 0;
BA_ "GenSigTimeoutTime_IPC" SG_ 2654339184 PreviousCanNMState_FD11_SGW 0;
BA_ "GenSigTimeoutTime_RFHM" SG_ 2654339184 PreviousCanNMState_FD11_SGW 0;
BA_ "GenSigTimeoutTime_SGW" SG_ 2654339184 PreviousCanNMState_FD11_SGW 0;
BA_ "GenSigTimeoutTime_TCM" SG_ 2654339184 PreviousCanNMState_FD11_SGW 0;
BA_ "GenSigTimeoutTime_AGSM" SG_ 2654339184 WakeupSource_FD01_SGW 0;
BA_ "GenSigTimeoutTime_ASBS" SG_ 2654339184 WakeupSource_FD01_SGW 0;
BA_ "GenSigTimeoutTime_BCM" SG_ 2654339184 WakeupSource_FD01_SGW 0;
BA_ "GenSigTimeoutTime_BSM" SG_ 2654339184 WakeupSource_FD01_SGW 0;
BA_ "GenSigTimeoutTime_CADM" SG_ 2654339184 WakeupSource_FD01_SGW 0;
BA_ "GenSigTimeoutTime_DMSM" SG_ 2654339184 WakeupSource_FD01_SGW 0;
BA_ "GenSigTimeoutTime_DTCM" SG_ 2654339184 WakeupSource_FD01_SGW 0;
BA_ "GenSigTimeoutTime_ELSDM" SG_ 2654339184 WakeupSource_FD01_SGW 0;
BA_ "GenSigTimeoutTime_ESL" SG_ 2654339184 WakeupSource_FD01_SGW 0;
BA_ "GenSigTimeoutTime_GNMM" SG_ 2654339184 WakeupSource_FD01_SGW 0;
BA_ "GenSigTimeoutTime_HCP" SG_ 2654339184 WakeupSource_FD01_SGW 0;
BA_ "GenSigTimeoutTime_IPC" SG_ 2654339184 WakeupSource_FD01_SGW 0;
BA_ "GenSigTimeoutTime_RFHM" SG_ 2654339184 WakeupSource_FD01_SGW 0;
BA_ "GenSigTimeoutTime_SGW" SG_ 2654339184 WakeupSource_FD01_SGW 0;
BA_ "GenSigTimeoutTime_TCM" SG_ 2654339184 WakeupSource_FD01_SGW 0;
BA_ "GenSigTimeoutTime_AGSM" SG_ 2654339184 WakeupSource_FD02_SGW 0;
BA_ "GenSigTimeoutTime_ASBS" SG_ 2654339184 WakeupSource_FD02_SGW 0;
BA_ "GenSigTimeoutTime_BCM" SG_ 2654339184 WakeupSource_FD02_SGW 0;
BA_ "GenSigTimeoutTime_BSM" SG_ 2654339184 WakeupSource_FD02_SGW 0;
BA_ "GenSigTimeoutTime_CADM" SG_ 2654339184 WakeupSource_FD02_SGW 0;
BA_ "GenSigTimeoutTime_DMSM" SG_ 2654339184 WakeupSource_FD02_SGW 0;
BA_ "GenSigTimeoutTime_DTCM" SG_ 2654339184 WakeupSource_FD02_SGW 0;
BA_ "GenSigTimeoutTime_ELSDM" SG_ 2654339184 WakeupSource_FD02_SGW 0;
BA_ "GenSigTimeoutTime_ESL" SG_ 2654339184 WakeupSource_FD02_SGW 0;
BA_ "GenSigTimeoutTime_GNMM" SG_ 2654339184 WakeupSource_FD02_SGW 0;
BA_ "GenSigTimeoutTime_HCP" SG_ 2654339184 WakeupSource_FD02_SGW 0;
BA_ "GenSigTimeoutTime_IPC" SG_ 2654339184 WakeupSource_FD02_SGW 0;
BA_ "GenSigTimeoutTime_RFHM" SG_ 2654339184 WakeupSource_FD02_SGW 0;
BA_ "GenSigTimeoutTime_SGW" SG_ 2654339184 WakeupSource_FD02_SGW 0;
BA_ "GenSigTimeoutTime_TCM" SG_ 2654339184 WakeupSource_FD02_SGW 0;
BA_ "GenSigTimeoutTime_AGSM" SG_ 2654339184 WakeupSource_FD03_SGW 0;
BA_ "GenSigTimeoutTime_ASBS" SG_ 2654339184 WakeupSource_FD03_SGW 0;
BA_ "GenSigTimeoutTime_BCM" SG_ 2654339184 WakeupSource_FD03_SGW 0;
BA_ "GenSigTimeoutTime_BSM" SG_ 2654339184 WakeupSource_FD03_SGW 0;
BA_ "GenSigTimeoutTime_CADM" SG_ 2654339184 WakeupSource_FD03_SGW 0;
BA_ "GenSigTimeoutTime_DMSM" SG_ 2654339184 WakeupSource_FD03_SGW 0;
BA_ "GenSigTimeoutTime_DTCM" SG_ 2654339184 WakeupSource_FD03_SGW 0;
BA_ "GenSigTimeoutTime_ELSDM" SG_ 2654339184 WakeupSource_FD03_SGW 0;
BA_ "GenSigTimeoutTime_ESL" SG_ 2654339184 WakeupSource_FD03_SGW 0;
BA_ "GenSigTimeoutTime_GNMM" SG_ 2654339184 WakeupSource_FD03_SGW 0;
BA_ "GenSigTimeoutTime_HCP" SG_ 2654339184 WakeupSource_FD03_SGW 0;
BA_ "GenSigTimeoutTime_IPC" SG_ 2654339184 WakeupSource_FD03_SGW 0;
BA_ "GenSigTimeoutTime_RFHM" SG_ 2654339184 WakeupSource_FD03_SGW 0;
BA_ "GenSigTimeoutTime_SGW" SG_ 2654339184 WakeupSource_FD03_SGW 0;
BA_ "GenSigTimeoutTime_TCM" SG_ 2654339184 WakeupSource_FD03_SGW 0;
BA_ "GenSigTimeoutTime_AGSM" SG_ 2654339184 WakeupSource_FD08_SGW 0;
BA_ "GenSigTimeoutTime_ASBS" SG_ 2654339184 WakeupSource_FD08_SGW 0;
BA_ "GenSigTimeoutTime_BCM" SG_ 2654339184 WakeupSource_FD08_SGW 0;
BA_ "GenSigTimeoutTime_BSM" SG_ 2654339184 WakeupSource_FD08_SGW 0;
BA_ "GenSigTimeoutTime_CADM" SG_ 2654339184 WakeupSource_FD08_SGW 0;
BA_ "GenSigTimeoutTime_DMSM" SG_ 2654339184 WakeupSource_FD08_SGW 0;
BA_ "GenSigTimeoutTime_DTCM" SG_ 2654339184 WakeupSource_FD08_SGW 0;
BA_ "GenSigTimeoutTime_ELSDM" SG_ 2654339184 WakeupSource_FD08_SGW 0;
BA_ "GenSigTimeoutTime_ESL" SG_ 2654339184 WakeupSource_FD08_SGW 0;
BA_ "GenSigTimeoutTime_GNMM" SG_ 2654339184 WakeupSource_FD08_SGW 0;
BA_ "GenSigTimeoutTime_HCP" SG_ 2654339184 WakeupSource_FD08_SGW 0;
BA_ "GenSigTimeoutTime_IPC" SG_ 2654339184 WakeupSource_FD08_SGW 0;
BA_ "GenSigTimeoutTime_RFHM" SG_ 2654339184 WakeupSource_FD08_SGW 0;
BA_ "GenSigTimeoutTime_SGW" SG_ 2654339184 WakeupSource_FD08_SGW 0;
BA_ "GenSigTimeoutTime_TCM" SG_ 2654339184 WakeupSource_FD08_SGW 0;
BA_ "GenSigTimeoutTime_AGSM" SG_ 2654339184 WakeupSource_FD11_SGW 0;
BA_ "GenSigTimeoutTime_ASBS" SG_ 2654339184 WakeupSource_FD11_SGW 0;
BA_ "GenSigTimeoutTime_BCM" SG_ 2654339184 WakeupSource_FD11_SGW 0;
BA_ "GenSigTimeoutTime_BSM" SG_ 2654339184 WakeupSource_FD11_SGW 0;
BA_ "GenSigTimeoutTime_CADM" SG_ 2654339184 WakeupSource_FD11_SGW 0;
BA_ "GenSigTimeoutTime_DMSM" SG_ 2654339184 WakeupSource_FD11_SGW 0;
BA_ "GenSigTimeoutTime_DTCM" SG_ 2654339184 WakeupSource_FD11_SGW 0;
BA_ "GenSigTimeoutTime_ELSDM" SG_ 2654339184 WakeupSource_FD11_SGW 0;
BA_ "GenSigTimeoutTime_ESL" SG_ 2654339184 WakeupSource_FD11_SGW 0;
BA_ "GenSigTimeoutTime_GNMM" SG_ 2654339184 WakeupSource_FD11_SGW 0;
BA_ "GenSigTimeoutTime_HCP" SG_ 2654339184 WakeupSource_FD11_SGW 0;
BA_ "GenSigTimeoutTime_IPC" SG_ 2654339184 WakeupSource_FD11_SGW 0;
BA_ "GenSigTimeoutTime_RFHM" SG_ 2654339184 WakeupSource_FD11_SGW 0;
BA_ "GenSigTimeoutTime_SGW" SG_ 2654339184 WakeupSource_FD11_SGW 0;
BA_ "GenSigTimeoutTime_TCM" SG_ 2654339184 WakeupSource_FD11_SGW 0;
BA_ "GenSigTimeoutTime_ADCAM" SG_ 2654555920 APPL_ECU_FD_ECM 0;
BA_ "GenSigTimeoutTime_EVCU2" SG_ 2654555920 APPL_ECU_FD_ECM 0;
BA_ "GenSigTimeoutTime_VDCM" SG_ 2654555920 APPL_ECU_FD_ECM 0;
BA_ "GenSigTimeoutTime_AGSM" SG_ 2654555920 APPL_ECU_FD_ECM 0;
BA_ "GenSigTimeoutTime_ASBS" SG_ 2654555920 APPL_ECU_FD_ECM 0;
BA_ "GenSigTimeoutTime_BCM" SG_ 2654555920 APPL_ECU_FD_ECM 0;
BA_ "GenSigTimeoutTime_BSM" SG_ 2654555920 APPL_ECU_FD_ECM 0;
BA_ "GenSigTimeoutTime_CADM" SG_ 2654555920 APPL_ECU_FD_ECM 0;
BA_ "GenSigTimeoutTime_DMSM" SG_ 2654555920 APPL_ECU_FD_ECM 0;
BA_ "GenSigTimeoutTime_DTCM" SG_ 2654555920 APPL_ECU_FD_ECM 0;
BA_ "GenSigTimeoutTime_ELSDM" SG_ 2654555920 APPL_ECU_FD_ECM 0;
BA_ "GenSigTimeoutTime_ESL" SG_ 2654555920 APPL_ECU_FD_ECM 0;
BA_ "GenSigTimeoutTime_GNMM" SG_ 2654555920 APPL_ECU_FD_ECM 0;
BA_ "GenSigTimeoutTime_HCP" SG_ 2654555920 APPL_ECU_FD_ECM 0;
BA_ "GenSigTimeoutTime_IPC" SG_ 2654555920 APPL_ECU_FD_ECM 0;
BA_ "GenSigTimeoutTime_RFHM" SG_ 2654555920 APPL_ECU_FD_ECM 0;
BA_ "GenSigTimeoutTime_SGW" SG_ 2654555920 APPL_ECU_FD_ECM 0;
BA_ "GenSigTimeoutTime_TCM" SG_ 2654555920 APPL_ECU_FD_ECM 0;
BA_ "GenSigSendType" SG_ 1445 ASCM_Stat 3;
BA_ "GenSigTimeoutTime_AGSM" SG_ 1445 ASCM_Stat 0;
BA_ "GenSigTimeoutTime_ASBS" SG_ 1445 ASCM_Stat 0;
BA_ "GenSigTimeoutTime_BCM" SG_ 1445 ASCM_Stat 0;
BA_ "GenSigTimeoutTime_DMSM" SG_ 1445 ASCM_Stat 0;
BA_ "GenSigTimeoutTime_DTCM" SG_ 1445 ASCM_Stat 0;
BA_ "GenSigTimeoutTime_ELSDM" SG_ 1445 ASCM_Stat 0;
BA_ "GenSigTimeoutTime_ESL" SG_ 1445 ASCM_Stat 0;
BA_ "GenSigTimeoutTime_GNMM" SG_ 1445 ASCM_Stat 0;
BA_ "GenSigTimeoutTime_HCP" SG_ 1445 ASCM_Stat 0;
BA_ "GenSigTimeoutTime_RFHM" SG_ 1445 ASCM_Stat 0;
BA_ "GenSigTimeoutTime_SGW" SG_ 1445 ASCM_Stat 0;
BA_ "GenSigTimeoutTime_TCM" SG_ 1445 ASCM_Stat 0;
BA_ "GenSigStartValue" SG_ 1153 ExternalTemperatureC 511;
BA_ "GenSigTimeoutTime_BCM" SG_ 1153 ExternalTemperatureC 0;
BA_ "GenSigTimeoutTime_ESL" SG_ 1153 ExternalTemperatureC 0;
BA_ "GenSigTimeoutTime_VDCM" SG_ 1153 CRC_BCM10 0;
BA_ "GenSigTimeoutTime_VDCM" SG_ 1153 MessageCounter_BCM10 0;
BA_ "GenSigTimeoutTime_ADCAM" SG_ 1153 SpSt_Pad1 0;
BA_ "GenSigTimeoutTime_EVCU2" SG_ 1153 SpSt_Pad1 0;
BA_ "GenSigTimeoutTime_ASBS" SG_ 256 MessageCounter_BCM2 0;
BA_ "GenSigTimeoutTime_BCM" SG_ 256 MessageCounter_BCM2 0;
BA_ "GenSigTimeoutTime_DTCM" SG_ 256 MessageCounter_BCM2 0;
BA_ "GenSigTimeoutTime_ELSDM" SG_ 256 MessageCounter_BCM2 0;
BA_ "GenSigTimeoutTime_ESL" SG_ 256 MessageCounter_BCM2 0;
BA_ "GenSigTimeoutTime_GNMM" SG_ 256 MessageCounter_BCM2 0;
BA_ "GenSigTimeoutTime_IPC" SG_ 256 MessageCounter_BCM2 0;
BA_ "GenSigTimeoutTime_RFHM" SG_ 256 MessageCounter_BCM2 0;
BA_ "GenSigTimeoutTime_SGW" SG_ 256 MessageCounter_BCM2 0;
BA_ "GenSigTimeoutTime_AGSM" SG_ 256 RefuelRequest 0;
BA_ "GenSigTimeoutTime_ASBS" SG_ 256 RefuelRequest 0;
BA_ "GenSigTimeoutTime_BCM" SG_ 256 RefuelRequest 0;
BA_ "GenSigTimeoutTime_BSM" SG_ 256 RefuelRequest 0;
BA_ "GenSigTimeoutTime_CADM" SG_ 256 RefuelRequest 0;
BA_ "GenSigTimeoutTime_DMSM" SG_ 256 RefuelRequest 0;
BA_ "GenSigTimeoutTime_DTCM" SG_ 256 RefuelRequest 0;
BA_ "GenSigTimeoutTime_ELSDM" SG_ 256 RefuelRequest 0;
BA_ "GenSigTimeoutTime_ESL" SG_ 256 RefuelRequest 0;
BA_ "GenSigTimeoutTime_GNMM" SG_ 256 RefuelRequest 0;
BA_ "GenSigTimeoutTime_HCP" SG_ 256 RefuelRequest 0;
BA_ "GenSigTimeoutTime_IPC" SG_ 256 RefuelRequest 0;
BA_ "GenSigTimeoutTime_RFHM" SG_ 256 RefuelRequest 0;
BA_ "GenSigTimeoutTime_SGW" SG_ 256 RefuelRequest 0;
BA_ "GenSigTimeoutTime_TCM" SG_ 256 RefuelRequest 0;
BA_ "GenSigTimeoutTime_AGSM" SG_ 256 RemStActvSts_R 0;
BA_ "GenSigTimeoutTime_ASBS" SG_ 256 RemStActvSts_R 0;
BA_ "GenSigTimeoutTime_BCM" SG_ 256 RemStActvSts_R 0;
BA_ "GenSigTimeoutTime_BSM" SG_ 256 RemStActvSts_R 0;
BA_ "GenSigTimeoutTime_CADM" SG_ 256 RemStActvSts_R 0;
BA_ "GenSigTimeoutTime_DMSM" SG_ 256 RemStActvSts_R 0;
BA_ "GenSigTimeoutTime_ELSDM" SG_ 256 RemStActvSts_R 0;
BA_ "GenSigTimeoutTime_ESL" SG_ 256 RemStActvSts_R 0;
BA_ "GenSigTimeoutTime_GNMM" SG_ 256 RemStActvSts_R 0;
BA_ "GenSigTimeoutTime_IPC" SG_ 256 RemStActvSts_R 0;
BA_ "GenSigTimeoutTime_RFHM" SG_ 256 RemStActvSts_R 0;
BA_ "GenSigTimeoutTime_SGW" SG_ 256 RemStActvSts_R 0;
BA_ "GenSigTimeoutTime_AGSM" SG_ 256 EngineOffRequest 0;
BA_ "GenSigTimeoutTime_ASBS" SG_ 256 EngineOffRequest 0;
BA_ "GenSigTimeoutTime_BCM" SG_ 256 EngineOffRequest 0;
BA_ "GenSigTimeoutTime_BSM" SG_ 256 EngineOffRequest 0;
BA_ "GenSigTimeoutTime_CADM" SG_ 256 EngineOffRequest 0;
BA_ "GenSigTimeoutTime_DMSM" SG_ 256 EngineOffRequest 0;
BA_ "GenSigTimeoutTime_DTCM" SG_ 256 EngineOffRequest 0;
BA_ "GenSigTimeoutTime_ELSDM" SG_ 256 EngineOffRequest 0;
BA_ "GenSigTimeoutTime_ESL" SG_ 256 EngineOffRequest 0;
BA_ "GenSigTimeoutTime_GNMM" SG_ 256 EngineOffRequest 0;
BA_ "GenSigTimeoutTime_HCP" SG_ 256 EngineOffRequest 0;
BA_ "GenSigTimeoutTime_IPC" SG_ 256 EngineOffRequest 0;
BA_ "GenSigTimeoutTime_RFHM" SG_ 256 EngineOffRequest 0;
BA_ "GenSigTimeoutTime_SGW" SG_ 256 EngineOffRequest 0;
BA_ "GenSigTimeoutTime_TCM" SG_ 256 EngineOffRequest 0;
BA_ "GenSigTimeoutTime_BCM" SG_ 256 OperationalModeSts 0;
BA_ "GenSigTimeoutTime_AGSM" SG_ 256 StartRelayBCMFault 0;
BA_ "GenSigTimeoutTime_ASBS" SG_ 256 StartRelayBCMFault 0;
BA_ "GenSigTimeoutTime_BCM" SG_ 256 StartRelayBCMFault 0;
BA_ "GenSigTimeoutTime_BSM" SG_ 256 StartRelayBCMFault 0;
BA_ "GenSigTimeoutTime_CADM" SG_ 256 StartRelayBCMFault 0;
BA_ "GenSigTimeoutTime_DMSM" SG_ 256 StartRelayBCMFault 0;
BA_ "GenSigTimeoutTime_DTCM" SG_ 256 StartRelayBCMFault 0;
BA_ "GenSigTimeoutTime_ELSDM" SG_ 256 StartRelayBCMFault 0;
BA_ "GenSigTimeoutTime_ESL" SG_ 256 StartRelayBCMFault 0;
BA_ "GenSigTimeoutTime_GNMM" SG_ 256 StartRelayBCMFault 0;
BA_ "GenSigTimeoutTime_HCP" SG_ 256 StartRelayBCMFault 0;
BA_ "GenSigTimeoutTime_IPC" SG_ 256 StartRelayBCMFault 0;
BA_ "GenSigTimeoutTime_RFHM" SG_ 256 StartRelayBCMFault 0;
BA_ "GenSigTimeoutTime_TCM" SG_ 256 StartRelayBCMFault 0;
BA_ "GenSigTimeoutTime_AGSM" SG_ 256 StartRelayBCMSts 0;
BA_ "GenSigTimeoutTime_ASBS" SG_ 256 StartRelayBCMSts 0;
BA_ "GenSigTimeoutTime_BCM" SG_ 256 StartRelayBCMSts 0;
BA_ "GenSigTimeoutTime_BSM" SG_ 256 StartRelayBCMSts 0;
BA_ "GenSigTimeoutTime_CADM" SG_ 256 StartRelayBCMSts 0;
BA_ "GenSigTimeoutTime_DMSM" SG_ 256 StartRelayBCMSts 0;
BA_ "GenSigTimeoutTime_DTCM" SG_ 256 StartRelayBCMSts 0;
BA_ "GenSigTimeoutTime_ELSDM" SG_ 256 StartRelayBCMSts 0;
BA_ "GenSigTimeoutTime_ESL" SG_ 256 StartRelayBCMSts 0;
BA_ "GenSigTimeoutTime_GNMM" SG_ 256 StartRelayBCMSts 0;
BA_ "GenSigTimeoutTime_HCP" SG_ 256 StartRelayBCMSts 0;
BA_ "GenSigTimeoutTime_IPC" SG_ 256 StartRelayBCMSts 0;
BA_ "GenSigTimeoutTime_RFHM" SG_ 256 StartRelayBCMSts 0;
BA_ "GenSigTimeoutTime_SGW" SG_ 256 StartRelayBCMSts 0;
BA_ "GenSigTimeoutTime_TCM" SG_ 256 StartRelayBCMSts 0;
BA_ "GenSigTimeoutTime_ADCAM" SG_ 1051 CRC_BCM4 0;
BA_ "GenSigTimeoutTime_VDCM" SG_ 1051 CRC_BCM4 0;
BA_ "GenSigTimeoutTime_AGSM" SG_ 1051 CRC_BCM4 0;
BA_ "GenSigTimeoutTime_BCM" SG_ 1051 CRC_BCM4 0;
BA_ "GenSigTimeoutTime_BSM" SG_ 1051 CRC_BCM4 0;
BA_ "GenSigTimeoutTime_DTCM" SG_ 1051 CRC_BCM4 0;
BA_ "GenSigTimeoutTime_ESL" SG_ 1051 CRC_BCM4 0;
BA_ "GenSigTimeoutTime_IPC" SG_ 1051 CRC_BCM4 0;
BA_ "GenSigTimeoutTime_RFHM" SG_ 1051 CRC_BCM4 0;
BA_ "GenSigTimeoutTime_SGW" SG_ 1051 CRC_BCM4 0;
BA_ "GenSigTimeoutTime_TCM" SG_ 1051 CRC_BCM4 0;
BA_ "GenSigTimeoutTime_ADCAM" SG_ 1051 MessageCounter_BCM4 0;
BA_ "GenSigTimeoutTime_VDCM" SG_ 1051 MessageCounter_BCM4 0;
BA_ "GenSigTimeoutTime_AGSM" SG_ 1051 MessageCounter_BCM4 0;
BA_ "GenSigTimeoutTime_BCM" SG_ 1051 MessageCounter_BCM4 0;
BA_ "GenSigTimeoutTime_BSM" SG_ 1051 MessageCounter_BCM4 0;
BA_ "GenSigTimeoutTime_DTCM" SG_ 1051 MessageCounter_BCM4 0;
BA_ "GenSigTimeoutTime_ESL" SG_ 1051 MessageCounter_BCM4 0;
BA_ "GenSigTimeoutTime_IPC" SG_ 1051 MessageCounter_BCM4 0;
BA_ "GenSigTimeoutTime_RFHM" SG_ 1051 MessageCounter_BCM4 0;
BA_ "GenSigTimeoutTime_SGW" SG_ 1051 MessageCounter_BCM4 0;
BA_ "GenSigTimeoutTime_TCM" SG_ 1051 MessageCounter_BCM4 0;
BA_ "GenSigTimeoutTime_ADCAM" SG_ 1051 AM_ECM_Trace 0;
BA_ "GenSigTimeoutTime_EVCU2" SG_ 1051 AM_ECM_Trace 0;
BA_ "GenSigTimeoutTime_VDCM" SG_ 1051 AM_ECM_Trace 0;
BA_ "GenSigTimeoutTime_ADCAM" SG_ 1051 BCMSAMFailSts 0;
BA_ "GenSigTimeoutTime_EVCU2" SG_ 1051 BCMSAMFailSts 0;
BA_ "GenSigTimeoutTime_VDCM" SG_ 1051 BCMSAMFailSts 0;
BA_ "GenSigTimeoutTime_ADCAM" SG_ 1051 VoltageMax 0;
BA_ "GenSigTimeoutTime_EVCU2" SG_ 1051 VoltageMax 0;
BA_ "GenSigTimeoutTime_VDCM" SG_ 1051 VoltageMax 0;
BA_ "GenSigTimeoutTime_ADCAM" SG_ 1051 VoltageMin 0;
BA_ "GenSigTimeoutTime_EVCU2" SG_ 1051 VoltageMin 0;
BA_ "GenSigTimeoutTime_VDCM" SG_ 1051 VoltageMin 0;
BA_ "GenSigTimeoutTime_ADCAM" SG_ 1051 ExternalTemperatureAD_Voltage 0;
BA_ "GenSigTimeoutTime_VDCM" SG_ 1051 ExternalTemperatureAD_Voltage 0;
BA_ "GenSigTimeoutTime_ADCAM" SG_ 255 Rear_Axle_Target_Torque 0;
BA_ "GenSigTimeoutTime_EVCU2" SG_ 255 Rear_Axle_Target_Torque 0;
BA_ "GenSigTimeoutTime_VDCM" SG_ 255 Rear_Axle_Target_Torque 0;
BA_ "GenSigStartValue" SG_ 255 Rear_Axle_Target_Torque 32767;
BA_ "GenSigTimeoutTime_AGSM" SG_ 255 Rear_Axle_Target_Torque 0;
BA_ "GenSigTimeoutTime_BCM" SG_ 255 Rear_Axle_Target_Torque 0;
BA_ "GenSigTimeoutTime_DTCM" SG_ 255 Rear_Axle_Target_Torque 0;
BA_ "GenSigTimeoutTime_ECM" SG_ 255 Rear_Axle_Target_Torque 0;
BA_ "GenSigTimeoutTime_ESL" SG_ 255 Rear_Axle_Target_Torque 0;
BA_ "GenSigTimeoutTime_IPC" SG_ 255 Rear_Axle_Target_Torque 0;
BA_ "GenSigTimeoutTime_RFHM" SG_ 255 Rear_Axle_Target_Torque 0;
BA_ "GenSigTimeoutTime_SGW" SG_ 255 Rear_Axle_Target_Torque 0;
BA_ "GenSigTimeoutTime_TCM" SG_ 255 Rear_Axle_Target_Torque 0;
BA_ "GenSigTimeoutTime_ADCAM" SG_ 255 Front_Axle_Target_Torque 0;
BA_ "GenSigTimeoutTime_EVCU2" SG_ 255 Front_Axle_Target_Torque 0;
BA_ "GenSigTimeoutTime_VDCM" SG_ 255 Front_Axle_Target_Torque 0;
BA_ "GenSigStartValue" SG_ 255 Front_Axle_Target_Torque 32767;
BA_ "GenSigTimeoutTime_AGSM" SG_ 255 Front_Axle_Target_Torque 0;
BA_ "GenSigTimeoutTime_BCM" SG_ 255 Front_Axle_Target_Torque 0;
BA_ "GenSigTimeoutTime_DTCM" SG_ 255 Front_Axle_Target_Torque 0;
BA_ "GenSigTimeoutTime_ECM" SG_ 255 Front_Axle_Target_Torque 0;
BA_ "GenSigTimeoutTime_ESL" SG_ 255 Front_Axle_Target_Torque 0;
BA_ "GenSigTimeoutTime_IPC" SG_ 255 Front_Axle_Target_Torque 0;
BA_ "GenSigTimeoutTime_RFHM" SG_ 255 Front_Axle_Target_Torque 0;
BA_ "GenSigTimeoutTime_SGW" SG_ 255 Front_Axle_Target_Torque 0;
BA_ "GenSigTimeoutTime_TCM" SG_ 255 Front_Axle_Target_Torque 0;
BA_ "GenSigTimeoutTime_ADCAM" SG_ 255 Rear_AxleTorque_Static 0;
BA_ "GenSigTimeoutTime_EVCU2" SG_ 255 Rear_AxleTorque_Static 0;
BA_ "GenSigTimeoutTime_VDCM" SG_ 255 Rear_AxleTorque_Static 0;
BA_ "GenSigStartValue" SG_ 255 Rear_AxleTorque_Static 32767;
BA_ "GenSigTimeoutTime_AGSM" SG_ 255 Rear_AxleTorque_Static 0;
BA_ "GenSigTimeoutTime_DTCM" SG_ 255 Rear_AxleTorque_Static 0;
BA_ "GenSigTimeoutTime_ECM" SG_ 255 Rear_AxleTorque_Static 0;
BA_ "GenSigTimeoutTime_ESL" SG_ 255 Rear_AxleTorque_Static 0;
BA_ "GenSigTimeoutTime_IPC" SG_ 255 Rear_AxleTorque_Static 0;
BA_ "GenSigTimeoutTime_RFHM" SG_ 255 Rear_AxleTorque_Static 0;
BA_ "GenSigTimeoutTime_TCM" SG_ 255 Rear_AxleTorque_Static 0;
BA_ "GenSigTimeoutTime_ADCAM" SG_ 255 Front_AxleTorque_Static 0;
BA_ "GenSigTimeoutTime_EVCU2" SG_ 255 Front_AxleTorque_Static 0;
BA_ "GenSigTimeoutTime_VDCM" SG_ 255 Front_AxleTorque_Static 0;
BA_ "GenSigStartValue" SG_ 255 Front_AxleTorque_Static 32767;
BA_ "GenSigTimeoutTime_AGSM" SG_ 255 Front_AxleTorque_Static 0;
BA_ "GenSigTimeoutTime_DTCM" SG_ 255 Front_AxleTorque_Static 0;
BA_ "GenSigTimeoutTime_ESL" SG_ 255 SumTorqueStatic 0;
BA_ "GenSigTimeoutTime_GNMM" SG_ 255 SumTorqueStatic 0;
BA_ "GenSigTimeoutTime_HCP" SG_ 255 SumTorqueStatic 0;
BA_ "GenSigTimeoutTime_IPC" SG_ 255 SumTorqueStatic 0;
BA_ "GenSigTimeoutTime_RFHM" SG_ 255 SumTorqueStatic 0;
BA_ "GenSigTimeoutTime_AGSM" SG_ 255 SumTorqueStatic_SEM 0;
BA_ "GenSigTimeoutTime_ASBS" SG_ 255 SumTorqueStatic_SEM 0;
BA_ "GenSigTimeoutTime_CADM" SG_ 255 SumTorqueStatic_SEM 0;
BA_ "GenSigTimeoutTime_DMSM" SG_ 255 SumTorqueStatic_SEM 0;
BA_ "GenSigTimeoutTime_DTCM" SG_ 255 SumTorqueStatic_SEM 0;
BA_ "GenSigTimeoutTime_ECM" SG_ 255 SumTorqueStatic_SEM 0;
BA_ "GenSigTimeoutTime_ELSDM" SG_ 255 SumTorqueStatic_SEM 0;
BA_ "GenSigTimeoutTime_ESL" SG_ 255 SumTorqueStatic_SEM 0;
BA_ "GenSigTimeoutTime_GNMM" SG_ 255 SumTorqueStatic_SEM 0;
BA_ "GenSigTimeoutTime_HCP" SG_ 255 SumTorqueStatic_SEM 0;
BA_ "GenSigTimeoutTime_IPC" SG_ 255 SumTorqueStatic_SEM 0;
BA_ "GenSigTimeoutTime_RFHM" SG_ 255 SumTorqueStatic_SEM 0;
BA_ "GenSigTimeoutTime_SGW" SG_ 255 SumTorqueStatic_SEM 0;
BA_ "GenSigTimeoutTime_AGSM" SG_ 255 SumTorqueTgt_SEM 0;
BA_ "GenSigTimeoutTime_ASBS" SG_ 255 SumTorqueTgt_SEM 0;
BA_ "GenSigTimeoutTime_BCM" SG_ 255 SumTorqueTgt_SEM 0;
BA_ "GenSigTimeoutTime_BSM" SG_ 255 SumTorqueTgt_SEM 0;
BA_ "GenSigTimeoutTime_CADM" SG_ 255 SumTorqueTgt_SEM 0;
BA_ "GenSigTimeoutTime_DMSM" SG_ 255 SumTorqueTgt_SEM 0;
BA_ "GenSigTimeoutTime_DTCM" SG_ 255 SumTorqueTgt_SEM 0;
BA_ "GenSigTimeoutTime_ECM" SG_ 255 SumTorqueTgt_SEM 0;
BA_ "GenSigTimeoutTime_ELSDM" SG_ 255 SumTorqueTgt_SEM 0;
BA_ "GenSigTimeoutTime_ESL" SG_ 255 SumTorqueTgt_SEM 0;
BA_ "GenSigTimeoutTime_GNMM" SG_ 255 SumTorqueTgt_SEM 0;
BA_ "GenSigTimeoutTime_HCP" SG_ 255 SumTorqueTgt_SEM 0;
BA_ "GenSigTimeoutTime_IPC" SG_ 255 SumTorqueTgt_SEM 0;
BA_ "GenSigTimeoutTime_RFHM" SG_ 255 SumTorqueTgt_SEM 0;
BA_ "GenSigTimeoutTime_SGW" SG_ 255 SumTorqueTgt_SEM 0;
VAL_ 513 VehicleStandStillSts 0 "True" 1 "False" 3 "SNA";
VAL_ 513 BrkTrq_Driver 32767 "SNA";
VAL_ 513 BrkTrq 32767 "SNA";
VAL_ 1066 PowerModeSts 0 "Standard_Power" 1 "Logistic_Mode_ON" 2 "Logistic_Mode_PR" 3 "LogisticModeON_and_EngineON";
VAL_ 1066 ParkBrakeSts 0 "OFF" 1 "ON";
VAL_ 1066 FuelLevel 255 "SNA";
VAL_ 1066 BonnetSts 0 "Closed" 1 "Open";
VAL_ 1375 ChkFuelLevelSts 0 "Fault_Not_Present" 1 "Chk_Code_1" 2 "Chk_Code_2" 3 "Chk_Code_3" 4 "Chk_Code_4" 5 "Not_Used" 6 "Not_Used" 7 "Not_Used";
VAL_ 1051 FUEL_VOLT 255 "SNA";
VAL_ 256 StartRelayBCMSts 0 "OFF" 1 "ON";
VAL_ 256 StartRelayBCMFault 0 "Not_Present" 1 "Present";
VAL_ 256 OperationalModeSts 0 "Initialization" 1 "Ignition_Off_WithoutKey" 2 "Ignition_Off" 3 "Ignition_Acc" 4 "Ignition_On" 5 "Ignition_Pre_Start" 6 "Ignition_Start" 7 "Ignition_Cranking" 8 "Ignition_On_EngOn" 9 "Ignition_Pre_Acc" 10 "Ignition_Pre_Off" 11 "Automatic_Cranking" 12 "Automatic_Stop" 13 "Key_Authenticated" 14 "Not_Used" 15 "SNA";
VAL_ 256 EngineOffRequest 0 "Not_Active" 1 "Active";
VAL_ 736 Command_15Sts 0 "Not_Pressed" 1 "Pressed" 3 "SNA";
VAL_ 159 SpeedLimiterOnOffSts 0 "Not_Active" 1 "Active";
VAL_ 159 CrusCnclSwitch 0 "Not_Active" 1 "Active";
VAL_ 159 ACC_On 0 "Not_Active" 1 "Active";
VAL_ 1153 ExternalTemperatureC 511 "SNA";
VAL_ 1153 CompressorACReqSts 0 "Not_Active" 1 "Active";
VAL_ 1153 CmdIgnSts 0 "Initialization" 1 "IGN_LK" 3 "ACC" 4 "RUN" 5 "START" 7 "SNA";
VAL_ 255 SumTorqueTgt_SEM 2047 "SNA";
VAL_ 255 SumTorqueStatic_SEM 2047 "SNA";
VAL_ 255 SumTorqueStatic 2047 "SNA";
VAL_ 255 SumTorqueSel_D_TTC 2047 "SNA";
VAL_ 255 SumTorqueMin 2047 "SNA";
VAL_ 255 SumTorqueMax 2047 "SNA";
VAL_ 255 SumTorqueExp 2047 "SNA";
VAL_ 255 SumTorque_DrvReqMod 8191 "SNA";
VAL_ 2654339184 GenericFailSts_FD11_SGW 0 "No_Fail_Present" 1 "Fail_Present";
VAL_ 2654339184 GenericFailSts_FD08_SGW 0 "No_Fail_Present" 1 "Fail_Present";
VAL_ 2654339184 GenericFailSts_FD03_SGW 0 "No_Fail_Present" 1 "Fail_Present";
VAL_ 2654339184 GenericFailSts_FD02_SGW 0 "No_Fail_Present" 1 "Fail_Present";
VAL_ 2654339184 GenericFailSts_FD01_SGW 0 "No_Fail_Present" 1 "Fail_Present";
VAL_ 2654339184 EOL_FD11_SGW 0 "No_EOL_Programming" 1 "EOL_Programming";
VAL_ 2654339184 EOL_FD08_SGW 0 "No_EOL_Programming" 1 "EOL_Programming";
VAL_ 2654339184 EOL_FD03_SGW 0 "No_EOL_Programming" 1 "EOL_Programming";
VAL_ 2654339184 EOL_FD02_SGW 0 "No_EOL_Programming" 1 "EOL_Programming";
VAL_ 2654339184 EOL_FD01_SGW 0 "No_EOL_Programming" 1 "EOL_Programming";
VAL_ 2654339184 CurrentFailSts_FD11_SGW 0 "No_Fail_Present" 1 "Fail_Present";
VAL_ 2654339184 CurrentFailSts_FD08_SGW 0 "No_Fail_Present" 1 "Fail_Present";
VAL_ 2654339184 CurrentFailSts_FD03_SGW 0 "No_Fail_Present" 1 "Fail_Present";
VAL_ 2654339184 CurrentFailSts_FD02_SGW 0 "No_Fail_Present" 1 "Fail_Present";
VAL_ 2654339184 CurrentFailSts_FD01_SGW 0 "No_Fail_Present" 1 "Fail_Present";
VAL_ 513 SelectSpdSts 0 "OFF" 1 "Select Speed Mode" 2 "Select Speed Mode Inhibit" 3 "SNA";
VAL_ 513 REF_VEH_SPEED 1023 "SNA";
VAL_ 1066 RHRDoorSts 0 "Closed" 1 "Open";
VAL_ 1066 RHatchSts 0 "Closed" 1 "Open";
VAL_ 1066 PsngrDoorSts 0 "Closed" 1 "Open";
VAL_ 1066 LowFuelWarningSts 0 "OFF" 1 "ON";
VAL_ 1066 LHRDoorSts 0 "Closed" 1 "Open";
VAL_ 1066 FrontWiperMoveSts 0 "Stop" 1 "Moving";
VAL_ 1066 DriverDoorSts 0 "Closed" 1 "Open";
VAL_ 1051 FUEL_VOLT2 255 "SNA";
VAL_ 1051 BCMSAMFailSts 0 "Fail_not_present" 1 "Fail_present";
VAL_ 256 RemStActvSts_R 0 "Remote Start Not Active" 1 "Remote Start Active";
VAL_ 256 RefuelRequest 0 "NO" 1 "Refuel" 3 "SNA";
VAL_ 512 LeakCheckTimerExpired 0 "NOT" 1 "ELAPSED" 3 "SNA";
VAL_ 512 FuelDrRelSwRawSt 255 "SNA";
VAL_ 512 DriverDoorAjarXtionSts 1 "NONE" 2 "TRNS" 3 "SNA";
VAL_ 512 DriverDoor2AjarXtionSts 1 "NONE" 2 "TRNS" 3 "SNA";
VAL_ 1431 TerrainSwStat 0 "Not_Activated" 1 "Left_Up_Activated" 2 "Right_Down_Activated" 5 "Short_to_Ground_Fault" 6 "Open_Short_to_Power_Fault" 7 "SNA";
VAL_ 1431 Sport_Request 0 "Not_Pressed" 1 "Pressed" 5 "Short_to_Ground_Fault" 6 "Open_Short_to_Power_Fault" 7 "SNA";
VAL_ 1430 Parallel_Prk_Ast_Pad1 0 "Not_Selected" 1 "Sw1_Activated" 2 "Sw2_Activated" 3 "Sw1_and_Sw2_Activated" 4 "Invalid_State" 5 "Short_to_Ground" 6 "Short_to_Power" 7 "SNA";
VAL_ 1430 AcOutputCurrentSts 255 "SNA";
VAL_ 1153 SpSt_Pad1 0 "Not_Selected" 1 "Sw1_Activated" 2 "Sw2_Activated" 3 "Sw1_and_Sw2_Activated" 4 "Invalid_State" 5 "Short_to_Ground" 6 "Short_to_Power" 7 "SNA";
VAL_ 1051 AM_ECM_Trace 0 "DEFAULT" 2 "AM_ECM_TRACE" 3 "SNA";
VAL_ 255 MotorB_Speed 65534 "Initialization" 65535 "SNA";
VAL_ 159 ResumeSwitch 0 "Not_Active" 1 "Active";
VAL_ 159 DeceleratorSts 0 "Not_Active" 1 "Active";
VAL_ 159 CruiseControlOnOffSts 0 "Not_Active" 1 "Active";
VAL_ 159 CruiseControlFailSts 0 "Fail_Not_Present" 1 "Fail_Present";
VAL_ 159 AcceleratorSts 0 "Not_Active" 1 "Active";
VAL_ 1445 ASCM_Stat 0 "NONE" 1 "DUMP" 2 "PARK" 3 "AERO" 4 "NVL" 5 "OR1" 6 "ORL2" 7 "Lifter" 8 "RAISE" 9 "LOWER" 10 "SYSFAIL" 11 "SRVS" 12 "AERO2" 13 "Clearance2" 15 "SNA";
VAL_ 2654339184 WakeupSource_FD11_SGW 0 "No_Wakeup" 1 "IGN_ON" 129 "FD1_Psv_WU" 130 "FD2_Psv_WU" 131 "FD3_Psv_WU" 132 "FD4_Psv_WU" 133 "FD5_Psv_WU" 134 "FD6_Psv_WU" 135 "FD7_Psv_WU" 136 "FD8_Psv_WU" 137 "FD9_Psv_WU" 138 "FD10_Psv_WU" 139 "FD11_Psv_WU" 140 "FD12_Psv_WU" 141 "FD13_Psv_WU" 142 "FD14_Psv_WU" 143 "FD15_Psv_WU" 144 "FD16_Psv_WU" 145 "FD17_Psv_WU" 146 "FD18_Psv_WU" 147 "FD19_Psv_WU" 148 "FD20_Psv_WU" 149 "FD21_Psv_WU" 150 "FD22_Psv_WU" 151 "FD23_Psv_WU" 152 "FD24_Psv_WU" 153 "FD25_Psv_WU" 154 "FD26_Psv_WU" 155 "FD27_Psv_WU" 156 "FD28_Psv_WU" 157 "FD29_Psv_WU" 158 "BHCAN_Psv_WU" 159 "CCAN_Psv_WU" 254 "WUSource_Not_Listed";
VAL_ 2654339184 WakeupSource_FD08_SGW 0 "No_Wakeup" 1 "IGN_ON" 129 "FD1_Psv_WU" 130 "FD2_Psv_WU" 131 "FD3_Psv_WU" 132 "FD4_Psv_WU" 133 "FD5_Psv_WU" 134 "FD6_Psv_WU" 135 "FD7_Psv_WU" 136 "FD8_Psv_WU" 137 "FD9_Psv_WU" 138 "FD10_Psv_WU" 139 "FD11_Psv_WU" 140 "FD12_Psv_WU" 141 "FD13_Psv_WU" 142 "FD14_Psv_WU" 143 "FD15_Psv_WU" 144 "FD16_Psv_WU" 145 "FD17_Psv_WU" 146 "FD18_Psv_WU" 147 "FD19_Psv_WU" 148 "FD20_Psv_WU" 149 "FD21_Psv_WU" 150 "FD22_Psv_WU" 151 "FD23_Psv_WU" 152 "FD24_Psv_WU" 153 "FD25_Psv_WU" 154 "FD26_Psv_WU" 155 "FD27_Psv_WU" 156 "FD28_Psv_WU" 157 "FD29_Psv_WU" 158 "BHCAN_Psv_WU" 159 "CCAN_Psv_WU" 254 "WUSource_Not_Listed";
VAL_ 2654339184 WakeupSource_FD03_SGW 0 "No_Wakeup" 1 "IGN_ON" 129 "FD1_Psv_WU" 130 "FD2_Psv_WU" 131 "FD3_Psv_WU" 132 "FD4_Psv_WU" 133 "FD5_Psv_WU" 134 "FD6_Psv_WU" 135 "FD7_Psv_WU" 136 "FD8_Psv_WU" 137 "FD9_Psv_WU" 138 "FD10_Psv_WU" 139 "FD11_Psv_WU" 140 "FD12_Psv_WU" 141 "FD13_Psv_WU" 142 "FD14_Psv_WU" 143 "FD15_Psv_WU" 144 "FD16_Psv_WU" 145 "FD17_Psv_WU" 146 "FD18_Psv_WU" 147 "FD19_Psv_WU" 148 "FD20_Psv_WU" 149 "FD21_Psv_WU" 150 "FD22_Psv_WU" 151 "FD23_Psv_WU" 152 "FD24_Psv_WU" 153 "FD25_Psv_WU" 154 "FD26_Psv_WU" 155 "FD27_Psv_WU" 156 "FD28_Psv_WU" 157 "FD29_Psv_WU" 158 "BHCAN_Psv_WU" 159 "CCAN_Psv_WU" 254 "WUSource_Not_Listed";
VAL_ 2654339184 WakeupSource_FD02_SGW 0 "No_Wakeup" 1 "IGN_ON" 129 "FD1_Psv_WU" 130 "FD2_Psv_WU" 131 "FD3_Psv_WU" 132 "FD4_Psv_WU" 133 "FD5_Psv_WU" 134 "FD6_Psv_WU" 135 "FD7_Psv_WU" 136 "FD8_Psv_WU" 137 "FD9_Psv_WU" 138 "FD10_Psv_WU" 139 "FD11_Psv_WU" 140 "FD12_Psv_WU" 141 "FD13_Psv_WU" 142 "FD14_Psv_WU" 143 "FD15_Psv_WU" 144 "FD16_Psv_WU" 145 "FD17_Psv_WU" 146 "FD18_Psv_WU" 147 "FD19_Psv_WU" 148 "FD20_Psv_WU" 149 "FD21_Psv_WU" 150 "FD22_Psv_WU" 151 "FD23_Psv_WU" 152 "FD24_Psv_WU" 153 "FD25_Psv_WU" 154 "FD26_Psv_WU" 155 "FD27_Psv_WU" 156 "FD28_Psv_WU" 157 "FD29_Psv_WU" 158 "BHCAN_Psv_WU" 159 "CCAN_Psv_WU" 254 "WUSource_Not_Listed";
VAL_ 2654339184 WakeupSource_FD01_SGW 0 "No_Wakeup" 1 "IGN_ON" 129 "FD1_Psv_WU" 130 "FD2_Psv_WU" 131 "FD3_Psv_WU" 132 "FD4_Psv_WU" 133 "FD5_Psv_WU" 134 "FD6_Psv_WU" 135 "FD7_Psv_WU" 136 "FD8_Psv_WU" 137 "FD9_Psv_WU" 138 "FD10_Psv_WU" 139 "FD11_Psv_WU" 140 "FD12_Psv_WU" 141 "FD13_Psv_WU" 142 "FD14_Psv_WU" 143 "FD15_Psv_WU" 144 "FD16_Psv_WU" 145 "FD17_Psv_WU" 146 "FD18_Psv_WU" 147 "FD19_Psv_WU" 148 "FD20_Psv_WU" 149 "FD21_Psv_WU" 150 "FD22_Psv_WU" 151 "FD23_Psv_WU" 152 "FD24_Psv_WU" 153 "FD25_Psv_WU" 154 "FD26_Psv_WU" 155 "FD27_Psv_WU" 156 "FD28_Psv_WU" 157 "FD29_Psv_WU" 158 "BHCAN_Psv_WU" 159 "CCAN_Psv_WU" 254 "WUSource_Not_Listed";
VAL_ 2654339184 PreviousCanNMState_FD11_SGW 0 "Uninitialized State" 1 "Bus-Sleep State" 2 "Prepare-Bus State" 3 "Ready-Sleep State" 4 "Normal Operation State" 5 "Repeat Message State" 6 "Synchronize State" 7 "Offline State";
VAL_ 2654339184 PreviousCanNMState_FD08_SGW 0 "Uninitialized State" 1 "Bus-Sleep State" 2 "Prepare-Bus State" 3 "Ready-Sleep State" 4 "Normal Operation State" 5 "Repeat Message State" 6 "Synchronize State" 7 "Offline State";
VAL_ 2654339184 PreviousCanNMState_FD03_SGW 0 "Uninitialized State" 1 "Bus-Sleep State" 2 "Prepare-Bus State" 3 "Ready-Sleep State" 4 "Normal Operation State" 5 "Repeat Message State" 6 "Synchronize State" 7 "Offline State";
VAL_ 2654339184 PreviousCanNMState_FD02_SGW 0 "Uninitialized State" 1 "Bus-Sleep State" 2 "Prepare-Bus State" 3 "Ready-Sleep State" 4 "Normal Operation State" 5 "Repeat Message State" 6 "Synchronize State" 7 "Offline State";
VAL_ 2654339184 PreviousCanNMState_FD01_SGW 0 "Uninitialized State" 1 "Bus-Sleep State" 2 "Prepare-Bus State" 3 "Ready-Sleep State" 4 "Normal Operation State" 5 "Repeat Message State" 6 "Synchronize State" 7 "Offline State";
VAL_ 2654339184 DES_FD11_SGW 0 "Error_Active_state" 1 "Error_passive_warning_state" 2 "Bus_off_state" 3 "Not_used";
VAL_ 2654339184 DES_FD08_SGW 0 "Error_Active_state" 1 "Error_passive_warning_state" 2 "Bus_off_state" 3 "Not_used";
VAL_ 2654339184 DES_FD03_SGW 0 "Error_Active_state" 1 "Error_passive_warning_state" 2 "Bus_off_state" 3 "Not_used";
VAL_ 2654339184 DES_FD02_SGW 0 "Error_Active_state" 1 "Error_passive_warning_state" 2 "Bus_off_state" 3 "Not_used";
VAL_ 2654339184 DES_FD01_SGW 0 "Error_Active_state" 1 "Error_passive_warning_state" 2 "Bus_off_state" 3 "Not_used";
VAL_ 2654339184 CurrentCanNMState_FD11_SGW 0 "Uninitialized State" 1 "Bus-Sleep State" 2 "Prepare-Bus State" 3 "Ready-Sleep State" 4 "Normal Operation State" 5 "Repeat Message State" 6 "Synchronize State" 7 "Offline State";
VAL_ 2654339184 CurrentCanNMState_FD08_SGW 0 "Uninitialized State" 1 "Bus-Sleep State" 2 "Prepare-Bus State" 3 "Ready-Sleep State" 4 "Normal Operation State" 5 "Repeat Message State" 6 "Synchronize State" 7 "Offline State";
VAL_ 2654339184 CurrentCanNMState_FD03_SGW 0 "Uninitialized State" 1 "Bus-Sleep State" 2 "Prepare-Bus State" 3 "Ready-Sleep State" 4 "Normal Operation State" 5 "Repeat Message State" 6 "Synchronize State" 7 "Offline State";
VAL_ 2654339184 CurrentCanNMState_FD02_SGW 0 "Uninitialized State" 1 "Bus-Sleep State" 2 "Prepare-Bus State" 3 "Ready-Sleep State" 4 "Normal Operation State" 5 "Repeat Message State" 6 "Synchronize State" 7 "Offline State";
VAL_ 2654339184 CurrentCanNMState_FD01_SGW 0 "Uninitialized State" 1 "Bus-Sleep State" 2 "Prepare-Bus State" 3 "Ready-Sleep State" 4 "Normal Operation State" 5 "Repeat Message State" 6 "Synchronize State" 7 "Offline State";
VAL_ 1375 ChkFuelLevelSts2 0 "Fault_Not_Present" 1 "Chk_Code_1" 2 "Chk_Code_2" 3 "Chk_Code_3" 4 "Chk_Code_4" 5 "Not_Used" 6 "Not_Used" 7 "Not_Used";
VAL_ 513 HILL_DES_STAT 0 "HDC_UNAVL" 1 "HDC_ACT" 2 "HDC_AVL" 3 "HDC_THRML_DEACT" 4 "HDC_OVERRIDE";
VAL_ 1465 PSI_Rq 0 "NONE " 1 "DISABLE " 2 "ENABLE " 3 "SNA";
VAL_ 1465 PSI_Gr5_RPM_SET 31 "SNA";
VAL_ 1465 PSI_Gr4_RPM_SET 31 "SNA";
VAL_ 1465 PSI_Gr3_RPM_SET 31 "SNA";
VAL_ 1465 PSI_Gr2_RPM_SET 31 "SNA";
VAL_ 1465 PSI_Gr1_RPM_SET 31 "SNA";
VAL_ 513 EngSpdIntervReq 0 "False" 1 "True";
VAL_ 1431 TerrainModeInterfaceButton_BCM 0 "Not_Activated" 1 "Activated" 5 "Short_to_Ground_Fault" 6 "Open_Short_to_Power_Fault" 7 "SNA";
VAL_ 1431 Right_Button_BCM 0 "Not_Activated" 1 "Activated" 5 "Short_to_Ground_Fault" 6 "Open_Short_to_Power_Fault" 7 "SNA";
VAL_ 1431 Left_Button_BCM 0 "Not_Activated" 1 "Activated" 5 "Short_to_Ground_Fault" 6 "Open_Short_to_Power_Fault" 7 "SNA";
VAL_ 255 SSC_TrqEnblRq_Allowed 0 "FALSE" 1 "TRUE";
VAL_ 255 ESC_TrqEnblRq_Allowed 0 "FALSE" 1 "TRUE";
VAL_ 255 Accel_Pedal_Override 0 "FALSE" 1 "TRUE";
VAL_ 255 ACC_NCC_TrqEnblRq_Allowed 0 "FALSE" 1 "TRUE";
VAL_ 255 Total_AxleTorque_Static 65535 "SNA";
VAL_ 255 Rear_AxleTorque_Static 65535 "SNA";
VAL_ 255 Front_AxleTorque_Static 65535 "SNA";
VAL_ 1465 Trns_DrvMdReq 0 "NP" 1 "STREET" 2 "VALET" 3 "SPORT" 4 "S_PLUS" 5 "TRACK" 6 "ECO" 7 "SNOW" 8 "ROCK" 9 "TOW" 10 "DRAG" 11 "MUD" 12 "SAND" 13 "BAJA" 15 "SNA";
VAL_ 2654339184 StayActiveSource_FD11_SGW 0 "CANNM_Ready_Sleep" 1 "IGN_ON" 2 "NonDefault_Diag" 4 "ING_OFF_NormSt_RptSt" 1073741824 "SASource_Not_Listed";
VAL_ 2654339184 StayActiveSource_FD08_SGW 0 "CANNM_Ready_Sleep" 1 "IGN_ON" 2 "NonDefault_Diag" 4 "ING_OFF_NormSt_RptSt" 1073741824 "SASource_Not_Listed";
VAL_ 2654339184 StayActiveSource_FD03_SGW 0 "CANNM_Ready_Sleep" 1 "IGN_ON" 2 "NonDefault_Diag" 4 "ING_OFF_NormSt_RptSt" 1073741824 "SASource_Not_Listed";
VAL_ 2654339184 StayActiveSource_FD02_SGW 0 "CANNM_Ready_Sleep" 1 "IGN_ON" 2 "NonDefault_Diag" 4 "ING_OFF_NormSt_RptSt" 1073741824 "SASource_Not_Listed";
VAL_ 2654339184 StayActiveSource_FD01_SGW 0 "CANNM_Ready_Sleep" 1 "IGN_ON" 2 "NonDefault_Diag" 4 "ING_OFF_NormSt_RptSt" 1073741824 "SASource_Not_Listed";
VAL_ 1431 Launch_Hard_Btn 0 "Not_Activated" 1 "Activated" 5 "Short_to_Ground_Fault" 6 "Open_Short_to_Power_Fault" 7 "SNA";
VAL_ 255 Veh_StandStill_Req_OPD 0 "Not_Active" 1 "Active" 3 "SNA";
VAL_ 255 Front_Axle_Target_Torque 65535 "SNA";
VAL_ 255 Rear_Axle_Target_Torque 65535 "SNA";
VAL_ 1430 StopStartClimateInfo 0 "SPST_ON" 1 "CABIN_HI" 2 "CABIN_LO" 3 "MAX_AC" 4 "FT_DEFROST" 5 "EBL" 6 "MAX_HEAT" 7 "SNA";
SIG_GROUP_ 513 BRAKE_FD_1_Pkt 1 : VehicleStandStillSts BrkTrq_Driver BrkTrq SelectSpdSts REF_VEH_SPEED MessageCounter_BRAKE1 CRC_BRAKE1 HILL_DES_STAT EngSpdIntervReq EngSpdInterv;
SIG_GROUP_ 1066 BCM_FD_9_Pkt 1 : PowerModeSts ParkBrakeSts FuelLevel BonnetSts RHRDoorSts RHatchSts PsngrDoorSts MessageCounter_BCM9 LowFuelWarningSts LHRDoorSts FrontWiperMoveSts DriverDoorSts CRC_BCM9 FuelLevel2;
SIG_GROUP_ 256 BCM_FD_2_Pkt 1 : StartRelayBCMSts StartRelayBCMFault OperationalModeSts EngineOffRequest RemStActvSts_R RefuelRequest MessageCounter_BCM2 CRC_BCM2;
SIG_GROUP_ 512 BCM_FD_18_Pkt 1 : LeakCheckTimerExpired FuelDrRelSwRawSt DriverDoorAjarXtionSts DriverDoor2AjarXtionSts DriverDoorAjarRawValSts_8 DriverDoor2AjarRawValSts_8 BonnetAjarRawValSts_8 MessageCounter_BCM18 CRC_BCM18;
SIG_GROUP_ 159 BCM_FD_13_Pkt 1 : SpeedLimiterOnOffSts MC_CSWC_1 CrusCnclSwitch CRC_CSWC_1 ACC_On MessageCounter_BCM13 CRC_BCM13 ResumeSwitch DeceleratorSts CruiseControlOnOffSts CruiseControlFailSts AcceleratorSts;
SIG_GROUP_ 255 PT_TORQUE_FD_1_Pkt 1 : SumTorqueTgt_SEM SumTorqueStatic_SEM SumTorqueStatic SumTorqueSel_D_TTC SumTorqueMin SumTorqueMax SumTorqueExp SumTorque_DrvReqMod MotorB_Speed MessageCounter_PT_TORQUE_FD_1 CRC_PT_TORQUE_FD_1 SSC_TrqEnblRq_Allowed ESC_TrqEnblRq_Allowed Accel_Pedal_Override ACC_NCC_TrqEnblRq_Allowed Total_AxleTorque_Static Rear_AxleTorque_Static Front_AxleTorque_Static Veh_StandStill_Req_OPD Front_Axle_Target_Torque Rear_Axle_Target_Torque;
