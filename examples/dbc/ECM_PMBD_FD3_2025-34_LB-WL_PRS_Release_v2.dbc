VERSION ""

NS_ :

BS_:

BU_: ECM

BO_ 753 LV_CHARGER1: 32 Vector__XXX
 SG_ LVDC_CurrentFeedback : 19|12@0+ (0.15,-299) [-299|299.5] "Amp"  ECM
 SG_ MessageCounter_LV_CHARGER1 : 179|4@0+ (1,0) [0|15] "-"  ECM
 SG_ CRC_LV_CHARGER1 : 191|8@0+ (1,0) [0|255] "-"  ECM

BO_ 1443 IPC_VEHICLE_SETUP: 48 Vector__XXX
 SG_ Traffic_Sign_Info : 230|1@0+ (1,0) [0|1] "" ECM
 SG_ Speed_Unit : 253|1@0+ (1,0) [0|1] "" ECM
 SG_ New_Spd_Zone_Ind : 247|2@0+ (1,0) [0|3] "" ECM
 SG_ Dist_Unit : 231|1@0+ (1,0) [0|1] "" ECM

BO_ 752 IBS3_DATA_1: 32 Vector__XXX
 SG_ IBS3_Vbatt : 96|9@0+ (0.025,5) [5|17.75] "V"  ECM
 SG_ IBS3_SOF_VC : 118|7@0+ (0.05,5) [5|11.3] "V"  ECM
 SG_ IBS3_Ibatt : 87|16@0+ (0.02,-1000) [-1000|310.68] "A"  ECM
 SG_ VoltBattFailStatus : 102|1@0+ (1,0) [0|1] "" ECM
 SG_ RsErrIBS3 : 100|1@0+ (1,0) [0|1] "" ECM
 SG_ IBS3_Error_Internal : 101|1@0+ (1,0) [0|1] "" ECM
 SG_ CurrBattFailStatus : 103|1@0+ (1,0) [0|1] "" ECM
 SG_ MessageCounter_IBS3DATA1 : 179|4@0+ (1,0) [0|15] "0"  ECM
 SG_ CRC_IBS3DATA1 : 191|8@0+ (1,0) [0|255] "0"  ECM
 SG_ IBS3_SOF_V_Accuracy : 99|1@0+ (1,0) [0|1] "" ECM

BO_ 1032 HYBRID_THERMAL_COMMAND: 32 Vector__XXX
 SG_ RadiatorFanSts : 78|7@0+ (1,0) [0|100] "%"  ECM
 SG_ PECP2_PumpSpeedActual : 94|7@0+ (1,0) [0|100] "%"  ECM
 SG_ PECP_PumpSpeedActual : 86|7@0+ (1,0) [0|100] "%"  ECM
 SG_ PE_CoolTempOut : 31|8@0+ (1,-40) [-40|214] "°C"  ECM
 SG_ AirflowRequest : 62|7@0+ (1,0) [0|100] "%"  ECM
 SG_ PE_CoolTempIn : 111|8@0+ (1,-40) [-40|214] "°C"  ECM

BO_ 1033 HYBRID_POWERTRAIN5: 32 Vector__XXX
 SG_ IdleCLoopTrq : 33|10@0+ (0.32,-163.52) [-163.52|163.52] "Nm"  ECM
 SG_ HEV_HybPwrtrnRdcdPerfCmnd : 22|1@0+ (1,0) [0|0] "-"  ECM
 SG_ HCPMaxEngRPM : 63|8@0+ (32,0) [0|8128] "rpm"  ECM
 SG_ Force_Park_Neutral : 16|1@0+ (1,0) [0|0] "-"  ECM
 SG_ ElectricTrqMult4Pedal : 55|8@0+ (0.0078125,-0.9921875) [-0.9921875|0.9921875] "-"  ECM
 SG_ Hybrid_Immobilizer_Status : 19|2@0+ (1,0) [0|2] "" ECM
 SG_ CRC_HYBRID_POWERTRAIN5 : 191|8@0+ (1,0) [0|255] "-"  ECM
 SG_ HCP_Stop_Start_Fault : 21|1@0+ (1,0) [0|1] "-"  ECM
 SG_ MessageCounter_HYBRID_POWERTRAI_409 : 179|4@0+ (1,0) [0|15] "-"  ECM

BO_ 1952 HYBRID_HVAC: 32 Vector__XXX
 SG_ ElecClntHtrInletTemp : 39|8@0+ (1,-40) [-40|214] "°C"  ECM
 SG_ HTShtOffVlvReq : 47|1@0+ (1,0) [0|1] "-"  ECM
 SG_ HTAuxPmpRPMAct : 31|8@0+ (24,0) [0|6096] "rpm"  ECM
 SG_ HeaterCoreInletTemp : 7|8@0+ (1,-40) [-40|214] "°C"  ECM
 SG_ ElecCoolantHtrPwr : 23|8@0+ (0.04,0) [0|10.16] "kW"  ECM
 SG_ HTAuxPmpMontrngRPM : 89|2@0+ (1,0) [0|2] "-"  ECM

BO_ 1049 HYBRID_DISPLAY: 32 Vector__XXX
 SG_ HybridMILRequest : 135|1@0+ (1,0) [0|1] "-"  ECM

BO_ 1834 HVBATTERY5: 32 Vector__XXX
 SG_ HVBattery_RealTimeClockV : 36|1@0+ (1,0) [0|0] "-"  ECM
 SG_ HVBattery_RealTimeClock : 7|32@0+ (1,0) [0|4294967294] "sec"  ECM

BO_ 1029 HVBATTERY3: 32 Vector__XXX
 SG_ HVBatDischargePower_LongV : 107|1@0+ (1,0) [0|0] "-"  ECM
 SG_ HVBatChargePower_ShortV : 105|1@0+ (1,0) [0|0] "-"  ECM
 SG_ HVBatChargePower_Short : 15|8@0+ (0.5,0) [0|125] "kW"  ECM
 SG_ HVBatChargePower_LongV : 104|1@0+ (1,0) [0|0] "-"  ECM
 SG_ HVBatChargePower_Long : 7|8@0+ (0.5,0) [0|125] "kW"  ECM
 SG_ HVBatChargePower_InstantV : 106|1@0+ (1,0) [0|0] "-"  ECM
 SG_ HVBatChargePower_Instant : 23|8@0+ (0.5,0) [0|125] "kW"  ECM

BO_ 1027 HVBATTERY2: 32 Vector__XXX
 SG_ HVBatterySOCV : 52|1@0+ (1,0) [0|0] "-"  ECM
 SG_ HVBatterySOC : 3|12@0+ (0.02442,0) [0|100] "%"  ECM
 SG_ HVBatteryMILRequest : 7|1@0+ (1,0) [0|0] "-"  ECM

BO_ 266 HVBATTERY1: 32 Vector__XXX
 SG_ REPRGD_PFC_CLR_BPCM : 180|1@0+ (1,0) [0|0] "-"  ECM
 SG_ CODE_CLR_BPCM : 181|1@0+ (1,0) [0|0] "-"  ECM

BO_ 1031 HV_CHARGER1: 32 Vector__XXX
 SG_ REPRGD_PFC_CLR_IDCM : 181|1@0+ (1,0) [0|0] "-"  ECM
 SG_ CODE_CLR_IDCM : 180|1@0+ (1,0) [0|0] "-"  ECM

BO_ 833 GPF_DATA_FD_1: 32 Vector__XXX
 SG_ GPF_T1_TEMP : 87|16@0+ (0.03125,-273) [-273|1774.97] "deg"  ECM
 SG_ GPF_T1_Status : 116|5@0+ (1,0) [0|0] "-"  ECM

BO_ 1328 ENGINE_HYBD_FD_4: 32 ECM
 SG_ EngTorqCapbltyMinTorq : 51|12@0+ (0.32,-300.16) [-300.16|1008] "Nm"  Vector__XXX
 SG_ EngTorqCapbltyMaxTorq : 19|12@0+ (0.32,-300.16) [-300.16|1008] "Nm"  Vector__XXX
 SG_ EngTorqCapbltyMaxOffTorq : 3|12@0+ (0.32,-300.16) [-300.16|1008] "Nm"  Vector__XXX
 SG_ EngTorqCapbltyRefEngSpd : 71|8@0+ (32,0) [0|8160] "rpm"  Vector__XXX
 SG_ EngTorqCapbltyMinRunTorq : 35|12@0+ (0.32,-300.16) [-300.16|1008] "Nm"  Vector__XXX
 SG_ EngTorqCapbltyFrmCntr : 7|4@0+ (1,0) [0|15] "-"  Vector__XXX
 SG_ EngTorqCapbltyEngOpMd : 21|1@0+ (1,0) [0|0] "-"  Vector__XXX
 SG_ EngTorqACCCapability : 79|8@0+ (0.32,0) [0|81.28] "Nm"  Vector__XXX
 SG_ CatHtgStateActive : 20|1@0+ (1,0) [0|0] "-"  Vector__XXX
 SG_ MessageCounter_ENGINE_HYBD_FD_4 : 179|4@0+ (1,0) [0|15] "-"  Vector__XXX
 SG_ CRC_ENGINE_HYBD_FD_4 : 191|8@0+ (1,0) [0|255] "-"  Vector__XXX
 SG_ CatTempMaint : 23|1@0+ (1,0) [0|1] "-"  Vector__XXX

BO_ 1035 ENGINE_HYBD_FD_3: 32 ECM
 SG_ MaxEngSpdCap : 52|13@0+ (1,0) [0|8160] "rpm"  Vector__XXX
 SG_ EngHalfCylSpdMaxLim : 20|13@0+ (1,0) [0|8160] "rpm"  Vector__XXX
 SG_ ServiceHybSys : 55|1@0+ (1,0) [0|0] "-"  Vector__XXX
 SG_ RadFanReq : 158|7@0+ (1,0) [0|100] "%"  Vector__XXX
 SG_ PECP_PumpFlowReq : 150|7@0+ (1,0) [0|100] "%"  Vector__XXX
 SG_ MinEngSpdCap : 68|13@0+ (1,0) [0|8160] "rpm"  Vector__XXX
 SG_ EngSpdStat : 38|2@0+ (1,0) [0|0] "-"  Vector__XXX
 SG_ EngSpd : 7|16@0+ (0.125,0) [0|8160] "rpm"  Vector__XXX
 SG_ EngOutofFuel : 151|1@0+ (1,0) [0|0] "-"  Vector__XXX
 SG_ EngCltTmpV : 69|1@0+ (1,0) [0|1] "" Vector__XXX
 SG_ EngCltTmp : 167|8@0+ (1,-40) [-40|214] "°C"  Vector__XXX
 SG_ AGSposn : 134|7@0+ (1,0) [0|100] "%"  Vector__XXX
 SG_ AfterRunReq : 23|3@0+ (1,0) [0|0] "-"  Vector__XXX
 SG_ MessageCounter_ENGINE_HYBD_FD_3 : 179|4@0+ (1,0) [0|15] "-"  Vector__XXX
 SG_ CRC_ENGINE_HYBD_FD_3 : 191|8@0+ (1,0) [0|255] "-"  Vector__XXX
 SG_ LTR_PumpSpeedAct : 142|7@0+ (1,0) [0|100] "%"  Vector__XXX
 SG_ EngHalfCylSpdMinLim : 36|13@0+ (1,0) [0|8160] "rpm"  Vector__XXX
 SG_ Engine_Maintenance_Sts : 175|3@0+ (1,0) [0|7] "-"  Vector__XXX

BO_ 1036 ENGINE_FD_3: 32 ECM
 SG_ SpeedLimitSts : 159|3@0+ (1,0) [0|7] "-"  Vector__XXX
 SG_ Override : 163|1@0+ (1,0) [0|1] "-"  Vector__XXX
 SG_ OilLifeLeftRst : 165|1@0+ (1,0) [0|1] "-"  Vector__XXX
 SG_ OilLifeLeft : 135|8@0+ (1,0) [0|255] "%"  Vector__XXX
 SG_ OIL_TEMP_IND_RQ : 161|2@0+ (1,0) [0|3] "-"  Vector__XXX
 SG_ OIL_TEMP_CHM_RQ : 156|2@0+ (1,0) [0|3] "-"  Vector__XXX
 SG_ OIL_IND_LMP_FLSH : 154|1@0+ (1,0) [0|1] "-"  Vector__XXX
 SG_ EngineOilMin : 86|1@0+ (1,0) [0|1] "-"  Vector__XXX
 SG_ DistOilLifeRst : 143|16@0+ (1,0) [0|65535] "km"  Vector__XXX
 SG_ CC_SetSpdDspl_MPH : 127|8@0+ (1,0) [0|255] "mph"  Vector__XXX
 SG_ CC_SetSpdDspl_KPH : 108|13@0+ (0.0625,0) [0|511.875] "kph"  Vector__XXX
 SG_ MessageCounter_ENGINE3 : 179|4@0+ (1,0) [0|15] "-"  Vector__XXX
 SG_ ISASts : 167|1@0+ (1,0) [0|1] "-"  Vector__XXX
 SG_ FANStatus : 174|7@0+ (1,0) [0|100] "%"  Vector__XXX
 SG_ DefFuelEcon : 7|8@0+ (0.2,0) [0|50] "kmpl"  Vector__XXX
 SG_ CRC_ENGINE3 : 191|8@0+ (1,0) [0|255] "-"  Vector__XXX
 SG_ EngineOilTemperature : 103|8@0+ (1,-40) [-40|214] "°C"  Vector__XXX
 SG_ EngineOilOverfill : 85|1@0+ (1,0) [0|1] "-"  Vector__XXX
 SG_ EngineOilCritical : 175|1@0+ (1,0) [0|1] "-"  Vector__XXX
 SG_ AfterRunCoolantPumpFailSts : 166|1@0+ (1,0) [0|1] "-"  Vector__XXX
 SG_ EngineOilLevel : 84|5@0+ (1,0) [0|31] "" Vector__XXX
 SG_ Racemode_Popup_ECM : 63|7@0+ (1,0) [0|127] "" Vector__XXX
 SG_ Launch_Hard_Btn_LED_ECM : 49|2@0+ (1,0) [0|3] "" Vector__XXX

BO_ 950 CVPAM_FD_Info: 32 Vector__XXX
 SG_ SPMControlSts : 183|2@0+ (1,0) [0|1] "-"  ECM

BO_ 750 BCM_FD_3: 32 Vector__XXX
 SG_ Battery_Volt_2 : 49|9@0+ (0.025,5) [5|17.75] "Volt"  ECM
 SG_ Battery_Volt_1 : 56|9@0+ (0.025,5) [5|17.75] "Volt"  ECM

BO_ 1436 BCM_FD_27: 32 Vector__XXX
 SG_ Blower_Speed : 136|9@0+ (1,0) [0|350] "Hz"  ECM
 SG_ Blower_Diagnostics : 121|10@0+ (0.1,0) [0|100] "%"  ECM

BO_ 1435 BCM_FD_26: 32 Vector__XXX
 SG_ DRV_TEMP_DR_POS_PCT : 95|8@0+ (1,-20) [-20|120] "%"  ECM
 SG_ HAS_OnOffSts : 122|1@0+ (1,0) [0|1] "" ECM
 SG_ HVAC_CLNT_FLW_MIN : 47|8@0+ (0.52155,0) [0|132.4737] "LpM"  ECM

BO_ 610 ADAS_FD_INFO2: 32 Vector__XXX
 SG_ TSRSts : 175|2@0+ (1,0) [0|3] "-"  ECM

BO_ 1456 ADAS_FD_HMI: 32 Vector__XXX
 SG_ MessageCounter_ADAS_FD_HMI : 179|4@0+ (1,0) [0|15] "-"  ECM
 SG_ CRC_ADAS_FD_HMI : 191|8@0+ (1,0) [0|255] "-"  ECM
 SG_ Set_Speed_KPH : 7|8@0+ (1,0) [0|255] "kph"  ECM
 SG_ HAS_TelltaleSts : 54|3@0+ (1,0) [0|7] "-"  ECM

BO_ 278 TRANSM_FD_1: 64 Vector__XXX
 SG_ TransLosses : 241|10@0+ (1,-500) [-500|522] "Nm"  ECM
 SG_ TorqueConverterSts : 55|2@0+ (1,0) [0|3] "-"  ECM
 SG_ TorqueConverterSTO : 195|1@0+ (1,0) [0|1] "-"  ECM
 SG_ TCM_Req_EngSpeed_Sts : 391|1@0+ (1,0) [0|0] "-"  ECM
 SG_ TCM_Req_EngSpeed : 100|13@0+ (1,0) [0|8189] "RPM"  ECM
 SG_ TCM_HillMode : 257|10@0+ (0.01,0) [0|4] "-"  ECM
 SG_ TargetGear : 151|4@0+ (1,0) [0|15] "-"  ECM
 SG_ MaxTrqDes : 162|11@0+ (1,-500) [-500|1546] "Nm"  ECM
 SG_ EngTrq_Rq_TCM : 178|11@0+ (1,-500) [-500|1546] "Nm"  ECM
 SG_ DisconnectClutch_Sts : 103|3@0+ (1,0) [0|0] "-"  ECM
 SG_ CRC_TRANSM1 : 447|8@0+ (1,0) [0|255] "-"  ECM
 SG_ TCM_ParkSL_Request : 437|2@0+ (1,0) [0|2] "-"  ECM
 SG_ TCM_Comm_Fail_CAN : 396|3@0+ (1,0) [0|7] "-"  ECM
 SG_ REPRGD_PFC_CLR_TCM : 275|1@0+ (1,0) [0|0] "-"  ECM
 SG_ PaddleShiftRequest : 399|3@0+ (1,0) [0|6] "-"  ECM
 SG_ MessageCounter_TRANSM1 : 435|4@0+ (1,0) [0|15] "-"  ECM
 SG_ DriveLineRatio : 405|14@0+ (0.01,0) [0|163.83] "-"  ECM
 SG_ CODE_CLR_TCM : 258|1@0+ (1,0) [0|0] "-"  ECM
 SG_ TxIdleRq : 351|8@0+ (8,0) [0|2032] "rpm"  ECM
 SG_ TCASERANGESTATUS_TCM : 407|2@0+ (1,0) [0|2] "-"  ECM
 SG_ TorqueAmpTransmission : 330|11@0+ (0.01,0) [0|20.46] "-"  ECM
 SG_ TrqCtrlModeReq : 23|2@0+ (1,0) [0|2] "-"  ECM
 SG_ TCMLnchCtrlAllowed : 393|2@0+ (1,0) [0|3] "-"  ECM
 SG_ TransIntakeTorq : 210|11@0+ (1.2,-1200) [-1200|1255.2] "Nm"  ECM

CM_ SG_ 278 TCMLnchCtrlAllowed "Launch Control Allowed for TCM";
CM_ SG_ 278 DisconnectClutch_Sts "Operational status of the K0 clutch";
CM_ SG_ 278 EngTrq_Rq_TCM "Requested engine torque";
CM_ SG_ 278 MaxTrqDes "Maximum engine torque desired";
CM_ SG_ 278 TargetGear "Tells of the intended target gear that the transmission will be shifting to. Also includes an cancel shift that the DASM uses for better control.";
CM_ SG_ 278 TCM_HillMode "Active Hill Mode";
CM_ SG_ 278 TCM_Req_EngSpeed "TCM-specified target combustion engine speed during transition from EV to parallel mode.";
CM_ SG_ 278 MessageCounter_TRANSM1 "This signal is a counter used for safety checks strategies. This counter is incremented of 1 (one) unit at each frame transmission.";
CM_ SG_ 278 PaddleShiftRequest "Paddle shifter request by driver";
CM_ SG_ 278 REPRGD_PFC_CLR_TCM "Set readiness to incomplete";
CM_ SG_ 278 TCM_Comm_Fail_CAN "Communication fault on CAN detected by TCM.";
CM_ SG_ 278 TCM_ParkSL_Request "TCM requested park pawl solenoid status";
CM_ SG_ 278 CRC_TRANSM1 "CRC according to SAE J1850 standard at each frame transmission.";
CM_ SG_ 278 TransIntakeTorq "Transmission intake torque";
CM_ SG_ 278 TrqCtrlModeReq "Torque control mode request";
CM_ SG_ 278 TorqueAmpTransmission "It is the torque transmission ratio from gearbox primary to wheels, calculated by gearbox . It is only used in Automatic Transmission application";
CM_ SG_ 278 TCASERANGESTATUS_TCM "Transfer case Range status from Transmission";
CM_ SG_ 278 CODE_CLR_TCM "Clear emission related faults";
CM_ SG_ 278 DriveLineRatio "Drive Line Ratio";
CM_ SG_ 278 TCM_Req_EngSpeed_Sts "Flag to request Launch Clutch Input Speed [1]= Active";
CM_ SG_ 278 TorqueConverterSTO "Conf. (torque converter lock-up) Starts to open";
CM_ SG_ 278 TorqueConverterSts "This signal indicates the control phase of lockup clutch.";
CM_ SG_ 278 TransLosses "Transmission drag torques";
CM_ SG_ 278 TxIdleRq "-";
CM_ SG_ 1456 HAS_TelltaleSts "Highway Assist telltale status in cluster";
CM_ SG_ 1456 Set_Speed_KPH "Speed shown by IPC, which ACC is controlling in KPH";
CM_ SG_ 1456 CRC_ADAS_FD_HMI "CRC according to SAE J1850 standard at each frame transmission.";
CM_ SG_ 1456 MessageCounter_ADAS_FD_HMI "This signal is a counter used for safety checks strategies. This counter is incremented of 1 (one) unit at each frame transmission.";
CM_ SG_ 610 TSRSts "This signal indicates the Traffic Sign Recognition status";
CM_ SG_ 1435 HVAC_CLNT_FLW_MIN "HVAC coolant flow minimum request";
CM_ SG_ 1435 DRV_TEMP_DR_POS_PCT "HVAC Driver Temp Door Position in percentage coming from LIN Actuator";
CM_ SG_ 1435 HAS_OnOffSts "HAS request signal";
CM_ SG_ 1436 Blower_Diagnostics "Duty cycle Feedback received from the Blower";
CM_ SG_ 1436 Blower_Speed "Frequency Feedback received from the Blower";
CM_ SG_ 750 Battery_Volt_2 "Battery Volt 2 signal";
CM_ SG_ 750 Battery_Volt_1 "Battery Volt 1 signal";
CM_ SG_ 950 SPMControlSts "This signal indicates the activation state of the SPM module.";
CM_ SG_ 833 GPF_T1_Status "PRE GPF Temperature Sensor Status";
CM_ SG_ 833 GPF_T1_TEMP "PRE GPF Temperature Sensor";
CM_ SG_ 1031 CODE_CLR_IDCM "Clear emission related faults; [0] = not clear";
CM_ SG_ 1031 REPRGD_PFC_CLR_IDCM "Set readiness to 'incomplete'; [0] =  Do nothing";
CM_ SG_ 266 CODE_CLR_BPCM "Clear emission related faults; [0] = not clear; [1] = Clear";
CM_ SG_ 266 REPRGD_PFC_CLR_BPCM "Set readiness to 'incomplete' ; [0] = Do nothing, [1] = Set incomplete";
CM_ SG_ 1027 HVBatteryMILRequest "MIL Lamp request from BPCM.";
CM_ SG_ 1027 HVBatterySOC "High voltage battery pack state of charge";
CM_ SG_ 1027 HVBatterySOCV "High voltage battery state of charge validity. 0-Valid, 1-Invalid.";
CM_ SG_ 1029 HVBatChargePower_Long "High Voltage Battery Charge Power 30 seconds";
CM_ SG_ 1029 HVBatChargePower_LongV "High voltage battery charge power 30 seconds validity; Invalid = [1]";
CM_ SG_ 1029 HVBatChargePower_Short "Eunjoo ??";
CM_ SG_ 1029 HVBatChargePower_ShortV "High voltage battery charge power 10 seconds validity; Invalid = [1]";
CM_ SG_ 1029 HVBatDischargePower_LongV "High voltage battery discharge power 30 seconds validity; Invalid = [1]";
CM_ SG_ 1029 HVBatChargePower_Instant "High Voltage Battery Charge Power 2 seconds";
CM_ SG_ 1029 HVBatChargePower_InstantV "High voltage battery charge power 2 seconds validity; Invalid = [1]";
CM_ SG_ 1834 HVBattery_RealTimeClock "32 bit Real Time Clock";
CM_ SG_ 1834 HVBattery_RealTimeClockV "-";
CM_ SG_ 1049 HybridMILRequest "MIL on request from the HCP";
CM_ SG_ 1952 HTAuxPmpMontrngRPM "High Temp Aux Pump RPM monitoring active";
CM_ SG_ 1952 ElecCoolantHtrPwr "Electric Coolant Heater Power";
CM_ SG_ 1952 HeaterCoreInletTemp "Heater Core Inlet Temp";
CM_ SG_ 1952 HTAuxPmpRPMAct "High Temp Aux Pump Status";
CM_ SG_ 1952 HTShtOffVlvReq "High temp shut off valve request; [0] = Open, [1] = Closed";
CM_ SG_ 1952 ElecClntHtrInletTemp "Electric Coolant Heater Inlet Temperature";
CM_ SG_ 1033 CRC_HYBRID_POWERTRAIN5 "CRC according to SAE J1850 standard at each frame transmission.";
CM_ SG_ 1033 Hybrid_Immobilizer_Status "System shutdown command from HCP";
CM_ SG_ 1033 MessageCounter_HYBRID_POWERTRAI_409 "This signal is a counter used for safety checks strategies. This counter is incremented of 1 (one) unit at each frame transmission.";
CM_ SG_ 1033 ElectricTrqMult4Pedal "Adjustment factor for elctric components of pedal max torque.";
CM_ SG_ 1033 Force_Park_Neutral "Request to park or Neutral";
CM_ SG_ 1033 HCPMaxEngRPM "Engine rev limit due to HCP/MGU limits";
CM_ SG_ 1033 HEV_HybPwrtrnRdcdPerfCmnd "Driver torque request modifier due to system remedial acion";
CM_ SG_ 1033 IdleCLoopTrq "Electric motor PID torque to maintain idle speed.";
CM_ SG_ 1033 HCP_Stop_Start_Fault "Stop/Start Fault, [1] = Active";
CM_ SG_ 1032 PE_CoolTempIn "Coolant temperature at Power Electronics Inlet";
CM_ SG_ 1032 AirflowRequest "Air Flow Request";
CM_ SG_ 1032 PE_CoolTempOut "Coolant temperature at Power Electronics outlet.";
CM_ SG_ 1032 PECP_PumpSpeedActual "Power Electronics Coolant pump actual speed";
CM_ SG_ 1032 PECP2_PumpSpeedActual "Power Electronics Coolant Pump 2 actual speed";
CM_ SG_ 1032 RadiatorFanSts "Radiator Fan state";
CM_ SG_ 752 CRC_IBS3DATA1 "CRC according to SAE J1850 standard at each frame transmission.";
CM_ SG_ 752 MessageCounter_IBS3DATA1 "This signal is a counter used for safety checks strategies. This counter is incremented of 1 (one) unit at each frame transmission.";
CM_ SG_ 752 IBS3_SOF_V_Accuracy "SOF_V accuracy; Data reliable = [0], unreliable = [1]";
CM_ SG_ 752 CurrBattFailStatus "Failure Status of Current meas. (internal defect)";
CM_ SG_ 752 IBS3_Error_Internal "Error in IBS calibration data; No Error = [0], Error = [1]";
CM_ SG_ 752 RsErrIBS3 "Response Error IBS; Error=[1]";
CM_ SG_ 752 VoltBattFailStatus "Failure Status of Voltage meas. (internal defect)";
CM_ SG_ 752 IBS3_Ibatt "Battery current";
CM_ SG_ 752 IBS3_SOF_VC "Predicted initial battery voltage dip during cranking (old CG spec)";
CM_ SG_ 752 IBS3_Vbatt "Battery voltage measured at the terminals";
CM_ SG_ 1443 Dist_Unit "Distance Unit setting";
CM_ SG_ 1443 New_Spd_Zone_Ind "New Speed Zone Indication setting";
CM_ SG_ 1443 Speed_Unit "Speed Unit setting";
CM_ SG_ 1443 Traffic_Sign_Info "Traffic Sign Information setting";
CM_ SG_ 753 CRC_LV_CHARGER1 "CRC according to SAE J1850 standard at each frame transmission.";
CM_ SG_ 753 MessageCounter_LV_CHARGER1 "This signal is a counter used for safety checks strategies. This counter is incremented of 1 (one) unit at each frame transmission.";
CM_ SG_ 753 LVDC_CurrentFeedback "Low side current feedback";
CM_ SG_ 1036 ISASts "This signal will be used to indicate when the Intelligent Speed Assist is Active";
CM_ SG_ 1036 MessageCounter_ENGINE3 "This signal is a counter used for safety checks strategies. This counter is incremented of 1 (one) unit at each frame transmission.";
CM_ SG_ 1036 CC_SetSpdDspl_KPH "Cruise Control Vehicle Set Speed in Kilometer Per Hour";
CM_ SG_ 1036 EngineOilTemperature "Engine Oil Temperature";
CM_ SG_ 1036 CRC_ENGINE3 "CRC according to SAE J1850 standard at each frame transmission.";
CM_ SG_ 1036 DefFuelEcon "Provides defined fuel economy for display in the cluster";
CM_ SG_ 1036 OilLifeLeftRst "This signal is the reset acknowledge";
CM_ SG_ 1036 Override "-";
CM_ SG_ 1036 SpeedLimitSts "It represents on C-CAN the actual status of speed limiter control function.";
CM_ SG_ 1035 LTR_PumpSpeedAct "Low temperature radiator pump actual flow speed";
CM_ SG_ 1035 EngCltTmpV "Engine Coolant Temperature Validity";
CM_ SG_ 1035 EngOutofFuel "Engine System Failed (limp home = 1)";
CM_ SG_ 1035 EngSpd "Engine speed";
CM_ SG_ 1035 EngSpdStat "Engine speed status";
CM_ SG_ 1035 MinEngSpdCap "Minimum Engine Speed Capacity";
CM_ SG_ 1035 PECP_PumpFlowReq "Power Electronics Coolant pump flowrate request from ECM";
CM_ SG_ 1035 Engine_Maintenance_Sts "Indication to HCP of engine maintenance modes to enable EV mode.";
CM_ SG_ 1035 CRC_ENGINE_HYBD_FD_3 "CRC according to SAE J1850 standard at each frame transmission.";
CM_ SG_ 1035 MessageCounter_ENGINE_HYBD_FD_3 "This signal is a counter used for safety checks strategies. This counter is incremented of 1 (one) unit at each frame transmission.";
CM_ SG_ 1035 AfterRunReq "Pump after-run request from ECM";
CM_ SG_ 1035 AGSposn ".";
CM_ SG_ 1035 EngCltTmp "Engine Coolant Temp";
CM_ SG_ 1035 RadFanReq "Radiator Fan request";
CM_ SG_ 1035 ServiceHybSys "Service Hybrid system; True = [1]";
CM_ SG_ 1035 EngHalfCylSpdMinLim "Engine Half Cylinder Speed Minimum Limit";
CM_ SG_ 1035 EngHalfCylSpdMaxLim "Engine Half Cylinder Speed Maximum Limit";
CM_ SG_ 1035 MaxEngSpdCap "Maximum Engine Speed Capacity";
CM_ SG_ 1328 EngTorqACCCapability "Eng Trq to be subtracted from the entire capability curve on the HCP side";
CM_ SG_ 1328 EngTorqCapbltyEngOpMd "Engine operating mode [0] = non-MDS, [1] = MDS";
CM_ SG_ 1328 EngTorqCapbltyFrmCntr "Engine Torque Capability: Frame Counter (4 bit)";
CM_ SG_ 1328 EngTorqCapbltyMinRunTorq "Engine torque capability: minimum run torque (fuel on)";
CM_ SG_ 1328 EngTorqCapbltyRefEngSpd "Engine torque capability: reference engine speed";
CM_ SG_ 1328 CatTempMaint "Catalyst Temperature Maintenance Flag";
CM_ SG_ 1328 CRC_ENGINE_HYBD_FD_4 "CRC according to SAE J1850 standard at each frame transmission.";
CM_ SG_ 1328 MessageCounter_ENGINE_HYBD_FD_4 "This signal is a counter used for safety checks strategies. This counter is incremented of 1 (one) unit at each frame transmission.";
CM_ SG_ 1328 CatHtgStateActive "Catalysator Heating Status Request, 0- no request, 1 - request";
CM_ SG_ 1328 EngTorqCapbltyMaxOffTorq "Capability Max-off";
CM_ SG_ 1328 EngTorqCapbltyMaxTorq "Engine torque capability: maximum torque";
CM_ SG_ 1328 EngTorqCapbltyMinTorq "Engine torque capability: minimum torque (fuel off)";
CM_ SG_ 1036 EngineOilCritical "Engine Oil Level Critically low";
CM_ SG_ 1036 AfterRunCoolantPumpFailSts "The signal indicates a fault on AfterRunCoolant Pump";
CM_ SG_ 1036 EngineOilMin "Oil Minimum indicator";
CM_ SG_ 1036 EngineOilOverfill "Oil Overfill indicator";
CM_ SG_ 1036 EngineOilLevel "Engine Oil Level";
CM_ SG_ 1036 Racemode_Popup_ECM "Racemode popup signal from ECM";
CM_ SG_ 1036 Launch_Hard_Btn_LED_ECM "launch hard LED button";
CM_ SG_ 1036 CC_SetSpdDspl_MPH "Cruise Control Vehicle Set Speed in Miles Per Hour";
CM_ SG_ 1036 DistOilLifeRst "This signal sends the distance since oil life reset.";
CM_ SG_ 1036 OIL_IND_LMP_FLSH "Oil indicator lamp flash (for in plant use)";
CM_ SG_ 1036 OIL_TEMP_CHM_RQ "Oil temperature chime request";
CM_ SG_ 1036 OIL_TEMP_IND_RQ "Oil temperature indicator request";
CM_ SG_ 1036 OilLifeLeft "This signal sends the oil life left percentage.";
CM_ SG_ 1036 FANStatus "ECM Fan status feedback";
BA_DEF_ SG_ "GenSigTimeoutTime_ADCAM" INT 0 65535;
BA_DEF_ SG_ "GenSigTimeoutTime_EVCU2" INT 0 65535;
BA_DEF_ SG_ "GenSigTimeoutTime_VDCM" INT 0 65535;
BA_DEF_ SG_ "GenSigStartValue" INT 0 2147483647;
BA_DEF_ SG_ "GenSigInactiveValue" INT 0 2147483647;
BA_DEF_ SG_ "GenSigSendType" ENUM "NotUsed","OnWrite","OnWriteWithRepetition","OnChange","OnChangeWithRepetition","IfActive","IfActiveWithRepetition","NoSigSendType";
BA_DEF_ SG_ "SystemSignalLongSymbol" STRING ;
BA_DEF_ SG_ "GenSigTimeoutTime_AGSM" INT 0 65535;
BA_DEF_ SG_ "GenSigTimeoutTime_ASBS" INT 0 65535;
BA_DEF_ SG_ "GenSigTimeoutTime_BCM" INT 0 65535;
BA_DEF_ SG_ "GenSigTimeoutTime_BSM" INT 0 65535;
BA_DEF_ SG_ "GenSigTimeoutTime_CADM" INT 0 65535;
BA_DEF_ SG_ "GenSigTimeoutTime_DMSM" INT 0 65535;
BA_DEF_ SG_ "GenSigTimeoutTime_DTCM" INT 0 65535;
BA_DEF_ SG_ "GenSigTimeoutTime_ECM" INT 0 65535;
BA_DEF_ SG_ "GenSigTimeoutTime_ELSDM" INT 0 65535;
BA_DEF_ SG_ "GenSigTimeoutTime_ESL" INT 0 65535;
BA_DEF_ SG_ "GenSigTimeoutTime_GNMM" INT 0 65535;
BA_DEF_ SG_ "GenSigTimeoutTime_HCP" INT 0 65535;
BA_DEF_ SG_ "GenSigTimeoutTime_IPC" INT 0 65535;
BA_DEF_ SG_ "GenSigTimeoutTime_RFHM" INT 0 65535;
BA_DEF_ SG_ "GenSigTimeoutTime_SGW" INT 0 65535;
BA_DEF_ SG_ "GenSigTimeoutTime_TCM" INT 0 65535;
BA_DEF_ BO_ "DiagRequest" ENUM "No","Yes";
BA_DEF_ BO_ "Type" ENUM "P","C","PE","COC","PE_Cntrl","E","E_Cntrl","OC","S","BAF","DC","EM","MM","ISO-TP","-";
BA_DEF_ BO_ "DiagResponse" ENUM "No","Yes";
BA_DEF_ BO_ "NmMessage" ENUM "No","Yes";
BA_DEF_ BO_ "GenMsgSendType" ENUM "Cyclic","NotUsed","NotUsed","NotUsed","NotUsed","NotUsed","NotUsed","NotUsed","NoMsgSendType";
BA_DEF_ BO_ "GenMsgNrOfRepetition" INT 0 255;
BA_DEF_ BO_ "GenMsgILSupport" ENUM "No","Yes";
BA_DEF_ BO_ "GenMsgStartDelayTime" INT 0 65535;
BA_DEF_ BO_ "GenMsgCycleTimeFast" INT 0 65535;
BA_DEF_ BO_ "GenMsgCycleTime" INT 0 65535;
BA_DEF_ BO_ "GenMsgDelayTime" INT 0 65535;
BA_DEF_ BO_ "NmAsrMessage" ENUM "No","Yes";
BA_DEF_ BO_ "DiagState" ENUM "No","Yes";
BA_DEF_ BO_ "DiagConnection" HEX 0 65535;
BA_DEF_ BO_ "VFrameFormat" ENUM "StandardCAN","ExtendedCAN","reserved","reserved","reserved","reserved","reserved","reserved","reserved","reserved","reserved","reserved","reserved","reserved","StandardCAN_FD","ExtendedCAN_FD";
BA_DEF_ BO_ "CANFD_BRS" ENUM "0","1";
BA_DEF_DEF_ "GenSigTimeoutTime_ADCAM" 2500;
BA_DEF_DEF_ "GenSigTimeoutTime_EVCU2" 2500;
BA_DEF_DEF_ "GenSigTimeoutTime_VDCM" 2500;
BA_DEF_DEF_ "GenSigStartValue" 0;
BA_DEF_DEF_ "GenSigInactiveValue" 0;
BA_DEF_DEF_ "GenSigSendType" "NoSigSendType";
BA_DEF_DEF_ "SystemSignalLongSymbol" "";
BA_DEF_DEF_ "GenSigTimeoutTime_AGSM" 2500;
BA_DEF_DEF_ "GenSigTimeoutTime_ASBS" 2500;
BA_DEF_DEF_ "GenSigTimeoutTime_BCM" 2500;
BA_DEF_DEF_ "GenSigTimeoutTime_BSM" 2500;
BA_DEF_DEF_ "GenSigTimeoutTime_CADM" 2500;
BA_DEF_DEF_ "GenSigTimeoutTime_DMSM" 2500;
BA_DEF_DEF_ "GenSigTimeoutTime_DTCM" 2500;
BA_DEF_DEF_ "GenSigTimeoutTime_ECM" 2500;
BA_DEF_DEF_ "GenSigTimeoutTime_ELSDM" 2500;
BA_DEF_DEF_ "GenSigTimeoutTime_ESL" 2500;
BA_DEF_DEF_ "GenSigTimeoutTime_GNMM" 2500;
BA_DEF_DEF_ "GenSigTimeoutTime_HCP" 2500;
BA_DEF_DEF_ "GenSigTimeoutTime_IPC" 2500;
BA_DEF_DEF_ "GenSigTimeoutTime_RFHM" 2500;
BA_DEF_DEF_ "GenSigTimeoutTime_SGW" 2500;
BA_DEF_DEF_ "GenSigTimeoutTime_TCM" 2500;
BA_DEF_DEF_ "DiagRequest" "No";
BA_DEF_DEF_ "Type" "-";
BA_DEF_DEF_ "DiagResponse" "No";
BA_DEF_DEF_ "NmMessage" "No";
BA_DEF_DEF_ "GenMsgSendType" "NoMsgSendType";
BA_DEF_DEF_ "GenMsgNrOfRepetition" 0;
BA_DEF_DEF_ "GenMsgILSupport" "No";
BA_DEF_DEF_ "GenMsgStartDelayTime" 0;
BA_DEF_DEF_ "GenMsgCycleTimeFast" 0;
BA_DEF_DEF_ "GenMsgCycleTime" 0;
BA_DEF_DEF_ "GenMsgDelayTime" 0;
BA_DEF_DEF_ "NmAsrMessage" "No";
BA_DEF_DEF_ "DiagState" "No";
BA_DEF_DEF_ "DiagConnection" 0;
BA_DEF_DEF_ "VFrameFormat" "StandardCAN_FD";
BA_DEF_DEF_ "CANFD_BRS" "0";
BA_ "GenMsgCycleTime" BO_ 1049 100;
BA_ "CANFD_BRS" BO_ 1049 1;
BA_ "Type" BO_ 1952 1;
BA_ "GenMsgSendType" BO_ 1952 0;
BA_ "GenMsgILSupport" BO_ 1952 1;
BA_ "GenMsgCycleTime" BO_ 1952 1000;
BA_ "CANFD_BRS" BO_ 1952 1;
BA_ "Type" BO_ 1033 1;
BA_ "GenMsgSendType" BO_ 1033 0;
BA_ "GenMsgILSupport" BO_ 1033 1;
BA_ "GenMsgCycleTime" BO_ 1033 100;
BA_ "CANFD_BRS" BO_ 1033 1;
BA_ "Type" BO_ 1032 1;
BA_ "GenMsgSendType" BO_ 1032 0;
BA_ "GenMsgILSupport" BO_ 1032 1;
BA_ "GenMsgCycleTime" BO_ 1032 100;
BA_ "CANFD_BRS" BO_ 1032 1;
BA_ "Type" BO_ 752 1;
BA_ "GenMsgSendType" BO_ 752 0;
BA_ "GenMsgILSupport" BO_ 752 1;
BA_ "GenMsgStartDelayTime" BO_ 752 40;
BA_ "GenMsgCycleTime" BO_ 752 50;
BA_ "CANFD_BRS" BO_ 752 1;
BA_ "Type" BO_ 1443 3;
BA_ "GenMsgSendType" BO_ 1443 0;
BA_ "GenMsgNrOfRepetition" BO_ 1443 2;
BA_ "GenMsgILSupport" BO_ 1443 1;
BA_ "GenMsgCycleTimeFast" BO_ 1443 20;
BA_ "GenMsgCycleTime" BO_ 1443 1000;
BA_ "GenMsgDelayTime" BO_ 1443 20;
BA_ "Type" BO_ 1036 3;
BA_ "GenMsgSendType" BO_ 1036 0;
BA_ "GenMsgNrOfRepetition" BO_ 1036 2;
BA_ "GenMsgILSupport" BO_ 1036 1;
BA_ "GenMsgStartDelayTime" BO_ 1036 90;
BA_ "GenMsgCycleTimeFast" BO_ 1036 20;
BA_ "GenMsgCycleTime" BO_ 1036 100;
BA_ "GenMsgDelayTime" BO_ 1036 20;
BA_ "CANFD_BRS" BO_ 1036 1;
BA_ "Type" BO_ 1035 1;
BA_ "GenMsgSendType" BO_ 1035 0;
BA_ "GenMsgILSupport" BO_ 1035 1;
BA_ "GenMsgCycleTime" BO_ 1035 100;
BA_ "CANFD_BRS" BO_ 1035 1;
BA_ "Type" BO_ 1328 1;
BA_ "GenMsgSendType" BO_ 1328 0;
BA_ "GenMsgILSupport" BO_ 1328 1;
BA_ "GenMsgCycleTime" BO_ 1328 200;
BA_ "CANFD_BRS" BO_ 1328 1;
BA_ "Type" BO_ 278 1;
BA_ "GenMsgSendType" BO_ 278 0;
BA_ "GenMsgILSupport" BO_ 278 1;
BA_ "GenMsgStartDelayTime" BO_ 278 5;
BA_ "GenMsgCycleTime" BO_ 278 10;
BA_ "CANFD_BRS" BO_ 278 1;
BA_ "Type" BO_ 1456 3;
BA_ "GenMsgSendType" BO_ 1456 0;
BA_ "GenMsgILSupport" BO_ 1456 1;
BA_ "GenMsgCycleTime" BO_ 1456 100;
BA_ "GenMsgDelayTime" BO_ 1456 20;
BA_ "CANFD_BRS" BO_ 1456 1;
BA_ "Type" BO_ 610 3;
BA_ "GenMsgSendType" BO_ 610 0;
BA_ "GenMsgNrOfRepetition" BO_ 610 2;
BA_ "GenMsgILSupport" BO_ 610 1;
BA_ "GenMsgCycleTimeFast" BO_ 610 20;
BA_ "GenMsgCycleTime" BO_ 610 100;
BA_ "GenMsgDelayTime" BO_ 610 20;
BA_ "CANFD_BRS" BO_ 610 1;
BA_ "Type" BO_ 1435 3;
BA_ "GenMsgSendType" BO_ 1435 0;
BA_ "GenMsgNrOfRepetition" BO_ 1435 2;
BA_ "GenMsgILSupport" BO_ 1435 1;
BA_ "GenMsgStartDelayTime" BO_ 1435 395;
BA_ "GenMsgCycleTimeFast" BO_ 1435 20;
BA_ "GenMsgCycleTime" BO_ 1435 1000;
BA_ "GenMsgDelayTime" BO_ 1435 20;
BA_ "CANFD_BRS" BO_ 1435 1;
BA_ "Type" BO_ 1436 3;
BA_ "GenMsgSendType" BO_ 1436 0;
BA_ "GenMsgNrOfRepetition" BO_ 1436 2;
BA_ "GenMsgILSupport" BO_ 1436 1;
BA_ "CANFD_BRS" BO_ 1443 1;
BA_ "Type" BO_ 753 1;
BA_ "GenMsgSendType" BO_ 753 0;
BA_ "GenMsgILSupport" BO_ 753 1;
BA_ "GenMsgCycleTime" BO_ 753 50;
BA_ "CANFD_BRS" BO_ 753 1;
BA_ "GenMsgStartDelayTime" BO_ 1436 400;
BA_ "GenMsgCycleTimeFast" BO_ 1436 20;
BA_ "GenMsgCycleTime" BO_ 1436 1000;
BA_ "GenMsgDelayTime" BO_ 1436 20;
BA_ "CANFD_BRS" BO_ 1436 1;
BA_ "Type" BO_ 750 1;
BA_ "GenMsgSendType" BO_ 750 0;
BA_ "GenMsgILSupport" BO_ 750 1;
BA_ "GenMsgStartDelayTime" BO_ 750 35;
BA_ "GenMsgCycleTime" BO_ 750 50;
BA_ "CANFD_BRS" BO_ 750 1;
BA_ "Type" BO_ 950 3;
BA_ "GenMsgSendType" BO_ 950 0;
BA_ "GenMsgILSupport" BO_ 950 1;
BA_ "GenMsgStartDelayTime" BO_ 950 45;
BA_ "GenMsgCycleTime" BO_ 950 250;
BA_ "CANFD_BRS" BO_ 950 1;
BA_ "Type" BO_ 833 1;
BA_ "GenMsgSendType" BO_ 833 0;
BA_ "GenMsgNrOfRepetition" BO_ 833 2;
BA_ "GenMsgILSupport" BO_ 833 1;
BA_ "GenMsgStartDelayTime" BO_ 833 60;
BA_ "GenMsgCycleTimeFast" BO_ 833 20;
BA_ "GenMsgCycleTime" BO_ 833 500;
BA_ "GenMsgDelayTime" BO_ 833 20;
BA_ "CANFD_BRS" BO_ 833 1;
BA_ "Type" BO_ 1031 1;
BA_ "GenMsgSendType" BO_ 1031 0;
BA_ "GenMsgILSupport" BO_ 1031 1;
BA_ "GenMsgCycleTime" BO_ 1031 100;
BA_ "CANFD_BRS" BO_ 1031 1;
BA_ "Type" BO_ 266 1;
BA_ "GenMsgSendType" BO_ 266 0;
BA_ "GenMsgILSupport" BO_ 266 1;
BA_ "GenMsgCycleTime" BO_ 266 10;
BA_ "CANFD_BRS" BO_ 266 1;
BA_ "Type" BO_ 1027 1;
BA_ "GenMsgSendType" BO_ 1027 0;
BA_ "GenMsgILSupport" BO_ 1027 1;
BA_ "GenMsgCycleTime" BO_ 1027 100;
BA_ "CANFD_BRS" BO_ 1027 1;
BA_ "Type" BO_ 1029 1;
BA_ "GenMsgSendType" BO_ 1029 0;
BA_ "GenMsgILSupport" BO_ 1029 1;
BA_ "GenMsgCycleTime" BO_ 1029 100;
BA_ "CANFD_BRS" BO_ 1029 1;
BA_ "Type" BO_ 1834 1;
BA_ "GenMsgSendType" BO_ 1834 0;
BA_ "GenMsgILSupport" BO_ 1834 1;
BA_ "GenMsgCycleTime" BO_ 1834 1000;
BA_ "CANFD_BRS" BO_ 1834 1;
BA_ "Type" BO_ 1049 1;
BA_ "GenMsgSendType" BO_ 1049 0;
BA_ "GenMsgILSupport" BO_ 1049 1;
BA_ "GenSigSendType" SG_ 950 SPMControlSts 3;
BA_ "GenSigTimeoutTime_TCM" SG_ 752 IBS3_SOF_VC 0;
BA_ "GenSigTimeoutTime_IPC" SG_ 1033 IdleCLoopTrq 0;
BA_ "GenSigTimeoutTime_RFHM" SG_ 1033 IdleCLoopTrq 0;
BA_ "GenSigTimeoutTime_SGW" SG_ 1033 IdleCLoopTrq 0;
BA_ "GenSigTimeoutTime_TCM" SG_ 1033 IdleCLoopTrq 0;
BA_ "GenSigTimeoutTime_AGSM" SG_ 1033 HCP_Stop_Start_Fault 0;
BA_ "GenSigTimeoutTime_ASBS" SG_ 1033 HCP_Stop_Start_Fault 0;
BA_ "GenSigTimeoutTime_BCM" SG_ 1033 HCP_Stop_Start_Fault 0;
BA_ "GenSigTimeoutTime_BSM" SG_ 1033 HCP_Stop_Start_Fault 0;
BA_ "GenSigTimeoutTime_CADM" SG_ 1033 HCP_Stop_Start_Fault 0;
BA_ "GenSigTimeoutTime_DMSM" SG_ 1033 HCP_Stop_Start_Fault 0;
BA_ "GenSigTimeoutTime_DTCM" SG_ 1033 HCP_Stop_Start_Fault 0;
BA_ "GenSigTimeoutTime_ELSDM" SG_ 1033 HCP_Stop_Start_Fault 0;
BA_ "GenSigTimeoutTime_ESL" SG_ 1033 HCP_Stop_Start_Fault 0;
BA_ "GenSigTimeoutTime_GNMM" SG_ 1033 HCP_Stop_Start_Fault 0;
BA_ "GenSigTimeoutTime_HCP" SG_ 1033 HCP_Stop_Start_Fault 0;
BA_ "GenSigTimeoutTime_IPC" SG_ 1033 HCP_Stop_Start_Fault 0;
BA_ "GenSigTimeoutTime_RFHM" SG_ 1033 HCP_Stop_Start_Fault 0;
BA_ "GenSigTimeoutTime_SGW" SG_ 1033 HCP_Stop_Start_Fault 0;
BA_ "GenSigTimeoutTime_TCM" SG_ 1033 HCP_Stop_Start_Fault 0;
BA_ "GenSigStartValue" SG_ 1032 PE_CoolTempIn 255;
BA_ "GenSigTimeoutTime_AGSM" SG_ 1032 PE_CoolTempIn 0;
BA_ "GenSigTimeoutTime_ASBS" SG_ 1032 PE_CoolTempIn 0;
BA_ "GenSigTimeoutTime_BCM" SG_ 1032 PE_CoolTempIn 0;
BA_ "GenSigTimeoutTime_BSM" SG_ 1032 PE_CoolTempIn 0;
BA_ "GenSigTimeoutTime_CADM" SG_ 1032 PE_CoolTempIn 0;
BA_ "GenSigTimeoutTime_DMSM" SG_ 1032 PE_CoolTempIn 0;
BA_ "GenSigTimeoutTime_DTCM" SG_ 1032 PE_CoolTempIn 0;
BA_ "GenSigTimeoutTime_ELSDM" SG_ 1032 PE_CoolTempIn 0;
BA_ "GenSigTimeoutTime_ESL" SG_ 1032 PE_CoolTempIn 0;
BA_ "GenSigTimeoutTime_GNMM" SG_ 1032 PE_CoolTempIn 0;
BA_ "GenSigTimeoutTime_HCP" SG_ 1032 PE_CoolTempIn 0;
BA_ "GenSigTimeoutTime_IPC" SG_ 1032 PE_CoolTempIn 0;
BA_ "GenSigTimeoutTime_RFHM" SG_ 1032 PE_CoolTempIn 0;
BA_ "GenSigTimeoutTime_SGW" SG_ 1032 PE_CoolTempIn 0;
BA_ "GenSigTimeoutTime_TCM" SG_ 1032 PE_CoolTempIn 0;
BA_ "GenSigTimeoutTime_AGSM" SG_ 1032 AirflowRequest 0;
BA_ "GenSigTimeoutTime_ASBS" SG_ 1032 AirflowRequest 0;
BA_ "GenSigTimeoutTime_BCM" SG_ 1032 AirflowRequest 0;
BA_ "GenSigTimeoutTime_BSM" SG_ 1032 AirflowRequest 0;
BA_ "GenSigTimeoutTime_CADM" SG_ 1032 AirflowRequest 0;
BA_ "GenSigTimeoutTime_DMSM" SG_ 1032 AirflowRequest 0;
BA_ "GenSigTimeoutTime_DTCM" SG_ 1032 AirflowRequest 0;
BA_ "GenSigTimeoutTime_ELSDM" SG_ 1032 AirflowRequest 0;
BA_ "GenSigTimeoutTime_ESL" SG_ 1032 AirflowRequest 0;
BA_ "GenSigTimeoutTime_GNMM" SG_ 1032 AirflowRequest 0;
BA_ "GenSigTimeoutTime_HCP" SG_ 1032 AirflowRequest 0;
BA_ "GenSigTimeoutTime_IPC" SG_ 1032 AirflowRequest 0;
BA_ "GenSigTimeoutTime_RFHM" SG_ 1032 AirflowRequest 0;
BA_ "GenSigTimeoutTime_SGW" SG_ 1032 AirflowRequest 0;
BA_ "GenSigTimeoutTime_TCM" SG_ 1032 AirflowRequest 0;
BA_ "GenSigStartValue" SG_ 1032 PE_CoolTempOut 255;
BA_ "GenSigTimeoutTime_AGSM" SG_ 1032 PE_CoolTempOut 0;
BA_ "GenSigTimeoutTime_ASBS" SG_ 1032 PE_CoolTempOut 0;
BA_ "GenSigTimeoutTime_BCM" SG_ 1032 PE_CoolTempOut 0;
BA_ "GenSigTimeoutTime_BSM" SG_ 1032 PE_CoolTempOut 0;
BA_ "GenSigTimeoutTime_CADM" SG_ 1032 PE_CoolTempOut 0;
BA_ "GenSigTimeoutTime_DMSM" SG_ 1032 PE_CoolTempOut 0;
BA_ "GenSigTimeoutTime_DTCM" SG_ 1032 PE_CoolTempOut 0;
BA_ "GenSigTimeoutTime_ELSDM" SG_ 1032 PE_CoolTempOut 0;
BA_ "GenSigTimeoutTime_ESL" SG_ 1032 PE_CoolTempOut 0;
BA_ "GenSigTimeoutTime_GNMM" SG_ 1032 PE_CoolTempOut 0;
BA_ "GenSigTimeoutTime_HCP" SG_ 1032 PE_CoolTempOut 0;
BA_ "GenSigTimeoutTime_IPC" SG_ 1032 PE_CoolTempOut 0;
BA_ "GenSigTimeoutTime_RFHM" SG_ 1032 PE_CoolTempOut 0;
BA_ "GenSigTimeoutTime_SGW" SG_ 1032 PE_CoolTempOut 0;
BA_ "GenSigTimeoutTime_TCM" SG_ 1032 PE_CoolTempOut 0;
BA_ "GenSigTimeoutTime_AGSM" SG_ 1032 PECP_PumpSpeedActual 0;
BA_ "GenSigTimeoutTime_ASBS" SG_ 1032 PECP_PumpSpeedActual 0;
BA_ "GenSigTimeoutTime_BCM" SG_ 1032 PECP_PumpSpeedActual 0;
BA_ "GenSigTimeoutTime_BSM" SG_ 1032 PECP_PumpSpeedActual 0;
BA_ "GenSigTimeoutTime_CADM" SG_ 1032 PECP_PumpSpeedActual 0;
BA_ "GenSigTimeoutTime_DMSM" SG_ 1032 PECP_PumpSpeedActual 0;
BA_ "GenSigTimeoutTime_DTCM" SG_ 1032 PECP_PumpSpeedActual 0;
BA_ "GenSigTimeoutTime_ELSDM" SG_ 1032 PECP_PumpSpeedActual 0;
BA_ "GenSigTimeoutTime_ESL" SG_ 1032 PECP_PumpSpeedActual 0;
BA_ "GenSigTimeoutTime_GNMM" SG_ 1032 PECP_PumpSpeedActual 0;
BA_ "GenSigTimeoutTime_HCP" SG_ 1032 PECP_PumpSpeedActual 0;
BA_ "GenSigTimeoutTime_IPC" SG_ 1032 PECP_PumpSpeedActual 0;
BA_ "GenSigTimeoutTime_RFHM" SG_ 1032 PECP_PumpSpeedActual 0;
BA_ "GenSigTimeoutTime_SGW" SG_ 1032 PECP_PumpSpeedActual 0;
BA_ "GenSigTimeoutTime_TCM" SG_ 1032 PECP_PumpSpeedActual 0;
BA_ "GenSigTimeoutTime_AGSM" SG_ 1032 PECP2_PumpSpeedActual 0;
BA_ "GenSigTimeoutTime_ASBS" SG_ 1032 PECP2_PumpSpeedActual 0;
BA_ "GenSigTimeoutTime_BCM" SG_ 1032 PECP2_PumpSpeedActual 0;
BA_ "GenSigTimeoutTime_BSM" SG_ 1032 PECP2_PumpSpeedActual 0;
BA_ "GenSigTimeoutTime_CADM" SG_ 1032 PECP2_PumpSpeedActual 0;
BA_ "GenSigTimeoutTime_DMSM" SG_ 1032 PECP2_PumpSpeedActual 0;
BA_ "GenSigTimeoutTime_DTCM" SG_ 1032 PECP2_PumpSpeedActual 0;
BA_ "GenSigTimeoutTime_ELSDM" SG_ 1032 PECP2_PumpSpeedActual 0;
BA_ "GenSigTimeoutTime_ESL" SG_ 1032 PECP2_PumpSpeedActual 0;
BA_ "GenSigTimeoutTime_GNMM" SG_ 1032 PECP2_PumpSpeedActual 0;
BA_ "GenSigTimeoutTime_HCP" SG_ 1032 PECP2_PumpSpeedActual 0;
BA_ "GenSigTimeoutTime_IPC" SG_ 1032 PECP2_PumpSpeedActual 0;
BA_ "GenSigTimeoutTime_RFHM" SG_ 1032 PECP2_PumpSpeedActual 0;
BA_ "GenSigTimeoutTime_SGW" SG_ 1032 PECP2_PumpSpeedActual 0;
BA_ "GenSigTimeoutTime_TCM" SG_ 1032 PECP2_PumpSpeedActual 0;
BA_ "GenSigTimeoutTime_AGSM" SG_ 1032 RadiatorFanSts 0;
BA_ "GenSigTimeoutTime_ASBS" SG_ 1032 RadiatorFanSts 0;
BA_ "GenSigTimeoutTime_BCM" SG_ 1032 RadiatorFanSts 0;
BA_ "GenSigTimeoutTime_BSM" SG_ 1032 RadiatorFanSts 0;
BA_ "GenSigTimeoutTime_CADM" SG_ 1032 RadiatorFanSts 0;
BA_ "GenSigTimeoutTime_DMSM" SG_ 1032 RadiatorFanSts 0;
BA_ "GenSigTimeoutTime_DTCM" SG_ 1032 RadiatorFanSts 0;
BA_ "GenSigTimeoutTime_ELSDM" SG_ 1032 RadiatorFanSts 0;
BA_ "GenSigTimeoutTime_ESL" SG_ 1032 RadiatorFanSts 0;
BA_ "GenSigTimeoutTime_GNMM" SG_ 1032 RadiatorFanSts 0;
BA_ "GenSigTimeoutTime_HCP" SG_ 1032 RadiatorFanSts 0;
BA_ "GenSigTimeoutTime_IPC" SG_ 1032 RadiatorFanSts 0;
BA_ "GenSigTimeoutTime_RFHM" SG_ 1032 RadiatorFanSts 0;
BA_ "GenSigTimeoutTime_SGW" SG_ 1032 RadiatorFanSts 0;
BA_ "GenSigTimeoutTime_TCM" SG_ 1032 RadiatorFanSts 0;
BA_ "GenSigTimeoutTime_ADCAM" SG_ 752 CRC_IBS3DATA1 0;
BA_ "GenSigTimeoutTime_VDCM" SG_ 752 CRC_IBS3DATA1 0;
BA_ "GenSigTimeoutTime_AGSM" SG_ 752 CRC_IBS3DATA1 0;
BA_ "GenSigTimeoutTime_BCM" SG_ 752 CRC_IBS3DATA1 0;
BA_ "GenSigTimeoutTime_BSM" SG_ 752 CRC_IBS3DATA1 0;
BA_ "GenSigTimeoutTime_DTCM" SG_ 752 CRC_IBS3DATA1 0;
BA_ "GenSigTimeoutTime_ESL" SG_ 752 CRC_IBS3DATA1 0;
BA_ "GenSigTimeoutTime_IPC" SG_ 752 CRC_IBS3DATA1 0;
BA_ "GenSigTimeoutTime_RFHM" SG_ 752 CRC_IBS3DATA1 0;
BA_ "GenSigTimeoutTime_SGW" SG_ 752 CRC_IBS3DATA1 0;
BA_ "GenSigTimeoutTime_TCM" SG_ 752 CRC_IBS3DATA1 0;
BA_ "GenSigTimeoutTime_ADCAM" SG_ 752 MessageCounter_IBS3DATA1 0;
BA_ "GenSigTimeoutTime_VDCM" SG_ 752 MessageCounter_IBS3DATA1 0;
BA_ "GenSigTimeoutTime_AGSM" SG_ 752 MessageCounter_IBS3DATA1 0;
BA_ "GenSigTimeoutTime_BCM" SG_ 752 MessageCounter_IBS3DATA1 0;
BA_ "GenSigTimeoutTime_BSM" SG_ 752 MessageCounter_IBS3DATA1 0;
BA_ "GenSigTimeoutTime_DTCM" SG_ 752 MessageCounter_IBS3DATA1 0;
BA_ "GenSigTimeoutTime_ESL" SG_ 752 MessageCounter_IBS3DATA1 0;
BA_ "GenSigTimeoutTime_IPC" SG_ 752 MessageCounter_IBS3DATA1 0;
BA_ "GenSigTimeoutTime_RFHM" SG_ 752 MessageCounter_IBS3DATA1 0;
BA_ "GenSigTimeoutTime_SGW" SG_ 752 MessageCounter_IBS3DATA1 0;
BA_ "GenSigTimeoutTime_TCM" SG_ 752 MessageCounter_IBS3DATA1 0;
BA_ "GenSigTimeoutTime_ADCAM" SG_ 752 IBS3_SOF_V_Accuracy 0;
BA_ "GenSigTimeoutTime_VDCM" SG_ 752 IBS3_SOF_V_Accuracy 0;
BA_ "GenSigTimeoutTime_ADCAM" SG_ 752 CurrBattFailStatus 0;
BA_ "GenSigTimeoutTime_VDCM" SG_ 752 CurrBattFailStatus 0;
BA_ "GenSigTimeoutTime_ADCAM" SG_ 752 IBS3_Error_Internal 0;
BA_ "GenSigTimeoutTime_VDCM" SG_ 752 IBS3_Error_Internal 0;
BA_ "GenSigTimeoutTime_ADCAM" SG_ 752 RsErrIBS3 0;
BA_ "GenSigTimeoutTime_VDCM" SG_ 752 RsErrIBS3 0;
BA_ "GenSigTimeoutTime_ADCAM" SG_ 752 VoltBattFailStatus 0;
BA_ "GenSigTimeoutTime_VDCM" SG_ 752 VoltBattFailStatus 0;
BA_ "GenSigTimeoutTime_ADCAM" SG_ 752 IBS3_Ibatt 0;
BA_ "GenSigTimeoutTime_VDCM" SG_ 752 IBS3_Ibatt 0;
BA_ "GenSigTimeoutTime_ADCAM" SG_ 752 IBS3_SOF_VC 0;
BA_ "GenSigTimeoutTime_VDCM" SG_ 752 IBS3_SOF_VC 0;
BA_ "GenSigTimeoutTime_ADCAM" SG_ 752 IBS3_Vbatt 0;
BA_ "GenSigTimeoutTime_VDCM" SG_ 752 IBS3_Vbatt 0;
BA_ "GenSigStartValue" SG_ 752 IBS3_SOF_V_Accuracy 1;
BA_ "GenSigTimeoutTime_AGSM" SG_ 752 IBS3_SOF_V_Accuracy 0;
BA_ "GenSigTimeoutTime_ASBS" SG_ 752 IBS3_SOF_V_Accuracy 0;
BA_ "GenSigTimeoutTime_BCM" SG_ 752 IBS3_SOF_V_Accuracy 0;
BA_ "GenSigTimeoutTime_BSM" SG_ 752 IBS3_SOF_V_Accuracy 0;
BA_ "GenSigTimeoutTime_CADM" SG_ 752 IBS3_SOF_V_Accuracy 0;
BA_ "GenSigTimeoutTime_DMSM" SG_ 752 IBS3_SOF_V_Accuracy 0;
BA_ "GenSigTimeoutTime_DTCM" SG_ 752 IBS3_SOF_V_Accuracy 0;
BA_ "GenSigTimeoutTime_ELSDM" SG_ 752 IBS3_SOF_V_Accuracy 0;
BA_ "GenSigTimeoutTime_ESL" SG_ 752 IBS3_SOF_V_Accuracy 0;
BA_ "GenSigTimeoutTime_GNMM" SG_ 752 IBS3_SOF_V_Accuracy 0;
BA_ "GenSigTimeoutTime_HCP" SG_ 752 IBS3_SOF_V_Accuracy 0;
BA_ "GenSigTimeoutTime_IPC" SG_ 752 IBS3_SOF_V_Accuracy 0;
BA_ "GenSigTimeoutTime_RFHM" SG_ 752 IBS3_SOF_V_Accuracy 0;
BA_ "GenSigTimeoutTime_SGW" SG_ 752 IBS3_SOF_V_Accuracy 0;
BA_ "GenSigTimeoutTime_TCM" SG_ 752 IBS3_SOF_V_Accuracy 0;
BA_ "GenSigTimeoutTime_AGSM" SG_ 752 CurrBattFailStatus 0;
BA_ "GenSigTimeoutTime_ASBS" SG_ 752 CurrBattFailStatus 0;
BA_ "GenSigTimeoutTime_BCM" SG_ 752 CurrBattFailStatus 0;
BA_ "GenSigTimeoutTime_BSM" SG_ 752 CurrBattFailStatus 0;
BA_ "GenSigTimeoutTime_CADM" SG_ 752 CurrBattFailStatus 0;
BA_ "GenSigTimeoutTime_DMSM" SG_ 752 CurrBattFailStatus 0;
BA_ "GenSigTimeoutTime_DTCM" SG_ 752 CurrBattFailStatus 0;
BA_ "GenSigTimeoutTime_ELSDM" SG_ 752 CurrBattFailStatus 0;
BA_ "GenSigTimeoutTime_ESL" SG_ 752 CurrBattFailStatus 0;
BA_ "GenSigTimeoutTime_GNMM" SG_ 752 CurrBattFailStatus 0;
BA_ "GenSigTimeoutTime_IPC" SG_ 752 CurrBattFailStatus 0;
BA_ "GenSigTimeoutTime_RFHM" SG_ 752 CurrBattFailStatus 0;
BA_ "GenSigTimeoutTime_SGW" SG_ 752 CurrBattFailStatus 0;
BA_ "GenSigTimeoutTime_TCM" SG_ 752 CurrBattFailStatus 0;
BA_ "GenSigTimeoutTime_AGSM" SG_ 752 IBS3_Error_Internal 0;
BA_ "GenSigTimeoutTime_ASBS" SG_ 752 IBS3_Error_Internal 0;
BA_ "GenSigTimeoutTime_AGSM" SG_ 950 SPMControlSts 0;
BA_ "GenSigTimeoutTime_ASBS" SG_ 950 SPMControlSts 0;
BA_ "GenSigTimeoutTime_BCM" SG_ 950 SPMControlSts 0;
BA_ "GenSigTimeoutTime_BSM" SG_ 950 SPMControlSts 0;
BA_ "GenSigTimeoutTime_CADM" SG_ 950 SPMControlSts 0;
BA_ "GenSigTimeoutTime_DMSM" SG_ 950 SPMControlSts 0;
BA_ "GenSigTimeoutTime_DTCM" SG_ 950 SPMControlSts 0;
BA_ "GenSigTimeoutTime_ELSDM" SG_ 950 SPMControlSts 0;
BA_ "GenSigTimeoutTime_ESL" SG_ 950 SPMControlSts 0;
BA_ "GenSigTimeoutTime_GNMM" SG_ 950 SPMControlSts 0;
BA_ "GenSigTimeoutTime_HCP" SG_ 950 SPMControlSts 0;
BA_ "GenSigTimeoutTime_RFHM" SG_ 950 SPMControlSts 0;
BA_ "GenSigTimeoutTime_SGW" SG_ 950 SPMControlSts 0;
BA_ "GenSigTimeoutTime_TCM" SG_ 950 SPMControlSts 0;
BA_ "GenSigTimeoutTime_AGSM" SG_ 833 GPF_T1_Status 0;
BA_ "GenSigTimeoutTime_ASBS" SG_ 833 GPF_T1_Status 0;
BA_ "GenSigTimeoutTime_BCM" SG_ 833 GPF_T1_Status 0;
BA_ "GenSigTimeoutTime_BSM" SG_ 833 GPF_T1_Status 0;
BA_ "GenSigTimeoutTime_CADM" SG_ 833 GPF_T1_Status 0;
BA_ "GenSigTimeoutTime_DMSM" SG_ 833 GPF_T1_Status 0;
BA_ "GenSigTimeoutTime_DTCM" SG_ 833 GPF_T1_Status 0;
BA_ "GenSigTimeoutTime_ELSDM" SG_ 833 GPF_T1_Status 0;
BA_ "GenSigTimeoutTime_ESL" SG_ 833 GPF_T1_Status 0;
BA_ "GenSigTimeoutTime_GNMM" SG_ 833 GPF_T1_Status 0;
BA_ "GenSigTimeoutTime_HCP" SG_ 833 GPF_T1_Status 0;
BA_ "GenSigTimeoutTime_IPC" SG_ 833 GPF_T1_Status 0;
BA_ "GenSigTimeoutTime_RFHM" SG_ 833 GPF_T1_Status 0;
BA_ "GenSigTimeoutTime_SGW" SG_ 833 GPF_T1_Status 0;
BA_ "GenSigTimeoutTime_TCM" SG_ 833 GPF_T1_Status 0;
BA_ "GenSigStartValue" SG_ 833 GPF_T1_TEMP 25;
BA_ "GenSigTimeoutTime_AGSM" SG_ 833 GPF_T1_TEMP 0;
BA_ "GenSigTimeoutTime_ASBS" SG_ 833 GPF_T1_TEMP 0;
BA_ "GenSigTimeoutTime_BCM" SG_ 833 GPF_T1_TEMP 0;
BA_ "GenSigTimeoutTime_BSM" SG_ 833 GPF_T1_TEMP 0;
BA_ "GenSigTimeoutTime_CADM" SG_ 833 GPF_T1_TEMP 0;
BA_ "GenSigTimeoutTime_DMSM" SG_ 833 GPF_T1_TEMP 0;
BA_ "GenSigTimeoutTime_DTCM" SG_ 833 GPF_T1_TEMP 0;
BA_ "GenSigTimeoutTime_ELSDM" SG_ 833 GPF_T1_TEMP 0;
BA_ "GenSigTimeoutTime_ESL" SG_ 833 GPF_T1_TEMP 0;
BA_ "GenSigTimeoutTime_GNMM" SG_ 833 GPF_T1_TEMP 0;
BA_ "GenSigTimeoutTime_HCP" SG_ 833 GPF_T1_TEMP 0;
BA_ "GenSigTimeoutTime_IPC" SG_ 833 GPF_T1_TEMP 0;
BA_ "GenSigTimeoutTime_RFHM" SG_ 833 GPF_T1_TEMP 0;
BA_ "GenSigTimeoutTime_SGW" SG_ 833 GPF_T1_TEMP 0;
BA_ "GenSigTimeoutTime_TCM" SG_ 833 GPF_T1_TEMP 0;
BA_ "GenSigTimeoutTime_AGSM" SG_ 1031 CODE_CLR_IDCM 0;
BA_ "GenSigTimeoutTime_ASBS" SG_ 1031 CODE_CLR_IDCM 0;
BA_ "GenSigTimeoutTime_BCM" SG_ 1031 CODE_CLR_IDCM 0;
BA_ "GenSigTimeoutTime_BSM" SG_ 1031 CODE_CLR_IDCM 0;
BA_ "GenSigTimeoutTime_CADM" SG_ 1031 CODE_CLR_IDCM 0;
BA_ "GenSigTimeoutTime_DMSM" SG_ 1031 CODE_CLR_IDCM 0;
BA_ "GenSigTimeoutTime_DTCM" SG_ 1031 CODE_CLR_IDCM 0;
BA_ "GenSigTimeoutTime_ELSDM" SG_ 1031 CODE_CLR_IDCM 0;
BA_ "GenSigTimeoutTime_ESL" SG_ 1031 CODE_CLR_IDCM 0;
BA_ "GenSigTimeoutTime_GNMM" SG_ 1031 CODE_CLR_IDCM 0;
BA_ "GenSigTimeoutTime_HCP" SG_ 1031 CODE_CLR_IDCM 0;
BA_ "GenSigTimeoutTime_IPC" SG_ 1031 CODE_CLR_IDCM 0;
BA_ "GenSigTimeoutTime_RFHM" SG_ 1031 CODE_CLR_IDCM 0;
BA_ "GenSigTimeoutTime_SGW" SG_ 1031 CODE_CLR_IDCM 0;
BA_ "GenSigTimeoutTime_TCM" SG_ 1031 CODE_CLR_IDCM 0;
BA_ "GenSigTimeoutTime_AGSM" SG_ 1031 REPRGD_PFC_CLR_IDCM 0;
BA_ "GenSigTimeoutTime_ASBS" SG_ 1031 REPRGD_PFC_CLR_IDCM 0;
BA_ "GenSigTimeoutTime_BCM" SG_ 1031 REPRGD_PFC_CLR_IDCM 0;
BA_ "GenSigTimeoutTime_BSM" SG_ 1031 REPRGD_PFC_CLR_IDCM 0;
BA_ "GenSigTimeoutTime_CADM" SG_ 1031 REPRGD_PFC_CLR_IDCM 0;
BA_ "GenSigTimeoutTime_DMSM" SG_ 1031 REPRGD_PFC_CLR_IDCM 0;
BA_ "GenSigTimeoutTime_DTCM" SG_ 1031 REPRGD_PFC_CLR_IDCM 0;
BA_ "GenSigTimeoutTime_ELSDM" SG_ 1031 REPRGD_PFC_CLR_IDCM 0;
BA_ "GenSigTimeoutTime_ESL" SG_ 1031 REPRGD_PFC_CLR_IDCM 0;
BA_ "GenSigTimeoutTime_GNMM" SG_ 1031 REPRGD_PFC_CLR_IDCM 0;
BA_ "GenSigTimeoutTime_HCP" SG_ 1031 REPRGD_PFC_CLR_IDCM 0;
BA_ "GenSigTimeoutTime_IPC" SG_ 1031 REPRGD_PFC_CLR_IDCM 0;
BA_ "GenSigTimeoutTime_RFHM" SG_ 1031 REPRGD_PFC_CLR_IDCM 0;
BA_ "GenSigTimeoutTime_SGW" SG_ 1031 REPRGD_PFC_CLR_IDCM 0;
BA_ "GenSigTimeoutTime_TCM" SG_ 1031 REPRGD_PFC_CLR_IDCM 0;
BA_ "GenSigTimeoutTime_AGSM" SG_ 266 CODE_CLR_BPCM 0;
BA_ "GenSigTimeoutTime_ASBS" SG_ 266 CODE_CLR_BPCM 0;
BA_ "GenSigTimeoutTime_BCM" SG_ 266 CODE_CLR_BPCM 0;
BA_ "GenSigTimeoutTime_BSM" SG_ 266 CODE_CLR_BPCM 0;
BA_ "GenSigTimeoutTime_CADM" SG_ 266 CODE_CLR_BPCM 0;
BA_ "GenSigTimeoutTime_DMSM" SG_ 266 CODE_CLR_BPCM 0;
BA_ "GenSigTimeoutTime_DTCM" SG_ 266 CODE_CLR_BPCM 0;
BA_ "GenSigTimeoutTime_ELSDM" SG_ 266 CODE_CLR_BPCM 0;
BA_ "GenSigTimeoutTime_ESL" SG_ 266 CODE_CLR_BPCM 0;
BA_ "GenSigTimeoutTime_GNMM" SG_ 266 CODE_CLR_BPCM 0;
BA_ "GenSigTimeoutTime_HCP" SG_ 266 CODE_CLR_BPCM 0;
BA_ "GenSigTimeoutTime_IPC" SG_ 266 CODE_CLR_BPCM 0;
BA_ "GenSigTimeoutTime_RFHM" SG_ 266 CODE_CLR_BPCM 0;
BA_ "GenSigTimeoutTime_SGW" SG_ 266 CODE_CLR_BPCM 0;
BA_ "GenSigTimeoutTime_TCM" SG_ 266 CODE_CLR_BPCM 0;
BA_ "GenSigTimeoutTime_AGSM" SG_ 266 REPRGD_PFC_CLR_BPCM 0;
BA_ "GenSigTimeoutTime_ASBS" SG_ 266 REPRGD_PFC_CLR_BPCM 0;
BA_ "GenSigTimeoutTime_BCM" SG_ 266 REPRGD_PFC_CLR_BPCM 0;
BA_ "GenSigTimeoutTime_BSM" SG_ 266 REPRGD_PFC_CLR_BPCM 0;
BA_ "GenSigTimeoutTime_CADM" SG_ 266 REPRGD_PFC_CLR_BPCM 0;
BA_ "GenSigTimeoutTime_DMSM" SG_ 266 REPRGD_PFC_CLR_BPCM 0;
BA_ "GenSigTimeoutTime_DTCM" SG_ 266 REPRGD_PFC_CLR_BPCM 0;
BA_ "GenSigTimeoutTime_ELSDM" SG_ 266 REPRGD_PFC_CLR_BPCM 0;
BA_ "GenSigTimeoutTime_ESL" SG_ 266 REPRGD_PFC_CLR_BPCM 0;
BA_ "GenSigTimeoutTime_GNMM" SG_ 266 REPRGD_PFC_CLR_BPCM 0;
BA_ "GenSigTimeoutTime_HCP" SG_ 266 REPRGD_PFC_CLR_BPCM 0;
BA_ "GenSigTimeoutTime_IPC" SG_ 266 REPRGD_PFC_CLR_BPCM 0;
BA_ "GenSigTimeoutTime_RFHM" SG_ 266 REPRGD_PFC_CLR_BPCM 0;
BA_ "GenSigTimeoutTime_SGW" SG_ 266 REPRGD_PFC_CLR_BPCM 0;
BA_ "GenSigTimeoutTime_TCM" SG_ 266 REPRGD_PFC_CLR_BPCM 0;
BA_ "GenSigTimeoutTime_AGSM" SG_ 1027 HVBatteryMILRequest 0;
BA_ "GenSigTimeoutTime_ASBS" SG_ 1027 HVBatteryMILRequest 0;
BA_ "GenSigTimeoutTime_BCM" SG_ 1027 HVBatteryMILRequest 0;
BA_ "GenSigTimeoutTime_BSM" SG_ 1027 HVBatteryMILRequest 0;
BA_ "GenSigTimeoutTime_CADM" SG_ 1027 HVBatteryMILRequest 0;
BA_ "GenSigTimeoutTime_DMSM" SG_ 1027 HVBatteryMILRequest 0;
BA_ "GenSigTimeoutTime_DTCM" SG_ 1027 HVBatteryMILRequest 0;
BA_ "GenSigTimeoutTime_ELSDM" SG_ 1027 HVBatteryMILRequest 0;
BA_ "GenSigTimeoutTime_ESL" SG_ 1027 HVBatteryMILRequest 0;
BA_ "GenSigTimeoutTime_GNMM" SG_ 1027 HVBatteryMILRequest 0;
BA_ "GenSigTimeoutTime_HCP" SG_ 1027 HVBatteryMILRequest 0;
BA_ "GenSigTimeoutTime_RFHM" SG_ 1027 HVBatteryMILRequest 0;
BA_ "GenSigTimeoutTime_TCM" SG_ 1027 HVBatteryMILRequest 0;
BA_ "GenSigStartValue" SG_ 1027 HVBatterySOC 2048;
BA_ "GenSigTimeoutTime_AGSM" SG_ 1027 HVBatterySOC 0;
BA_ "GenSigTimeoutTime_ASBS" SG_ 1027 HVBatterySOC 0;
BA_ "GenSigTimeoutTime_BCM" SG_ 1027 HVBatterySOC 0;
BA_ "GenSigTimeoutTime_CADM" SG_ 1027 HVBatterySOC 0;
BA_ "GenSigTimeoutTime_DMSM" SG_ 1027 HVBatterySOC 0;
BA_ "GenSigTimeoutTime_DTCM" SG_ 1027 HVBatterySOC 0;
BA_ "GenSigTimeoutTime_ELSDM" SG_ 1027 HVBatterySOC 0;
BA_ "GenSigTimeoutTime_ESL" SG_ 1027 HVBatterySOC 0;
BA_ "GenSigTimeoutTime_GNMM" SG_ 1027 HVBatterySOC 0;
BA_ "GenSigTimeoutTime_HCP" SG_ 1027 HVBatterySOC 0;
BA_ "GenSigTimeoutTime_IPC" SG_ 1027 HVBatterySOC 0;
BA_ "GenSigTimeoutTime_RFHM" SG_ 1027 HVBatterySOC 0;
BA_ "GenSigTimeoutTime_SGW" SG_ 1027 HVBatterySOC 0;
BA_ "GenSigTimeoutTime_TCM" SG_ 1027 HVBatterySOC 0;
BA_ "GenSigStartValue" SG_ 1027 HVBatterySOCV 1;
BA_ "GenSigTimeoutTime_AGSM" SG_ 1027 HVBatterySOCV 0;
BA_ "GenSigTimeoutTime_ASBS" SG_ 1027 HVBatterySOCV 0;
BA_ "GenSigTimeoutTime_BCM" SG_ 1027 HVBatterySOCV 0;
BA_ "GenSigTimeoutTime_BSM" SG_ 1027 HVBatterySOCV 0;
BA_ "GenSigTimeoutTime_CADM" SG_ 1027 HVBatterySOCV 0;
BA_ "GenSigTimeoutTime_DMSM" SG_ 1027 HVBatterySOCV 0;
BA_ "GenSigTimeoutTime_DTCM" SG_ 1027 HVBatterySOCV 0;
BA_ "GenSigTimeoutTime_ELSDM" SG_ 1027 HVBatterySOCV 0;
BA_ "GenSigTimeoutTime_ESL" SG_ 1027 HVBatterySOCV 0;
BA_ "GenSigTimeoutTime_GNMM" SG_ 1027 HVBatterySOCV 0;
BA_ "GenSigTimeoutTime_HCP" SG_ 1027 HVBatterySOCV 0;
BA_ "GenSigTimeoutTime_IPC" SG_ 1027 HVBatterySOCV 0;
BA_ "GenSigTimeoutTime_RFHM" SG_ 1027 HVBatterySOCV 0;
BA_ "GenSigTimeoutTime_SGW" SG_ 1027 HVBatterySOCV 0;
BA_ "GenSigTimeoutTime_TCM" SG_ 1027 HVBatterySOCV 0;
BA_ "GenSigTimeoutTime_AGSM" SG_ 1029 HVBatChargePower_Long 0;
BA_ "GenSigTimeoutTime_ASBS" SG_ 1029 HVBatChargePower_Long 0;
BA_ "GenSigTimeoutTime_BCM" SG_ 1029 HVBatChargePower_Long 0;
BA_ "GenSigTimeoutTime_BSM" SG_ 1029 HVBatChargePower_Long 0;
BA_ "GenSigTimeoutTime_CADM" SG_ 1029 HVBatChargePower_Long 0;
BA_ "GenSigTimeoutTime_DMSM" SG_ 1029 HVBatChargePower_Long 0;
BA_ "GenSigTimeoutTime_DTCM" SG_ 1029 HVBatChargePower_Long 0;
BA_ "GenSigTimeoutTime_ELSDM" SG_ 1029 HVBatChargePower_Long 0;
BA_ "GenSigTimeoutTime_ESL" SG_ 1029 HVBatChargePower_Long 0;
BA_ "GenSigTimeoutTime_GNMM" SG_ 1029 HVBatChargePower_Long 0;
BA_ "GenSigTimeoutTime_HCP" SG_ 1029 HVBatChargePower_Long 0;
BA_ "GenSigTimeoutTime_IPC" SG_ 1029 HVBatChargePower_Long 0;
BA_ "GenSigTimeoutTime_RFHM" SG_ 1029 HVBatChargePower_Long 0;
BA_ "GenSigTimeoutTime_SGW" SG_ 1029 HVBatChargePower_Long 0;
BA_ "GenSigTimeoutTime_TCM" SG_ 1029 HVBatChargePower_Long 0;
BA_ "GenSigTimeoutTime_AGSM" SG_ 1029 HVBatChargePower_LongV 0;
BA_ "GenSigTimeoutTime_ASBS" SG_ 1029 HVBatChargePower_LongV 0;
BA_ "GenSigTimeoutTime_BCM" SG_ 1029 HVBatChargePower_LongV 0;
BA_ "GenSigTimeoutTime_BSM" SG_ 1029 HVBatChargePower_LongV 0;
BA_ "GenSigTimeoutTime_CADM" SG_ 1029 HVBatChargePower_LongV 0;
BA_ "GenSigTimeoutTime_DMSM" SG_ 1029 HVBatChargePower_LongV 0;
BA_ "GenSigTimeoutTime_DTCM" SG_ 1029 HVBatChargePower_LongV 0;
BA_ "GenSigTimeoutTime_ELSDM" SG_ 1029 HVBatChargePower_LongV 0;
BA_ "GenSigTimeoutTime_ESL" SG_ 1029 HVBatChargePower_LongV 0;
BA_ "GenSigTimeoutTime_GNMM" SG_ 1029 HVBatChargePower_LongV 0;
BA_ "GenSigTimeoutTime_HCP" SG_ 1029 HVBatChargePower_LongV 0;
BA_ "GenSigTimeoutTime_IPC" SG_ 1029 HVBatChargePower_LongV 0;
BA_ "GenSigTimeoutTime_RFHM" SG_ 1029 HVBatChargePower_LongV 0;
BA_ "GenSigTimeoutTime_SGW" SG_ 1029 HVBatChargePower_LongV 0;
BA_ "GenSigTimeoutTime_TCM" SG_ 1029 HVBatChargePower_LongV 0;
BA_ "GenSigTimeoutTime_AGSM" SG_ 1029 HVBatChargePower_Short 0;
BA_ "GenSigTimeoutTime_ASBS" SG_ 1029 HVBatChargePower_Short 0;
BA_ "GenSigTimeoutTime_BCM" SG_ 1029 HVBatChargePower_Short 0;
BA_ "GenSigTimeoutTime_BSM" SG_ 1029 HVBatChargePower_Short 0;
BA_ "GenSigTimeoutTime_CADM" SG_ 1029 HVBatChargePower_Short 0;
BA_ "GenSigTimeoutTime_DMSM" SG_ 1029 HVBatChargePower_Short 0;
BA_ "GenSigTimeoutTime_DTCM" SG_ 1029 HVBatChargePower_Short 0;
BA_ "GenSigTimeoutTime_ELSDM" SG_ 1029 HVBatChargePower_Short 0;
BA_ "GenSigTimeoutTime_ESL" SG_ 1029 HVBatChargePower_Short 0;
BA_ "GenSigTimeoutTime_GNMM" SG_ 1029 HVBatChargePower_Short 0;
BA_ "GenSigTimeoutTime_HCP" SG_ 1029 HVBatChargePower_Short 0;
BA_ "GenSigTimeoutTime_IPC" SG_ 1029 HVBatChargePower_Short 0;
BA_ "GenSigTimeoutTime_RFHM" SG_ 1029 HVBatChargePower_Short 0;
BA_ "GenSigTimeoutTime_SGW" SG_ 1029 HVBatChargePower_Short 0;
BA_ "GenSigTimeoutTime_TCM" SG_ 1029 HVBatChargePower_Short 0;
BA_ "GenSigTimeoutTime_AGSM" SG_ 1029 HVBatChargePower_ShortV 0;
BA_ "GenSigTimeoutTime_ASBS" SG_ 1029 HVBatChargePower_ShortV 0;
BA_ "GenSigTimeoutTime_BCM" SG_ 1029 HVBatChargePower_ShortV 0;
BA_ "GenSigTimeoutTime_BSM" SG_ 1029 HVBatChargePower_ShortV 0;
BA_ "GenSigTimeoutTime_CADM" SG_ 1029 HVBatChargePower_ShortV 0;
BA_ "GenSigTimeoutTime_DMSM" SG_ 1029 HVBatChargePower_ShortV 0;
BA_ "GenSigTimeoutTime_DTCM" SG_ 1029 HVBatChargePower_ShortV 0;
BA_ "GenSigTimeoutTime_ELSDM" SG_ 1029 HVBatChargePower_ShortV 0;
BA_ "GenSigTimeoutTime_ESL" SG_ 1029 HVBatChargePower_ShortV 0;
BA_ "GenSigTimeoutTime_GNMM" SG_ 1029 HVBatChargePower_ShortV 0;
BA_ "GenSigTimeoutTime_HCP" SG_ 1029 HVBatChargePower_ShortV 0;
BA_ "GenSigTimeoutTime_IPC" SG_ 1029 HVBatChargePower_ShortV 0;
BA_ "GenSigTimeoutTime_RFHM" SG_ 1029 HVBatChargePower_ShortV 0;
BA_ "GenSigTimeoutTime_SGW" SG_ 1029 HVBatChargePower_ShortV 0;
BA_ "GenSigTimeoutTime_TCM" SG_ 1029 HVBatChargePower_ShortV 0;
BA_ "GenSigTimeoutTime_AGSM" SG_ 1029 HVBatDischargePower_LongV 0;
BA_ "GenSigTimeoutTime_ASBS" SG_ 1029 HVBatDischargePower_LongV 0;
BA_ "GenSigTimeoutTime_BCM" SG_ 1029 HVBatDischargePower_LongV 0;
BA_ "GenSigTimeoutTime_BSM" SG_ 1029 HVBatDischargePower_LongV 0;
BA_ "GenSigTimeoutTime_CADM" SG_ 1029 HVBatDischargePower_LongV 0;
BA_ "GenSigTimeoutTime_DMSM" SG_ 1029 HVBatDischargePower_LongV 0;
BA_ "GenSigTimeoutTime_DTCM" SG_ 1029 HVBatDischargePower_LongV 0;
BA_ "GenSigTimeoutTime_ELSDM" SG_ 1029 HVBatDischargePower_LongV 0;
BA_ "GenSigTimeoutTime_ESL" SG_ 1029 HVBatDischargePower_LongV 0;
BA_ "GenSigTimeoutTime_GNMM" SG_ 1029 HVBatDischargePower_LongV 0;
BA_ "GenSigTimeoutTime_HCP" SG_ 1029 HVBatDischargePower_LongV 0;
BA_ "GenSigTimeoutTime_IPC" SG_ 1029 HVBatDischargePower_LongV 0;
BA_ "GenSigTimeoutTime_RFHM" SG_ 1029 HVBatDischargePower_LongV 0;
BA_ "GenSigTimeoutTime_SGW" SG_ 1029 HVBatDischargePower_LongV 0;
BA_ "GenSigTimeoutTime_TCM" SG_ 1029 HVBatDischargePower_LongV 0;
BA_ "GenSigTimeoutTime_AGSM" SG_ 1029 HVBatChargePower_Instant 0;
BA_ "GenSigTimeoutTime_ASBS" SG_ 1029 HVBatChargePower_Instant 0;
BA_ "GenSigTimeoutTime_BCM" SG_ 1029 HVBatChargePower_Instant 0;
BA_ "GenSigTimeoutTime_BSM" SG_ 1029 HVBatChargePower_Instant 0;
BA_ "GenSigTimeoutTime_CADM" SG_ 1029 HVBatChargePower_Instant 0;
BA_ "GenSigTimeoutTime_DMSM" SG_ 1029 HVBatChargePower_Instant 0;
BA_ "GenSigTimeoutTime_DTCM" SG_ 1029 HVBatChargePower_Instant 0;
BA_ "GenSigTimeoutTime_ELSDM" SG_ 1029 HVBatChargePower_Instant 0;
BA_ "GenSigTimeoutTime_ESL" SG_ 1029 HVBatChargePower_Instant 0;
BA_ "GenSigTimeoutTime_GNMM" SG_ 1029 HVBatChargePower_Instant 0;
BA_ "GenSigTimeoutTime_HCP" SG_ 1029 HVBatChargePower_Instant 0;
BA_ "GenSigTimeoutTime_IPC" SG_ 1029 HVBatChargePower_Instant 0;
BA_ "GenSigTimeoutTime_RFHM" SG_ 1029 HVBatChargePower_Instant 0;
BA_ "GenSigTimeoutTime_SGW" SG_ 1029 HVBatChargePower_Instant 0;
BA_ "GenSigTimeoutTime_TCM" SG_ 1029 HVBatChargePower_Instant 0;
BA_ "GenSigTimeoutTime_AGSM" SG_ 1029 HVBatChargePower_InstantV 0;
BA_ "GenSigTimeoutTime_ASBS" SG_ 1029 HVBatChargePower_InstantV 0;
BA_ "GenSigTimeoutTime_BCM" SG_ 1029 HVBatChargePower_InstantV 0;
BA_ "GenSigTimeoutTime_BSM" SG_ 1029 HVBatChargePower_InstantV 0;
BA_ "GenSigTimeoutTime_CADM" SG_ 1029 HVBatChargePower_InstantV 0;
BA_ "GenSigTimeoutTime_DMSM" SG_ 1029 HVBatChargePower_InstantV 0;
BA_ "GenSigTimeoutTime_DTCM" SG_ 1029 HVBatChargePower_InstantV 0;
BA_ "GenSigTimeoutTime_ELSDM" SG_ 1029 HVBatChargePower_InstantV 0;
BA_ "GenSigTimeoutTime_ESL" SG_ 1029 HVBatChargePower_InstantV 0;
BA_ "GenSigTimeoutTime_GNMM" SG_ 1029 HVBatChargePower_InstantV 0;
BA_ "GenSigTimeoutTime_HCP" SG_ 1029 HVBatChargePower_InstantV 0;
BA_ "GenSigTimeoutTime_IPC" SG_ 1029 HVBatChargePower_InstantV 0;
BA_ "GenSigStartValue" SG_ 752 IBS3_Vbatt 511;
BA_ "GenSigTimeoutTime_AGSM" SG_ 752 IBS3_Vbatt 0;
BA_ "GenSigTimeoutTime_ASBS" SG_ 752 IBS3_Vbatt 0;
BA_ "GenSigTimeoutTime_BCM" SG_ 752 IBS3_Vbatt 0;
BA_ "GenSigTimeoutTime_BSM" SG_ 752 IBS3_Vbatt 0;
BA_ "GenSigTimeoutTime_CADM" SG_ 752 IBS3_Vbatt 0;
BA_ "GenSigTimeoutTime_DMSM" SG_ 752 IBS3_Vbatt 0;
BA_ "GenSigTimeoutTime_DTCM" SG_ 752 IBS3_Vbatt 0;
BA_ "GenSigTimeoutTime_ELSDM" SG_ 752 IBS3_Vbatt 0;
BA_ "GenSigTimeoutTime_ESL" SG_ 752 IBS3_Vbatt 0;
BA_ "GenSigTimeoutTime_GNMM" SG_ 752 IBS3_Vbatt 0;
BA_ "GenSigTimeoutTime_IPC" SG_ 752 IBS3_Vbatt 0;
BA_ "GenSigTimeoutTime_TCM" SG_ 752 IBS3_Vbatt 0;
BA_ "GenSigTimeoutTime_ADCAM" SG_ 1443 Dist_Unit 0;
BA_ "GenSigTimeoutTime_EVCU2" SG_ 1443 Dist_Unit 0;
BA_ "GenSigTimeoutTime_VDCM" SG_ 1443 Dist_Unit 0;
BA_ "GenSigSendType" SG_ 1443 Dist_Unit 3;
BA_ "GenSigTimeoutTime_AGSM" SG_ 1443 Dist_Unit 0;
BA_ "GenSigTimeoutTime_BSM" SG_ 1443 Dist_Unit 0;
BA_ "GenSigTimeoutTime_DTCM" SG_ 1443 Dist_Unit 0;
BA_ "GenSigTimeoutTime_ESL" SG_ 1443 Dist_Unit 0;
BA_ "GenSigTimeoutTime_IPC" SG_ 1443 Dist_Unit 0;
BA_ "GenSigTimeoutTime_RFHM" SG_ 1443 Dist_Unit 0;
BA_ "GenSigTimeoutTime_TCM" SG_ 1443 Dist_Unit 0;
BA_ "GenSigTimeoutTime_VDCM" SG_ 1443 Speed_Unit 0;
BA_ "GenSigSendType" SG_ 1443 New_Spd_Zone_Ind 3;
BA_ "GenSigTimeoutTime_AGSM" SG_ 1443 New_Spd_Zone_Ind 0;
BA_ "GenSigTimeoutTime_ASBS" SG_ 1443 New_Spd_Zone_Ind 0;
BA_ "GenSigTimeoutTime_BSM" SG_ 1443 New_Spd_Zone_Ind 0;
BA_ "GenSigTimeoutTime_CADM" SG_ 1443 New_Spd_Zone_Ind 0;
BA_ "GenSigTimeoutTime_DMSM" SG_ 1443 New_Spd_Zone_Ind 0;
BA_ "GenSigTimeoutTime_DTCM" SG_ 1443 New_Spd_Zone_Ind 0;
BA_ "GenSigTimeoutTime_ELSDM" SG_ 1443 New_Spd_Zone_Ind 0;
BA_ "GenSigTimeoutTime_ESL" SG_ 1443 New_Spd_Zone_Ind 0;
BA_ "GenSigTimeoutTime_GNMM" SG_ 1443 New_Spd_Zone_Ind 0;
BA_ "GenSigTimeoutTime_HCP" SG_ 1443 New_Spd_Zone_Ind 0;
BA_ "GenSigTimeoutTime_IPC" SG_ 1443 New_Spd_Zone_Ind 0;
BA_ "GenSigTimeoutTime_RFHM" SG_ 1443 New_Spd_Zone_Ind 0;
BA_ "GenSigTimeoutTime_TCM" SG_ 1443 New_Spd_Zone_Ind 0;
BA_ "GenSigSendType" SG_ 1443 Speed_Unit 3;
BA_ "GenSigTimeoutTime_AGSM" SG_ 1443 Speed_Unit 0;
BA_ "GenSigTimeoutTime_BSM" SG_ 1443 Speed_Unit 0;
BA_ "GenSigTimeoutTime_DMSM" SG_ 1443 Speed_Unit 0;
BA_ "GenSigTimeoutTime_DTCM" SG_ 1443 Speed_Unit 0;
BA_ "GenSigTimeoutTime_ELSDM" SG_ 1443 Speed_Unit 0;
BA_ "GenSigTimeoutTime_ESL" SG_ 1443 Speed_Unit 0;
BA_ "GenSigTimeoutTime_GNMM" SG_ 1443 Speed_Unit 0;
BA_ "GenSigTimeoutTime_HCP" SG_ 1443 Speed_Unit 0;
BA_ "GenSigTimeoutTime_IPC" SG_ 1443 Speed_Unit 0;
BA_ "GenSigTimeoutTime_RFHM" SG_ 1443 Speed_Unit 0;
BA_ "GenSigTimeoutTime_TCM" SG_ 1443 Speed_Unit 0;
BA_ "GenSigSendType" SG_ 1443 Traffic_Sign_Info 3;
BA_ "GenSigTimeoutTime_AGSM" SG_ 1443 Traffic_Sign_Info 0;
BA_ "GenSigTimeoutTime_ASBS" SG_ 1443 Traffic_Sign_Info 0;
BA_ "GenSigTimeoutTime_BSM" SG_ 1443 Traffic_Sign_Info 0;
BA_ "GenSigTimeoutTime_DMSM" SG_ 1443 Traffic_Sign_Info 0;
BA_ "GenSigTimeoutTime_DTCM" SG_ 1443 Traffic_Sign_Info 0;
BA_ "GenSigTimeoutTime_ELSDM" SG_ 1443 Traffic_Sign_Info 0;
BA_ "GenSigTimeoutTime_ESL" SG_ 1443 Traffic_Sign_Info 0;
BA_ "GenSigTimeoutTime_GNMM" SG_ 1443 Traffic_Sign_Info 0;
BA_ "GenSigTimeoutTime_HCP" SG_ 1443 Traffic_Sign_Info 0;
BA_ "GenSigTimeoutTime_IPC" SG_ 1443 Traffic_Sign_Info 0;
BA_ "GenSigTimeoutTime_RFHM" SG_ 1443 Traffic_Sign_Info 0;
BA_ "GenSigTimeoutTime_TCM" SG_ 1443 Traffic_Sign_Info 0;
BA_ "GenSigTimeoutTime_AGSM" SG_ 753 CRC_LV_CHARGER1 0;
BA_ "GenSigTimeoutTime_ASBS" SG_ 753 CRC_LV_CHARGER1 0;
BA_ "GenSigTimeoutTime_BCM" SG_ 753 CRC_LV_CHARGER1 0;
BA_ "GenSigTimeoutTime_BSM" SG_ 753 CRC_LV_CHARGER1 0;
BA_ "GenSigTimeoutTime_CADM" SG_ 753 CRC_LV_CHARGER1 0;
BA_ "GenSigTimeoutTime_DMSM" SG_ 753 CRC_LV_CHARGER1 0;
BA_ "GenSigTimeoutTime_DTCM" SG_ 753 CRC_LV_CHARGER1 0;
BA_ "GenSigTimeoutTime_ELSDM" SG_ 753 CRC_LV_CHARGER1 0;
BA_ "GenSigTimeoutTime_ESL" SG_ 753 CRC_LV_CHARGER1 0;
BA_ "GenSigTimeoutTime_GNMM" SG_ 753 CRC_LV_CHARGER1 0;
BA_ "GenSigTimeoutTime_HCP" SG_ 753 CRC_LV_CHARGER1 0;
BA_ "GenSigTimeoutTime_IPC" SG_ 753 CRC_LV_CHARGER1 0;
BA_ "GenSigTimeoutTime_RFHM" SG_ 753 CRC_LV_CHARGER1 0;
BA_ "GenSigTimeoutTime_SGW" SG_ 753 CRC_LV_CHARGER1 0;
BA_ "GenSigTimeoutTime_TCM" SG_ 753 CRC_LV_CHARGER1 0;
BA_ "GenSigTimeoutTime_AGSM" SG_ 753 MessageCounter_LV_CHARGER1 0;
BA_ "GenSigTimeoutTime_ASBS" SG_ 753 MessageCounter_LV_CHARGER1 0;
BA_ "GenSigTimeoutTime_BCM" SG_ 753 MessageCounter_LV_CHARGER1 0;
BA_ "GenSigTimeoutTime_BSM" SG_ 753 MessageCounter_LV_CHARGER1 0;
BA_ "GenSigTimeoutTime_CADM" SG_ 753 MessageCounter_LV_CHARGER1 0;
BA_ "GenSigTimeoutTime_DMSM" SG_ 753 MessageCounter_LV_CHARGER1 0;
BA_ "GenSigTimeoutTime_DTCM" SG_ 753 MessageCounter_LV_CHARGER1 0;
BA_ "GenSigTimeoutTime_ELSDM" SG_ 753 MessageCounter_LV_CHARGER1 0;
BA_ "GenSigTimeoutTime_ESL" SG_ 753 MessageCounter_LV_CHARGER1 0;
BA_ "GenSigTimeoutTime_GNMM" SG_ 753 MessageCounter_LV_CHARGER1 0;
BA_ "GenSigTimeoutTime_HCP" SG_ 753 MessageCounter_LV_CHARGER1 0;
BA_ "GenSigTimeoutTime_IPC" SG_ 753 MessageCounter_LV_CHARGER1 0;
BA_ "GenSigTimeoutTime_RFHM" SG_ 753 MessageCounter_LV_CHARGER1 0;
BA_ "GenSigTimeoutTime_SGW" SG_ 753 MessageCounter_LV_CHARGER1 0;
BA_ "GenSigTimeoutTime_TCM" SG_ 753 MessageCounter_LV_CHARGER1 0;
BA_ "GenSigStartValue" SG_ 753 LVDC_CurrentFeedback 4095;
BA_ "GenSigTimeoutTime_AGSM" SG_ 753 LVDC_CurrentFeedback 0;
BA_ "GenSigTimeoutTime_ASBS" SG_ 753 LVDC_CurrentFeedback 0;
BA_ "GenSigTimeoutTime_BCM" SG_ 753 LVDC_CurrentFeedback 0;
BA_ "GenSigTimeoutTime_BSM" SG_ 753 LVDC_CurrentFeedback 0;
BA_ "GenSigTimeoutTime_CADM" SG_ 753 LVDC_CurrentFeedback 0;
BA_ "GenSigTimeoutTime_DMSM" SG_ 753 LVDC_CurrentFeedback 0;
BA_ "GenSigTimeoutTime_DTCM" SG_ 753 LVDC_CurrentFeedback 0;
BA_ "GenSigTimeoutTime_ELSDM" SG_ 753 LVDC_CurrentFeedback 0;
BA_ "GenSigTimeoutTime_ESL" SG_ 753 LVDC_CurrentFeedback 0;
BA_ "GenSigTimeoutTime_GNMM" SG_ 753 LVDC_CurrentFeedback 0;
BA_ "GenSigTimeoutTime_HCP" SG_ 753 LVDC_CurrentFeedback 0;
BA_ "GenSigTimeoutTime_IPC" SG_ 753 LVDC_CurrentFeedback 0;
BA_ "GenSigTimeoutTime_RFHM" SG_ 753 LVDC_CurrentFeedback 0;
BA_ "GenSigTimeoutTime_SGW" SG_ 753 LVDC_CurrentFeedback 0;
BA_ "GenSigTimeoutTime_TCM" SG_ 753 LVDC_CurrentFeedback 0;
BA_ "GenSigTimeoutTime_RFHM" SG_ 1029 HVBatChargePower_InstantV 0;
BA_ "GenSigTimeoutTime_ADCAM" SG_ 278 TCMLnchCtrlAllowed 0;
BA_ "GenSigTimeoutTime_EVCU2" SG_ 278 TCMLnchCtrlAllowed 0;
BA_ "GenSigTimeoutTime_VDCM" SG_ 278 TCMLnchCtrlAllowed 0;
BA_ "GenSigTimeoutTime_RFHM" SG_ 1435 DRV_TEMP_DR_POS_PCT 0;
BA_ "GenSigTimeoutTime_SGW" SG_ 1435 DRV_TEMP_DR_POS_PCT 0;
BA_ "GenSigTimeoutTime_TCM" SG_ 1435 DRV_TEMP_DR_POS_PCT 0;
BA_ "GenSigSendType" SG_ 1435 HAS_OnOffSts 3;
BA_ "GenSigTimeoutTime_AGSM" SG_ 1435 HAS_OnOffSts 0;
BA_ "GenSigTimeoutTime_ASBS" SG_ 1435 HAS_OnOffSts 0;
BA_ "GenSigTimeoutTime_BCM" SG_ 1435 HAS_OnOffSts 0;
BA_ "GenSigTimeoutTime_BSM" SG_ 1435 HAS_OnOffSts 0;
BA_ "GenSigTimeoutTime_DMSM" SG_ 1435 HAS_OnOffSts 0;
BA_ "GenSigTimeoutTime_DTCM" SG_ 1435 HAS_OnOffSts 0;
BA_ "GenSigTimeoutTime_ELSDM" SG_ 1435 HAS_OnOffSts 0;
BA_ "GenSigTimeoutTime_ESL" SG_ 1435 HAS_OnOffSts 0;
BA_ "GenSigTimeoutTime_GNMM" SG_ 1435 HAS_OnOffSts 0;
BA_ "GenSigTimeoutTime_HCP" SG_ 1435 HAS_OnOffSts 0;
BA_ "GenSigTimeoutTime_IPC" SG_ 1435 HAS_OnOffSts 0;
BA_ "GenSigTimeoutTime_RFHM" SG_ 1435 HAS_OnOffSts 0;
BA_ "GenSigTimeoutTime_SGW" SG_ 1435 HAS_OnOffSts 0;
BA_ "GenSigTimeoutTime_TCM" SG_ 1435 HAS_OnOffSts 0;
BA_ "GenSigTimeoutTime_ADCAM" SG_ 1436 Blower_Diagnostics 0;
BA_ "GenSigTimeoutTime_EVCU2" SG_ 1436 Blower_Diagnostics 0;
BA_ "GenSigTimeoutTime_VDCM" SG_ 1436 Blower_Diagnostics 0;
BA_ "GenSigTimeoutTime_ADCAM" SG_ 1436 Blower_Speed 0;
BA_ "GenSigTimeoutTime_EVCU2" SG_ 1436 Blower_Speed 0;
BA_ "GenSigTimeoutTime_VDCM" SG_ 1436 Blower_Speed 0;
BA_ "GenSigSendType" SG_ 1436 Blower_Diagnostics 3;
BA_ "GenSigTimeoutTime_AGSM" SG_ 1436 Blower_Diagnostics 0;
BA_ "GenSigTimeoutTime_ASBS" SG_ 1436 Blower_Diagnostics 0;
BA_ "GenSigTimeoutTime_BCM" SG_ 1436 Blower_Diagnostics 0;
BA_ "GenSigTimeoutTime_BSM" SG_ 1436 Blower_Diagnostics 0;
BA_ "GenSigTimeoutTime_HCP" SG_ 1033 IdleCLoopTrq 0;
BA_ "GenSigTimeoutTime_AGSM" SG_ 278 TCMLnchCtrlAllowed 0;
BA_ "GenSigTimeoutTime_BCM" SG_ 278 TCMLnchCtrlAllowed 0;
BA_ "GenSigTimeoutTime_BSM" SG_ 278 TCMLnchCtrlAllowed 0;
BA_ "GenSigTimeoutTime_DTCM" SG_ 278 TCMLnchCtrlAllowed 0;
BA_ "GenSigTimeoutTime_ESL" SG_ 278 TCMLnchCtrlAllowed 0;
BA_ "GenSigTimeoutTime_IPC" SG_ 278 TCMLnchCtrlAllowed 0;
BA_ "GenSigTimeoutTime_RFHM" SG_ 278 TCMLnchCtrlAllowed 0;
BA_ "GenSigTimeoutTime_SGW" SG_ 278 TCMLnchCtrlAllowed 0;
BA_ "GenSigTimeoutTime_TCM" SG_ 278 TCMLnchCtrlAllowed 0;
BA_ "GenSigTimeoutTime_ADCAM" SG_ 278 TCM_Req_EngSpeed 0;
BA_ "GenSigTimeoutTime_EVCU2" SG_ 278 TCM_Req_EngSpeed 0;
BA_ "GenSigTimeoutTime_VDCM" SG_ 278 TCM_Req_EngSpeed 0;
BA_ "GenSigTimeoutTime_EVCU2" SG_ 278 MessageCounter_TRANSM1 0;
BA_ "GenSigTimeoutTime_VDCM" SG_ 278 MessageCounter_TRANSM1 0;
BA_ "GenSigTimeoutTime_BCM" SG_ 278 MessageCounter_TRANSM1 0;
BA_ "GenSigTimeoutTime_SGW" SG_ 278 MessageCounter_TRANSM1 0;
BA_ "GenSigTimeoutTime_EVCU2" SG_ 278 CRC_TRANSM1 0;
BA_ "GenSigTimeoutTime_VDCM" SG_ 278 CRC_TRANSM1 0;
BA_ "GenSigTimeoutTime_BCM" SG_ 278 CRC_TRANSM1 0;
BA_ "GenSigTimeoutTime_SGW" SG_ 278 CRC_TRANSM1 0;
BA_ "GenSigTimeoutTime_ADCAM" SG_ 278 TCASERANGESTATUS_TCM 0;
BA_ "GenSigTimeoutTime_EVCU2" SG_ 278 TCASERANGESTATUS_TCM 0;
BA_ "GenSigTimeoutTime_VDCM" SG_ 278 TCASERANGESTATUS_TCM 0;
BA_ "GenSigTimeoutTime_ADCAM" SG_ 278 DriveLineRatio 0;
BA_ "GenSigTimeoutTime_EVCU2" SG_ 278 DriveLineRatio 0;
BA_ "GenSigTimeoutTime_VDCM" SG_ 278 DriveLineRatio 0;
BA_ "GenSigTimeoutTime_BSM" SG_ 278 DriveLineRatio 0;
BA_ "GenSigTimeoutTime_ADCAM" SG_ 278 TCM_Req_EngSpeed_Sts 0;
BA_ "GenSigTimeoutTime_EVCU2" SG_ 278 TCM_Req_EngSpeed_Sts 0;
BA_ "GenSigTimeoutTime_VDCM" SG_ 278 TCM_Req_EngSpeed_Sts 0;
BA_ "GenSigTimeoutTime_AGSM" SG_ 278 DisconnectClutch_Sts 0;
BA_ "GenSigTimeoutTime_ASBS" SG_ 278 DisconnectClutch_Sts 0;
BA_ "GenSigTimeoutTime_BCM" SG_ 278 DisconnectClutch_Sts 0;
BA_ "GenSigTimeoutTime_BSM" SG_ 278 DisconnectClutch_Sts 0;
BA_ "GenSigTimeoutTime_CADM" SG_ 278 DisconnectClutch_Sts 0;
BA_ "GenSigTimeoutTime_DMSM" SG_ 278 DisconnectClutch_Sts 0;
BA_ "GenSigTimeoutTime_DTCM" SG_ 278 DisconnectClutch_Sts 0;
BA_ "GenSigTimeoutTime_ELSDM" SG_ 278 DisconnectClutch_Sts 0;
BA_ "GenSigTimeoutTime_ESL" SG_ 278 DisconnectClutch_Sts 0;
BA_ "GenSigTimeoutTime_GNMM" SG_ 278 DisconnectClutch_Sts 0;
BA_ "GenSigTimeoutTime_IPC" SG_ 278 DisconnectClutch_Sts 0;
BA_ "GenSigTimeoutTime_RFHM" SG_ 278 DisconnectClutch_Sts 0;
BA_ "GenSigTimeoutTime_SGW" SG_ 278 DisconnectClutch_Sts 0;
BA_ "GenSigTimeoutTime_TCM" SG_ 278 DisconnectClutch_Sts 0;
BA_ "GenSigStartValue" SG_ 278 EngTrq_Rq_TCM 2047;
BA_ "GenSigTimeoutTime_AGSM" SG_ 278 EngTrq_Rq_TCM 0;
BA_ "GenSigTimeoutTime_ASBS" SG_ 278 EngTrq_Rq_TCM 0;
BA_ "GenSigTimeoutTime_BCM" SG_ 278 EngTrq_Rq_TCM 0;
BA_ "GenSigTimeoutTime_CADM" SG_ 278 EngTrq_Rq_TCM 0;
BA_ "GenSigTimeoutTime_DMSM" SG_ 278 EngTrq_Rq_TCM 0;
BA_ "GenSigTimeoutTime_DTCM" SG_ 278 EngTrq_Rq_TCM 0;
BA_ "GenSigTimeoutTime_ELSDM" SG_ 278 EngTrq_Rq_TCM 0;
BA_ "GenSigTimeoutTime_ESL" SG_ 278 EngTrq_Rq_TCM 0;
BA_ "GenSigTimeoutTime_GNMM" SG_ 278 EngTrq_Rq_TCM 0;
BA_ "GenSigTimeoutTime_IPC" SG_ 278 EngTrq_Rq_TCM 0;
BA_ "GenSigTimeoutTime_RFHM" SG_ 278 EngTrq_Rq_TCM 0;
BA_ "GenSigTimeoutTime_SGW" SG_ 278 EngTrq_Rq_TCM 0;
BA_ "GenSigTimeoutTime_TCM" SG_ 278 EngTrq_Rq_TCM 0;
BA_ "GenSigStartValue" SG_ 278 MaxTrqDes 2047;
BA_ "GenSigTimeoutTime_AGSM" SG_ 278 MaxTrqDes 0;
BA_ "GenSigTimeoutTime_ASBS" SG_ 278 MaxTrqDes 0;
BA_ "GenSigTimeoutTime_BCM" SG_ 278 MaxTrqDes 0;
BA_ "GenSigTimeoutTime_BSM" SG_ 278 MaxTrqDes 0;
BA_ "GenSigTimeoutTime_CADM" SG_ 278 MaxTrqDes 0;
BA_ "GenSigTimeoutTime_DMSM" SG_ 278 MaxTrqDes 0;
BA_ "GenSigTimeoutTime_DTCM" SG_ 278 MaxTrqDes 0;
BA_ "GenSigTimeoutTime_ELSDM" SG_ 278 MaxTrqDes 0;
BA_ "GenSigTimeoutTime_ESL" SG_ 278 MaxTrqDes 0;
BA_ "GenSigTimeoutTime_GNMM" SG_ 278 MaxTrqDes 0;
BA_ "GenSigTimeoutTime_IPC" SG_ 278 MaxTrqDes 0;
BA_ "GenSigTimeoutTime_RFHM" SG_ 278 MaxTrqDes 0;
BA_ "GenSigTimeoutTime_SGW" SG_ 278 MaxTrqDes 0;
BA_ "GenSigTimeoutTime_TCM" SG_ 278 MaxTrqDes 0;
BA_ "GenSigStartValue" SG_ 278 TargetGear 15;
BA_ "GenSigTimeoutTime_AGSM" SG_ 278 TargetGear 0;
BA_ "GenSigTimeoutTime_ASBS" SG_ 278 TargetGear 0;
BA_ "GenSigTimeoutTime_DMSM" SG_ 278 TargetGear 0;
BA_ "GenSigTimeoutTime_ELSDM" SG_ 278 TargetGear 0;
BA_ "GenSigTimeoutTime_ESL" SG_ 278 TargetGear 0;
BA_ "GenSigTimeoutTime_GNMM" SG_ 278 TargetGear 0;
BA_ "GenSigTimeoutTime_RFHM" SG_ 278 TargetGear 0;
BA_ "GenSigTimeoutTime_TCM" SG_ 278 TargetGear 0;
BA_ "GenSigStartValue" SG_ 278 TCM_HillMode 1022;
BA_ "GenSigTimeoutTime_AGSM" SG_ 278 TCM_HillMode 0;
BA_ "GenSigTimeoutTime_ASBS" SG_ 278 TCM_HillMode 0;
BA_ "GenSigTimeoutTime_BCM" SG_ 278 TCM_HillMode 0;
BA_ "GenSigTimeoutTime_BSM" SG_ 278 TCM_HillMode 0;
BA_ "GenSigTimeoutTime_CADM" SG_ 278 TCM_HillMode 0;
BA_ "GenSigTimeoutTime_DMSM" SG_ 278 TCM_HillMode 0;
BA_ "GenSigTimeoutTime_DTCM" SG_ 278 TCM_HillMode 0;
BA_ "GenSigTimeoutTime_ELSDM" SG_ 278 TCM_HillMode 0;
BA_ "GenSigTimeoutTime_ESL" SG_ 278 TCM_HillMode 0;
BA_ "GenSigTimeoutTime_GNMM" SG_ 278 TCM_HillMode 0;
BA_ "GenSigTimeoutTime_IPC" SG_ 278 TCM_HillMode 0;
BA_ "GenSigTimeoutTime_RFHM" SG_ 278 TCM_HillMode 0;
BA_ "GenSigTimeoutTime_SGW" SG_ 278 TCM_HillMode 0;
BA_ "GenSigTimeoutTime_TCM" SG_ 278 TCM_HillMode 0;
BA_ "GenSigStartValue" SG_ 278 TCM_Req_EngSpeed 8190;
BA_ "GenSigTimeoutTime_AGSM" SG_ 278 TCM_Req_EngSpeed 0;
BA_ "GenSigTimeoutTime_ASBS" SG_ 278 TCM_Req_EngSpeed 0;
BA_ "GenSigTimeoutTime_BCM" SG_ 278 TCM_Req_EngSpeed 0;
BA_ "GenSigTimeoutTime_BSM" SG_ 278 TCM_Req_EngSpeed 0;
BA_ "GenSigTimeoutTime_CADM" SG_ 278 TCM_Req_EngSpeed 0;
BA_ "GenSigTimeoutTime_DMSM" SG_ 278 TCM_Req_EngSpeed 0;
BA_ "GenSigTimeoutTime_DTCM" SG_ 278 TCM_Req_EngSpeed 0;
BA_ "GenSigTimeoutTime_ELSDM" SG_ 278 TCM_Req_EngSpeed 0;
BA_ "GenSigTimeoutTime_ESL" SG_ 278 TCM_Req_EngSpeed 0;
BA_ "GenSigTimeoutTime_GNMM" SG_ 278 TCM_Req_EngSpeed 0;
BA_ "GenSigTimeoutTime_IPC" SG_ 278 TCM_Req_EngSpeed 0;
BA_ "GenSigTimeoutTime_RFHM" SG_ 278 TCM_Req_EngSpeed 0;
BA_ "GenSigTimeoutTime_SGW" SG_ 278 TCM_Req_EngSpeed 0;
BA_ "GenSigTimeoutTime_TCM" SG_ 278 TCM_Req_EngSpeed 0;
BA_ "GenSigTimeoutTime_AGSM" SG_ 278 MessageCounter_TRANSM1 0;
BA_ "GenSigTimeoutTime_ASBS" SG_ 278 MessageCounter_TRANSM1 0;
BA_ "GenSigTimeoutTime_DMSM" SG_ 278 MessageCounter_TRANSM1 0;
BA_ "GenSigTimeoutTime_ELSDM" SG_ 278 MessageCounter_TRANSM1 0;
BA_ "GenSigTimeoutTime_ESL" SG_ 278 MessageCounter_TRANSM1 0;
BA_ "GenSigTimeoutTime_GNMM" SG_ 278 MessageCounter_TRANSM1 0;
BA_ "GenSigTimeoutTime_IPC" SG_ 278 MessageCounter_TRANSM1 0;
BA_ "GenSigTimeoutTime_RFHM" SG_ 278 MessageCounter_TRANSM1 0;
BA_ "GenSigTimeoutTime_TCM" SG_ 278 MessageCounter_TRANSM1 0;
BA_ "GenSigTimeoutTime_AGSM" SG_ 278 PaddleShiftRequest 0;
BA_ "GenSigTimeoutTime_ASBS" SG_ 278 PaddleShiftRequest 0;
BA_ "GenSigTimeoutTime_BCM" SG_ 278 PaddleShiftRequest 0;
BA_ "GenSigTimeoutTime_BSM" SG_ 278 PaddleShiftRequest 0;
BA_ "GenSigTimeoutTime_CADM" SG_ 278 PaddleShiftRequest 0;
BA_ "GenSigTimeoutTime_DMSM" SG_ 278 PaddleShiftRequest 0;
BA_ "GenSigTimeoutTime_DTCM" SG_ 278 PaddleShiftRequest 0;
BA_ "GenSigTimeoutTime_ELSDM" SG_ 278 PaddleShiftRequest 0;
BA_ "GenSigTimeoutTime_ESL" SG_ 278 PaddleShiftRequest 0;
BA_ "GenSigTimeoutTime_GNMM" SG_ 278 PaddleShiftRequest 0;
BA_ "GenSigTimeoutTime_HCP" SG_ 278 PaddleShiftRequest 0;
BA_ "GenSigTimeoutTime_IPC" SG_ 278 PaddleShiftRequest 0;
BA_ "GenSigTimeoutTime_RFHM" SG_ 278 PaddleShiftRequest 0;
BA_ "GenSigTimeoutTime_SGW" SG_ 278 PaddleShiftRequest 0;
BA_ "GenSigTimeoutTime_TCM" SG_ 278 PaddleShiftRequest 0;
BA_ "GenSigTimeoutTime_AGSM" SG_ 278 REPRGD_PFC_CLR_TCM 0;
BA_ "GenSigTimeoutTime_ASBS" SG_ 278 REPRGD_PFC_CLR_TCM 0;
BA_ "GenSigTimeoutTime_BCM" SG_ 278 REPRGD_PFC_CLR_TCM 0;
BA_ "GenSigTimeoutTime_BSM" SG_ 278 REPRGD_PFC_CLR_TCM 0;
BA_ "GenSigTimeoutTime_CADM" SG_ 278 REPRGD_PFC_CLR_TCM 0;
BA_ "GenSigTimeoutTime_DMSM" SG_ 278 REPRGD_PFC_CLR_TCM 0;
BA_ "GenSigTimeoutTime_DTCM" SG_ 278 REPRGD_PFC_CLR_TCM 0;
BA_ "GenSigTimeoutTime_ELSDM" SG_ 278 REPRGD_PFC_CLR_TCM 0;
BA_ "GenSigTimeoutTime_ESL" SG_ 278 REPRGD_PFC_CLR_TCM 0;
BA_ "GenSigTimeoutTime_GNMM" SG_ 278 REPRGD_PFC_CLR_TCM 0;
BA_ "GenSigTimeoutTime_HCP" SG_ 278 REPRGD_PFC_CLR_TCM 0;
BA_ "GenSigTimeoutTime_IPC" SG_ 278 REPRGD_PFC_CLR_TCM 0;
BA_ "GenSigTimeoutTime_RFHM" SG_ 278 REPRGD_PFC_CLR_TCM 0;
BA_ "GenSigTimeoutTime_SGW" SG_ 278 REPRGD_PFC_CLR_TCM 0;
BA_ "GenSigTimeoutTime_TCM" SG_ 278 REPRGD_PFC_CLR_TCM 0;
BA_ "GenSigTimeoutTime_AGSM" SG_ 278 TCM_Comm_Fail_CAN 0;
BA_ "GenSigTimeoutTime_ASBS" SG_ 278 TCM_Comm_Fail_CAN 0;
BA_ "GenSigTimeoutTime_BCM" SG_ 278 TCM_Comm_Fail_CAN 0;
BA_ "GenSigTimeoutTime_BSM" SG_ 278 TCM_Comm_Fail_CAN 0;
BA_ "GenSigTimeoutTime_CADM" SG_ 278 TCM_Comm_Fail_CAN 0;
BA_ "GenSigTimeoutTime_DMSM" SG_ 278 TCM_Comm_Fail_CAN 0;
BA_ "GenSigTimeoutTime_DTCM" SG_ 278 TCM_Comm_Fail_CAN 0;
BA_ "GenSigTimeoutTime_ELSDM" SG_ 278 TCM_Comm_Fail_CAN 0;
BA_ "GenSigTimeoutTime_ESL" SG_ 278 TCM_Comm_Fail_CAN 0;
BA_ "GenSigTimeoutTime_GNMM" SG_ 278 TCM_Comm_Fail_CAN 0;
BA_ "GenSigTimeoutTime_IPC" SG_ 278 TCM_Comm_Fail_CAN 0;
BA_ "GenSigTimeoutTime_RFHM" SG_ 278 TCM_Comm_Fail_CAN 0;
BA_ "GenSigTimeoutTime_SGW" SG_ 278 TCM_Comm_Fail_CAN 0;
BA_ "GenSigTimeoutTime_TCM" SG_ 278 TCM_Comm_Fail_CAN 0;
BA_ "GenSigTimeoutTime_AGSM" SG_ 278 TCM_ParkSL_Request 0;
BA_ "GenSigTimeoutTime_ASBS" SG_ 278 TCM_ParkSL_Request 0;
BA_ "GenSigTimeoutTime_BCM" SG_ 278 TCM_ParkSL_Request 0;
BA_ "GenSigTimeoutTime_BSM" SG_ 278 TCM_ParkSL_Request 0;
BA_ "GenSigTimeoutTime_CADM" SG_ 278 TCM_ParkSL_Request 0;
BA_ "GenSigTimeoutTime_DMSM" SG_ 278 TCM_ParkSL_Request 0;
BA_ "GenSigTimeoutTime_DTCM" SG_ 278 TCM_ParkSL_Request 0;
BA_ "GenSigTimeoutTime_ELSDM" SG_ 278 TCM_ParkSL_Request 0;
BA_ "GenSigTimeoutTime_ESL" SG_ 278 TCM_ParkSL_Request 0;
BA_ "GenSigTimeoutTime_GNMM" SG_ 278 TCM_ParkSL_Request 0;
BA_ "GenSigTimeoutTime_HCP" SG_ 278 TCM_ParkSL_Request 0;
BA_ "GenSigTimeoutTime_IPC" SG_ 278 TCM_ParkSL_Request 0;
BA_ "GenSigTimeoutTime_RFHM" SG_ 278 TCM_ParkSL_Request 0;
BA_ "GenSigTimeoutTime_SGW" SG_ 278 TCM_ParkSL_Request 0;
BA_ "GenSigTimeoutTime_TCM" SG_ 278 TCM_ParkSL_Request 0;
BA_ "GenSigTimeoutTime_AGSM" SG_ 278 CRC_TRANSM1 0;
BA_ "GenSigTimeoutTime_ASBS" SG_ 278 CRC_TRANSM1 0;
BA_ "GenSigTimeoutTime_DMSM" SG_ 278 CRC_TRANSM1 0;
BA_ "GenSigTimeoutTime_ELSDM" SG_ 278 CRC_TRANSM1 0;
BA_ "GenSigTimeoutTime_ESL" SG_ 278 CRC_TRANSM1 0;
BA_ "GenSigTimeoutTime_GNMM" SG_ 278 CRC_TRANSM1 0;
BA_ "GenSigTimeoutTime_IPC" SG_ 278 CRC_TRANSM1 0;
BA_ "GenSigTimeoutTime_RFHM" SG_ 278 CRC_TRANSM1 0;
BA_ "GenSigTimeoutTime_TCM" SG_ 278 CRC_TRANSM1 0;
BA_ "GenSigStartValue" SG_ 278 TransIntakeTorq 1000;
BA_ "GenSigTimeoutTime_AGSM" SG_ 278 TransIntakeTorq 0;
BA_ "GenSigTimeoutTime_ASBS" SG_ 278 TransIntakeTorq 0;
BA_ "GenSigTimeoutTime_BCM" SG_ 278 TransIntakeTorq 0;
BA_ "GenSigTimeoutTime_BSM" SG_ 278 TransIntakeTorq 0;
BA_ "GenSigTimeoutTime_CADM" SG_ 278 TransIntakeTorq 0;
BA_ "GenSigTimeoutTime_DMSM" SG_ 278 TransIntakeTorq 0;
BA_ "GenSigTimeoutTime_DTCM" SG_ 278 TransIntakeTorq 0;
BA_ "GenSigTimeoutTime_ELSDM" SG_ 278 TransIntakeTorq 0;
BA_ "GenSigTimeoutTime_ESL" SG_ 278 TransIntakeTorq 0;
BA_ "GenSigTimeoutTime_GNMM" SG_ 278 TransIntakeTorq 0;
BA_ "GenSigTimeoutTime_IPC" SG_ 278 TransIntakeTorq 0;
BA_ "GenSigTimeoutTime_RFHM" SG_ 278 TransIntakeTorq 0;
BA_ "GenSigTimeoutTime_SGW" SG_ 278 TransIntakeTorq 0;
BA_ "GenSigTimeoutTime_TCM" SG_ 278 TransIntakeTorq 0;
BA_ "GenSigTimeoutTime_AGSM" SG_ 278 TrqCtrlModeReq 0;
BA_ "GenSigTimeoutTime_ASBS" SG_ 278 TrqCtrlModeReq 0;
BA_ "GenSigTimeoutTime_BCM" SG_ 278 TrqCtrlModeReq 0;
BA_ "GenSigTimeoutTime_CADM" SG_ 278 TrqCtrlModeReq 0;
BA_ "GenSigTimeoutTime_DMSM" SG_ 278 TrqCtrlModeReq 0;
BA_ "GenSigTimeoutTime_DTCM" SG_ 278 TrqCtrlModeReq 0;
BA_ "GenSigTimeoutTime_ELSDM" SG_ 278 TrqCtrlModeReq 0;
BA_ "GenSigTimeoutTime_ESL" SG_ 278 TrqCtrlModeReq 0;
BA_ "GenSigTimeoutTime_GNMM" SG_ 278 TrqCtrlModeReq 0;
BA_ "GenSigTimeoutTime_IPC" SG_ 278 TrqCtrlModeReq 0;
BA_ "GenSigTimeoutTime_RFHM" SG_ 278 TrqCtrlModeReq 0;
BA_ "GenSigTimeoutTime_SGW" SG_ 278 TrqCtrlModeReq 0;
BA_ "GenSigTimeoutTime_TCM" SG_ 278 TrqCtrlModeReq 0;
BA_ "GenSigTimeoutTime_AGSM" SG_ 278 TorqueAmpTransmission 0;
BA_ "GenSigTimeoutTime_ASBS" SG_ 278 TorqueAmpTransmission 0;
BA_ "GenSigTimeoutTime_DMSM" SG_ 278 TorqueAmpTransmission 0;
BA_ "GenSigTimeoutTime_ELSDM" SG_ 278 TorqueAmpTransmission 0;
BA_ "GenSigTimeoutTime_ESL" SG_ 278 TorqueAmpTransmission 0;
BA_ "GenSigTimeoutTime_GNMM" SG_ 278 TorqueAmpTransmission 0;
BA_ "GenSigTimeoutTime_IPC" SG_ 278 TorqueAmpTransmission 0;
BA_ "GenSigTimeoutTime_RFHM" SG_ 278 TorqueAmpTransmission 0;
BA_ "GenSigTimeoutTime_TCM" SG_ 278 TorqueAmpTransmission 0;
BA_ "GenSigTimeoutTime_AGSM" SG_ 278 TCASERANGESTATUS_TCM 0;
BA_ "GenSigTimeoutTime_ASBS" SG_ 278 TCASERANGESTATUS_TCM 0;
BA_ "GenSigTimeoutTime_BCM" SG_ 278 TCASERANGESTATUS_TCM 0;
BA_ "GenSigTimeoutTime_BSM" SG_ 278 TCASERANGESTATUS_TCM 0;
BA_ "GenSigTimeoutTime_CADM" SG_ 278 TCASERANGESTATUS_TCM 0;
BA_ "GenSigTimeoutTime_DMSM" SG_ 278 TCASERANGESTATUS_TCM 0;
BA_ "GenSigTimeoutTime_DTCM" SG_ 278 TCASERANGESTATUS_TCM 0;
BA_ "GenSigTimeoutTime_ELSDM" SG_ 278 TCASERANGESTATUS_TCM 0;
BA_ "GenSigTimeoutTime_ESL" SG_ 278 TCASERANGESTATUS_TCM 0;
BA_ "GenSigTimeoutTime_GNMM" SG_ 278 TCASERANGESTATUS_TCM 0;
BA_ "GenSigTimeoutTime_IPC" SG_ 278 TCASERANGESTATUS_TCM 0;
BA_ "GenSigTimeoutTime_RFHM" SG_ 278 TCASERANGESTATUS_TCM 0;
BA_ "GenSigTimeoutTime_SGW" SG_ 278 TCASERANGESTATUS_TCM 0;
BA_ "GenSigTimeoutTime_TCM" SG_ 278 TCASERANGESTATUS_TCM 0;
BA_ "GenSigTimeoutTime_AGSM" SG_ 278 CODE_CLR_TCM 0;
BA_ "GenSigTimeoutTime_ASBS" SG_ 278 CODE_CLR_TCM 0;
BA_ "GenSigTimeoutTime_BCM" SG_ 278 CODE_CLR_TCM 0;
BA_ "GenSigTimeoutTime_BSM" SG_ 278 CODE_CLR_TCM 0;
BA_ "GenSigTimeoutTime_CADM" SG_ 278 CODE_CLR_TCM 0;
BA_ "GenSigTimeoutTime_DMSM" SG_ 278 CODE_CLR_TCM 0;
BA_ "GenSigTimeoutTime_DTCM" SG_ 278 CODE_CLR_TCM 0;
BA_ "GenSigTimeoutTime_ELSDM" SG_ 278 CODE_CLR_TCM 0;
BA_ "GenSigTimeoutTime_ESL" SG_ 278 CODE_CLR_TCM 0;
BA_ "GenSigTimeoutTime_GNMM" SG_ 278 CODE_CLR_TCM 0;
BA_ "GenSigTimeoutTime_HCP" SG_ 278 CODE_CLR_TCM 0;
BA_ "GenSigTimeoutTime_IPC" SG_ 278 CODE_CLR_TCM 0;
BA_ "GenSigTimeoutTime_RFHM" SG_ 278 CODE_CLR_TCM 0;
BA_ "GenSigTimeoutTime_SGW" SG_ 278 CODE_CLR_TCM 0;
BA_ "GenSigTimeoutTime_TCM" SG_ 278 CODE_CLR_TCM 0;
BA_ "GenSigTimeoutTime_AGSM" SG_ 278 DriveLineRatio 0;
BA_ "GenSigTimeoutTime_ASBS" SG_ 278 DriveLineRatio 0;
BA_ "GenSigTimeoutTime_BCM" SG_ 278 DriveLineRatio 0;
BA_ "GenSigTimeoutTime_DMSM" SG_ 278 DriveLineRatio 0;
BA_ "GenSigTimeoutTime_DTCM" SG_ 278 DriveLineRatio 0;
BA_ "GenSigTimeoutTime_ELSDM" SG_ 278 DriveLineRatio 0;
BA_ "GenSigTimeoutTime_ESL" SG_ 278 DriveLineRatio 0;
BA_ "GenSigTimeoutTime_GNMM" SG_ 278 DriveLineRatio 0;
BA_ "GenSigTimeoutTime_IPC" SG_ 278 DriveLineRatio 0;
BA_ "GenSigTimeoutTime_RFHM" SG_ 278 DriveLineRatio 0;
BA_ "GenSigTimeoutTime_SGW" SG_ 278 DriveLineRatio 0;
BA_ "GenSigTimeoutTime_TCM" SG_ 278 DriveLineRatio 0;
BA_ "GenSigTimeoutTime_AGSM" SG_ 278 TCM_Req_EngSpeed_Sts 0;
BA_ "GenSigTimeoutTime_ASBS" SG_ 278 TCM_Req_EngSpeed_Sts 0;
BA_ "GenSigTimeoutTime_BCM" SG_ 278 TCM_Req_EngSpeed_Sts 0;
BA_ "GenSigTimeoutTime_BSM" SG_ 278 TCM_Req_EngSpeed_Sts 0;
BA_ "GenSigTimeoutTime_CADM" SG_ 278 TCM_Req_EngSpeed_Sts 0;
BA_ "GenSigTimeoutTime_DMSM" SG_ 278 TCM_Req_EngSpeed_Sts 0;
BA_ "GenSigTimeoutTime_DTCM" SG_ 278 TCM_Req_EngSpeed_Sts 0;
BA_ "GenSigTimeoutTime_ELSDM" SG_ 278 TCM_Req_EngSpeed_Sts 0;
BA_ "GenSigTimeoutTime_ESL" SG_ 278 TCM_Req_EngSpeed_Sts 0;
BA_ "GenSigTimeoutTime_GNMM" SG_ 278 TCM_Req_EngSpeed_Sts 0;
BA_ "GenSigTimeoutTime_IPC" SG_ 278 TCM_Req_EngSpeed_Sts 0;
BA_ "GenSigTimeoutTime_RFHM" SG_ 278 TCM_Req_EngSpeed_Sts 0;
BA_ "GenSigTimeoutTime_SGW" SG_ 278 TCM_Req_EngSpeed_Sts 0;
BA_ "GenSigTimeoutTime_TCM" SG_ 278 TCM_Req_EngSpeed_Sts 0;
BA_ "GenSigTimeoutTime_AGSM" SG_ 278 TorqueConverterSTO 0;
BA_ "GenSigTimeoutTime_ASBS" SG_ 278 TorqueConverterSTO 0;
BA_ "GenSigTimeoutTime_BCM" SG_ 278 TorqueConverterSTO 0;
BA_ "GenSigTimeoutTime_BSM" SG_ 278 TorqueConverterSTO 0;
BA_ "GenSigTimeoutTime_CADM" SG_ 278 TorqueConverterSTO 0;
BA_ "GenSigTimeoutTime_DMSM" SG_ 278 TorqueConverterSTO 0;
BA_ "GenSigTimeoutTime_DTCM" SG_ 278 TorqueConverterSTO 0;
BA_ "GenSigTimeoutTime_ELSDM" SG_ 278 TorqueConverterSTO 0;
BA_ "GenSigTimeoutTime_ESL" SG_ 278 TorqueConverterSTO 0;
BA_ "GenSigTimeoutTime_GNMM" SG_ 278 TorqueConverterSTO 0;
BA_ "GenSigTimeoutTime_IPC" SG_ 278 TorqueConverterSTO 0;
BA_ "GenSigTimeoutTime_RFHM" SG_ 278 TorqueConverterSTO 0;
BA_ "GenSigTimeoutTime_TCM" SG_ 278 TorqueConverterSTO 0;
BA_ "GenSigTimeoutTime_AGSM" SG_ 278 TorqueConverterSts 0;
BA_ "GenSigTimeoutTime_ASBS" SG_ 278 TorqueConverterSts 0;
BA_ "GenSigTimeoutTime_BCM" SG_ 278 TorqueConverterSts 0;
BA_ "GenSigTimeoutTime_CADM" SG_ 278 TorqueConverterSts 0;
BA_ "GenSigTimeoutTime_DMSM" SG_ 278 TorqueConverterSts 0;
BA_ "GenSigTimeoutTime_DTCM" SG_ 278 TorqueConverterSts 0;
BA_ "GenSigTimeoutTime_ELSDM" SG_ 278 TorqueConverterSts 0;
BA_ "GenSigTimeoutTime_ESL" SG_ 278 TorqueConverterSts 0;
BA_ "GenSigTimeoutTime_GNMM" SG_ 278 TorqueConverterSts 0;
BA_ "GenSigTimeoutTime_IPC" SG_ 278 TorqueConverterSts 0;
BA_ "GenSigTimeoutTime_RFHM" SG_ 278 TorqueConverterSts 0;
BA_ "GenSigTimeoutTime_TCM" SG_ 278 TorqueConverterSts 0;
BA_ "GenSigTimeoutTime_AGSM" SG_ 278 TransLosses 0;
BA_ "GenSigTimeoutTime_ASBS" SG_ 278 TransLosses 0;
BA_ "GenSigTimeoutTime_BCM" SG_ 278 TransLosses 0;
BA_ "GenSigTimeoutTime_BSM" SG_ 278 TransLosses 0;
BA_ "GenSigTimeoutTime_CADM" SG_ 278 TransLosses 0;
BA_ "GenSigTimeoutTime_DMSM" SG_ 278 TransLosses 0;
BA_ "GenSigTimeoutTime_DTCM" SG_ 278 TransLosses 0;
BA_ "GenSigTimeoutTime_ELSDM" SG_ 278 TransLosses 0;
BA_ "GenSigTimeoutTime_ESL" SG_ 278 TransLosses 0;
BA_ "GenSigTimeoutTime_GNMM" SG_ 278 TransLosses 0;
BA_ "GenSigTimeoutTime_HCP" SG_ 278 TransLosses 0;
BA_ "GenSigTimeoutTime_IPC" SG_ 278 TransLosses 0;
BA_ "GenSigTimeoutTime_RFHM" SG_ 278 TransLosses 0;
BA_ "GenSigTimeoutTime_SGW" SG_ 278 TransLosses 0;
BA_ "GenSigTimeoutTime_TCM" SG_ 278 TransLosses 0;
BA_ "GenSigTimeoutTime_AGSM" SG_ 278 TxIdleRq 0;
BA_ "GenSigTimeoutTime_ASBS" SG_ 278 TxIdleRq 0;
BA_ "GenSigTimeoutTime_BCM" SG_ 278 TxIdleRq 0;
BA_ "GenSigTimeoutTime_BSM" SG_ 278 TxIdleRq 0;
BA_ "GenSigTimeoutTime_CADM" SG_ 278 TxIdleRq 0;
BA_ "GenSigTimeoutTime_DMSM" SG_ 278 TxIdleRq 0;
BA_ "GenSigTimeoutTime_DTCM" SG_ 278 TxIdleRq 0;
BA_ "GenSigTimeoutTime_ELSDM" SG_ 278 TxIdleRq 0;
BA_ "GenSigTimeoutTime_ESL" SG_ 278 TxIdleRq 0;
BA_ "GenSigTimeoutTime_GNMM" SG_ 278 TxIdleRq 0;
BA_ "GenSigTimeoutTime_IPC" SG_ 278 TxIdleRq 0;
BA_ "GenSigTimeoutTime_RFHM" SG_ 278 TxIdleRq 0;
BA_ "GenSigTimeoutTime_SGW" SG_ 278 TxIdleRq 0;
BA_ "GenSigTimeoutTime_TCM" SG_ 278 TxIdleRq 0;
BA_ "GenSigTimeoutTime_ADCAM" SG_ 1456 HAS_TelltaleSts 0;
BA_ "GenSigTimeoutTime_VDCM" SG_ 1456 HAS_TelltaleSts 0;
BA_ "GenSigSendType" SG_ 1456 HAS_TelltaleSts 3;
BA_ "GenSigTimeoutTime_AGSM" SG_ 1456 HAS_TelltaleSts 0;
BA_ "GenSigTimeoutTime_BCM" SG_ 1456 HAS_TelltaleSts 0;
BA_ "GenSigTimeoutTime_BSM" SG_ 1456 HAS_TelltaleSts 0;
BA_ "GenSigTimeoutTime_DTCM" SG_ 1456 HAS_TelltaleSts 0;
BA_ "GenSigTimeoutTime_ESL" SG_ 1456 HAS_TelltaleSts 0;
BA_ "GenSigTimeoutTime_RFHM" SG_ 1456 HAS_TelltaleSts 0;
BA_ "GenSigTimeoutTime_TCM" SG_ 1456 HAS_TelltaleSts 0;
BA_ "GenSigTimeoutTime_ADCAM" SG_ 1456 Set_Speed_KPH 0;
BA_ "GenSigTimeoutTime_VDCM" SG_ 1456 Set_Speed_KPH 0;
BA_ "GenSigSendType" SG_ 1456 Set_Speed_KPH 3;
BA_ "GenSigTimeoutTime_AGSM" SG_ 1456 Set_Speed_KPH 0;
BA_ "GenSigTimeoutTime_ASBS" SG_ 1456 Set_Speed_KPH 0;
BA_ "GenSigTimeoutTime_BCM" SG_ 1456 Set_Speed_KPH 0;
BA_ "GenSigTimeoutTime_BSM" SG_ 1456 Set_Speed_KPH 0;
BA_ "GenSigTimeoutTime_CADM" SG_ 1456 Set_Speed_KPH 0;
BA_ "GenSigTimeoutTime_DMSM" SG_ 1456 Set_Speed_KPH 0;
BA_ "GenSigTimeoutTime_DTCM" SG_ 1456 Set_Speed_KPH 0;
BA_ "GenSigTimeoutTime_ELSDM" SG_ 1456 Set_Speed_KPH 0;
BA_ "GenSigTimeoutTime_ESL" SG_ 1456 Set_Speed_KPH 0;
BA_ "GenSigTimeoutTime_GNMM" SG_ 1456 Set_Speed_KPH 0;
BA_ "GenSigTimeoutTime_HCP" SG_ 1456 Set_Speed_KPH 0;
BA_ "GenSigTimeoutTime_RFHM" SG_ 1456 Set_Speed_KPH 0;
BA_ "GenSigTimeoutTime_AGSM" SG_ 1456 CRC_ADAS_FD_HMI 0;
BA_ "GenSigTimeoutTime_ASBS" SG_ 1456 CRC_ADAS_FD_HMI 0;
BA_ "GenSigTimeoutTime_BCM" SG_ 1456 CRC_ADAS_FD_HMI 0;
BA_ "GenSigTimeoutTime_CADM" SG_ 1456 CRC_ADAS_FD_HMI 0;
BA_ "GenSigTimeoutTime_DTCM" SG_ 1456 CRC_ADAS_FD_HMI 0;
BA_ "GenSigTimeoutTime_ELSDM" SG_ 1456 CRC_ADAS_FD_HMI 0;
BA_ "GenSigTimeoutTime_ESL" SG_ 1456 CRC_ADAS_FD_HMI 0;
BA_ "GenSigTimeoutTime_GNMM" SG_ 1456 CRC_ADAS_FD_HMI 0;
BA_ "GenSigTimeoutTime_HCP" SG_ 1456 CRC_ADAS_FD_HMI 0;
BA_ "GenSigTimeoutTime_RFHM" SG_ 1456 CRC_ADAS_FD_HMI 0;
BA_ "GenSigTimeoutTime_SGW" SG_ 1456 CRC_ADAS_FD_HMI 0;
BA_ "GenSigTimeoutTime_TCM" SG_ 1456 CRC_ADAS_FD_HMI 0;
BA_ "GenSigTimeoutTime_AGSM" SG_ 1456 MessageCounter_ADAS_FD_HMI 0;
BA_ "GenSigTimeoutTime_ASBS" SG_ 1456 MessageCounter_ADAS_FD_HMI 0;
BA_ "GenSigTimeoutTime_BCM" SG_ 1456 MessageCounter_ADAS_FD_HMI 0;
BA_ "GenSigTimeoutTime_CADM" SG_ 1456 MessageCounter_ADAS_FD_HMI 0;
BA_ "GenSigTimeoutTime_DTCM" SG_ 1456 MessageCounter_ADAS_FD_HMI 0;
BA_ "GenSigTimeoutTime_ELSDM" SG_ 1456 MessageCounter_ADAS_FD_HMI 0;
BA_ "GenSigTimeoutTime_ESL" SG_ 1456 MessageCounter_ADAS_FD_HMI 0;
BA_ "GenSigTimeoutTime_GNMM" SG_ 1456 MessageCounter_ADAS_FD_HMI 0;
BA_ "GenSigTimeoutTime_HCP" SG_ 1456 MessageCounter_ADAS_FD_HMI 0;
BA_ "GenSigTimeoutTime_RFHM" SG_ 1456 MessageCounter_ADAS_FD_HMI 0;
BA_ "GenSigTimeoutTime_SGW" SG_ 1456 MessageCounter_ADAS_FD_HMI 0;
BA_ "GenSigTimeoutTime_TCM" SG_ 1456 MessageCounter_ADAS_FD_HMI 0;
BA_ "GenSigSendType" SG_ 610 TSRSts 3;
BA_ "GenSigTimeoutTime_AGSM" SG_ 610 TSRSts 0;
BA_ "GenSigTimeoutTime_ASBS" SG_ 610 TSRSts 0;
BA_ "GenSigTimeoutTime_BCM" SG_ 610 TSRSts 0;
BA_ "GenSigTimeoutTime_BSM" SG_ 610 TSRSts 0;
BA_ "GenSigTimeoutTime_CADM" SG_ 610 TSRSts 0;
BA_ "GenSigTimeoutTime_DMSM" SG_ 610 TSRSts 0;
BA_ "GenSigTimeoutTime_DTCM" SG_ 610 TSRSts 0;
BA_ "GenSigTimeoutTime_ELSDM" SG_ 610 TSRSts 0;
BA_ "GenSigTimeoutTime_ESL" SG_ 610 TSRSts 0;
BA_ "GenSigTimeoutTime_GNMM" SG_ 610 TSRSts 0;
BA_ "GenSigTimeoutTime_HCP" SG_ 610 TSRSts 0;
BA_ "GenSigTimeoutTime_RFHM" SG_ 610 TSRSts 0;
BA_ "GenSigTimeoutTime_TCM" SG_ 610 TSRSts 0;
BA_ "GenSigTimeoutTime_ADCAM" SG_ 1435 DRV_TEMP_DR_POS_PCT 0;
BA_ "GenSigTimeoutTime_EVCU2" SG_ 1435 DRV_TEMP_DR_POS_PCT 0;
BA_ "GenSigTimeoutTime_VDCM" SG_ 1435 DRV_TEMP_DR_POS_PCT 0;
BA_ "GenSigStartValue" SG_ 1435 HVAC_CLNT_FLW_MIN 255;
BA_ "GenSigSendType" SG_ 1435 HVAC_CLNT_FLW_MIN 3;
BA_ "GenSigTimeoutTime_AGSM" SG_ 1435 HVAC_CLNT_FLW_MIN 0;
BA_ "GenSigTimeoutTime_ASBS" SG_ 1435 HVAC_CLNT_FLW_MIN 0;
BA_ "GenSigTimeoutTime_BCM" SG_ 1435 HVAC_CLNT_FLW_MIN 0;
BA_ "GenSigTimeoutTime_BSM" SG_ 1435 HVAC_CLNT_FLW_MIN 0;
BA_ "GenSigTimeoutTime_CADM" SG_ 1435 HVAC_CLNT_FLW_MIN 0;
BA_ "GenSigTimeoutTime_DMSM" SG_ 1435 HVAC_CLNT_FLW_MIN 0;
BA_ "GenSigTimeoutTime_DTCM" SG_ 1435 HVAC_CLNT_FLW_MIN 0;
BA_ "GenSigTimeoutTime_ELSDM" SG_ 1435 HVAC_CLNT_FLW_MIN 0;
BA_ "GenSigTimeoutTime_ESL" SG_ 1435 HVAC_CLNT_FLW_MIN 0;
BA_ "GenSigTimeoutTime_GNMM" SG_ 1435 HVAC_CLNT_FLW_MIN 0;
BA_ "GenSigTimeoutTime_HCP" SG_ 1435 HVAC_CLNT_FLW_MIN 0;
BA_ "GenSigTimeoutTime_IPC" SG_ 1435 HVAC_CLNT_FLW_MIN 0;
BA_ "GenSigTimeoutTime_RFHM" SG_ 1435 HVAC_CLNT_FLW_MIN 0;
BA_ "GenSigTimeoutTime_SGW" SG_ 1435 HVAC_CLNT_FLW_MIN 0;
BA_ "GenSigTimeoutTime_TCM" SG_ 1435 HVAC_CLNT_FLW_MIN 0;
BA_ "GenSigStartValue" SG_ 1435 DRV_TEMP_DR_POS_PCT 255;
BA_ "GenSigSendType" SG_ 1435 DRV_TEMP_DR_POS_PCT 3;
BA_ "GenSigTimeoutTime_AGSM" SG_ 1435 DRV_TEMP_DR_POS_PCT 0;
BA_ "GenSigTimeoutTime_ASBS" SG_ 1435 DRV_TEMP_DR_POS_PCT 0;
BA_ "GenSigTimeoutTime_BCM" SG_ 1435 DRV_TEMP_DR_POS_PCT 0;
BA_ "GenSigTimeoutTime_BSM" SG_ 1435 DRV_TEMP_DR_POS_PCT 0;
BA_ "GenSigTimeoutTime_CADM" SG_ 1435 DRV_TEMP_DR_POS_PCT 0;
BA_ "GenSigTimeoutTime_DMSM" SG_ 1435 DRV_TEMP_DR_POS_PCT 0;
BA_ "GenSigTimeoutTime_DTCM" SG_ 1435 DRV_TEMP_DR_POS_PCT 0;
BA_ "GenSigTimeoutTime_ELSDM" SG_ 1435 DRV_TEMP_DR_POS_PCT 0;
BA_ "GenSigTimeoutTime_ESL" SG_ 1435 DRV_TEMP_DR_POS_PCT 0;
BA_ "GenSigTimeoutTime_GNMM" SG_ 1435 DRV_TEMP_DR_POS_PCT 0;
BA_ "GenSigTimeoutTime_HCP" SG_ 1435 DRV_TEMP_DR_POS_PCT 0;
BA_ "GenSigTimeoutTime_IPC" SG_ 1435 DRV_TEMP_DR_POS_PCT 0;
BA_ "GenSigTimeoutTime_ADCAM" SG_ 1036 EngineOilCritical 0;
BA_ "GenSigTimeoutTime_EVCU2" SG_ 1036 EngineOilCritical 0;
BA_ "GenSigTimeoutTime_VDCM" SG_ 1036 EngineOilCritical 0;
BA_ "GenSigSendType" SG_ 1036 EngineOilCritical 3;
BA_ "GenSigTimeoutTime_AGSM" SG_ 1036 EngineOilCritical 0;
BA_ "GenSigTimeoutTime_BCM" SG_ 1036 EngineOilCritical 0;
BA_ "GenSigTimeoutTime_BSM" SG_ 1036 EngineOilCritical 0;
BA_ "GenSigTimeoutTime_DTCM" SG_ 1036 EngineOilCritical 0;
BA_ "GenSigTimeoutTime_ECM" SG_ 1036 EngineOilCritical 0;
BA_ "GenSigTimeoutTime_ESL" SG_ 1036 EngineOilCritical 0;
BA_ "GenSigTimeoutTime_RFHM" SG_ 1036 EngineOilCritical 0;
BA_ "GenSigTimeoutTime_SGW" SG_ 1036 EngineOilCritical 0;
BA_ "GenSigTimeoutTime_TCM" SG_ 1036 EngineOilCritical 0;
BA_ "GenSigTimeoutTime_ADCAM" SG_ 1036 AfterRunCoolantPumpFailSts 0;
BA_ "GenSigTimeoutTime_EVCU2" SG_ 1036 AfterRunCoolantPumpFailSts 0;
BA_ "GenSigTimeoutTime_VDCM" SG_ 1036 AfterRunCoolantPumpFailSts 0;
BA_ "GenSigSendType" SG_ 1036 AfterRunCoolantPumpFailSts 3;
BA_ "GenSigTimeoutTime_AGSM" SG_ 1036 AfterRunCoolantPumpFailSts 0;
BA_ "GenSigTimeoutTime_BCM" SG_ 1036 AfterRunCoolantPumpFailSts 0;
BA_ "GenSigTimeoutTime_BSM" SG_ 1036 AfterRunCoolantPumpFailSts 0;
BA_ "GenSigTimeoutTime_DTCM" SG_ 1036 AfterRunCoolantPumpFailSts 0;
BA_ "GenSigTimeoutTime_ECM" SG_ 1036 AfterRunCoolantPumpFailSts 0;
BA_ "GenSigTimeoutTime_ESL" SG_ 1036 AfterRunCoolantPumpFailSts 0;
BA_ "GenSigTimeoutTime_RFHM" SG_ 1036 AfterRunCoolantPumpFailSts 0;
BA_ "GenSigTimeoutTime_SGW" SG_ 1036 AfterRunCoolantPumpFailSts 0;
BA_ "GenSigTimeoutTime_TCM" SG_ 1036 AfterRunCoolantPumpFailSts 0;
BA_ "GenSigTimeoutTime_ADCAM" SG_ 1036 EngineOilMin 0;
BA_ "GenSigTimeoutTime_EVCU2" SG_ 1036 EngineOilMin 0;
BA_ "GenSigTimeoutTime_VDCM" SG_ 1036 EngineOilMin 0;
BA_ "GenSigSendType" SG_ 1036 EngineOilMin 3;
BA_ "GenSigTimeoutTime_AGSM" SG_ 1036 EngineOilMin 0;
BA_ "GenSigTimeoutTime_BCM" SG_ 1036 EngineOilMin 0;
BA_ "GenSigTimeoutTime_BSM" SG_ 1036 EngineOilMin 0;
BA_ "GenSigTimeoutTime_DTCM" SG_ 1036 EngineOilMin 0;
BA_ "GenSigTimeoutTime_ECM" SG_ 1036 EngineOilMin 0;
BA_ "GenSigTimeoutTime_ESL" SG_ 1036 EngineOilMin 0;
BA_ "GenSigTimeoutTime_RFHM" SG_ 1036 EngineOilMin 0;
BA_ "GenSigTimeoutTime_SGW" SG_ 1036 EngineOilMin 0;
BA_ "GenSigTimeoutTime_TCM" SG_ 1036 EngineOilMin 0;
BA_ "GenSigTimeoutTime_ADCAM" SG_ 1036 EngineOilOverfill 0;
BA_ "GenSigTimeoutTime_EVCU2" SG_ 1036 EngineOilOverfill 0;
BA_ "GenSigTimeoutTime_VDCM" SG_ 1036 EngineOilOverfill 0;
BA_ "GenSigSendType" SG_ 1036 EngineOilOverfill 3;
BA_ "GenSigTimeoutTime_AGSM" SG_ 1036 EngineOilOverfill 0;
BA_ "GenSigTimeoutTime_BCM" SG_ 1036 EngineOilOverfill 0;
BA_ "GenSigTimeoutTime_BSM" SG_ 1036 EngineOilOverfill 0;
BA_ "GenSigTimeoutTime_DTCM" SG_ 1036 EngineOilOverfill 0;
BA_ "GenSigTimeoutTime_ECM" SG_ 1036 EngineOilOverfill 0;
BA_ "GenSigTimeoutTime_ESL" SG_ 1036 EngineOilOverfill 0;
BA_ "GenSigTimeoutTime_RFHM" SG_ 1036 EngineOilOverfill 0;
BA_ "GenSigTimeoutTime_SGW" SG_ 1036 EngineOilOverfill 0;
BA_ "GenSigTimeoutTime_TCM" SG_ 1036 EngineOilOverfill 0;
BA_ "GenSigTimeoutTime_ADCAM" SG_ 1036 EngineOilLevel 0;
BA_ "GenSigTimeoutTime_EVCU2" SG_ 1036 EngineOilLevel 0;
BA_ "GenSigTimeoutTime_VDCM" SG_ 1036 EngineOilLevel 0;
BA_ "GenSigTimeoutTime_AGSM" SG_ 1036 EngineOilLevel 0;
BA_ "GenSigTimeoutTime_BCM" SG_ 1036 EngineOilLevel 0;
BA_ "GenSigTimeoutTime_BSM" SG_ 1036 EngineOilLevel 0;
BA_ "GenSigTimeoutTime_DTCM" SG_ 1036 EngineOilLevel 0;
BA_ "GenSigTimeoutTime_ECM" SG_ 1036 EngineOilLevel 0;
BA_ "GenSigTimeoutTime_ESL" SG_ 1036 EngineOilLevel 0;
BA_ "GenSigTimeoutTime_RFHM" SG_ 1036 EngineOilLevel 0;
BA_ "GenSigTimeoutTime_SGW" SG_ 1036 EngineOilLevel 0;
BA_ "GenSigTimeoutTime_TCM" SG_ 1036 EngineOilLevel 0;
BA_ "GenSigTimeoutTime_ADCAM" SG_ 1036 Racemode_Popup_ECM 0;
BA_ "GenSigTimeoutTime_EVCU2" SG_ 1036 Racemode_Popup_ECM 0;
BA_ "GenSigTimeoutTime_VDCM" SG_ 1036 Racemode_Popup_ECM 0;
BA_ "GenSigTimeoutTime_AGSM" SG_ 1036 Racemode_Popup_ECM 0;
BA_ "GenSigTimeoutTime_BCM" SG_ 1036 Racemode_Popup_ECM 0;
BA_ "GenSigTimeoutTime_BSM" SG_ 1036 Racemode_Popup_ECM 0;
BA_ "GenSigTimeoutTime_DTCM" SG_ 1036 Racemode_Popup_ECM 0;
BA_ "GenSigTimeoutTime_ECM" SG_ 1036 Racemode_Popup_ECM 0;
BA_ "GenSigTimeoutTime_ESL" SG_ 1036 Racemode_Popup_ECM 0;
BA_ "GenSigTimeoutTime_RFHM" SG_ 1036 Racemode_Popup_ECM 0;
BA_ "GenSigTimeoutTime_SGW" SG_ 1036 Racemode_Popup_ECM 0;
BA_ "GenSigTimeoutTime_TCM" SG_ 1036 Racemode_Popup_ECM 0;
BA_ "GenSigTimeoutTime_ADCAM" SG_ 1036 Launch_Hard_Btn_LED_ECM 0;
BA_ "GenSigTimeoutTime_EVCU2" SG_ 1036 Launch_Hard_Btn_LED_ECM 0;
BA_ "GenSigTimeoutTime_VDCM" SG_ 1036 Launch_Hard_Btn_LED_ECM 0;
BA_ "GenSigTimeoutTime_AGSM" SG_ 1036 Launch_Hard_Btn_LED_ECM 0;
BA_ "GenSigTimeoutTime_BSM" SG_ 1036 Launch_Hard_Btn_LED_ECM 0;
BA_ "GenSigTimeoutTime_DTCM" SG_ 1036 Launch_Hard_Btn_LED_ECM 0;
BA_ "GenSigTimeoutTime_ECM" SG_ 1036 Launch_Hard_Btn_LED_ECM 0;
BA_ "GenSigTimeoutTime_ESL" SG_ 1036 Launch_Hard_Btn_LED_ECM 0;
BA_ "GenSigTimeoutTime_IPC" SG_ 1036 Launch_Hard_Btn_LED_ECM 0;
BA_ "GenSigTimeoutTime_RFHM" SG_ 1036 Launch_Hard_Btn_LED_ECM 0;
BA_ "GenSigTimeoutTime_SGW" SG_ 1036 Launch_Hard_Btn_LED_ECM 0;
BA_ "GenSigTimeoutTime_TCM" SG_ 1036 Launch_Hard_Btn_LED_ECM 0;
BA_ "GenSigTimeoutTime_ADCAM" SG_ 1036 CC_SetSpdDspl_MPH 0;
BA_ "GenSigTimeoutTime_EVCU2" SG_ 1036 CC_SetSpdDspl_MPH 0;
BA_ "GenSigTimeoutTime_VDCM" SG_ 1036 CC_SetSpdDspl_MPH 0;
BA_ "GenSigTimeoutTime_IPC" SG_ 1036 CC_SetSpdDspl_MPH 0;
BA_ "GenSigTimeoutTime_ADCAM" SG_ 1036 DistOilLifeRst 0;
BA_ "GenSigTimeoutTime_EVCU2" SG_ 1036 DistOilLifeRst 0;
BA_ "GenSigTimeoutTime_VDCM" SG_ 1036 DistOilLifeRst 0;
BA_ "GenSigTimeoutTime_ADCAM" SG_ 1036 OIL_IND_LMP_FLSH 0;
BA_ "GenSigTimeoutTime_EVCU2" SG_ 1036 OIL_IND_LMP_FLSH 0;
BA_ "GenSigTimeoutTime_VDCM" SG_ 1036 OIL_IND_LMP_FLSH 0;
BA_ "GenSigTimeoutTime_ADCAM" SG_ 1036 OIL_TEMP_CHM_RQ 0;
BA_ "GenSigTimeoutTime_EVCU2" SG_ 1036 OIL_TEMP_CHM_RQ 0;
BA_ "GenSigTimeoutTime_VDCM" SG_ 1036 OIL_TEMP_CHM_RQ 0;
BA_ "GenSigTimeoutTime_ADCAM" SG_ 1036 OIL_TEMP_IND_RQ 0;
BA_ "GenSigTimeoutTime_EVCU2" SG_ 1036 OIL_TEMP_IND_RQ 0;
BA_ "GenSigTimeoutTime_VDCM" SG_ 1036 OIL_TEMP_IND_RQ 0;
BA_ "GenSigTimeoutTime_ADCAM" SG_ 1036 OilLifeLeft 0;
BA_ "GenSigTimeoutTime_EVCU2" SG_ 1036 OilLifeLeft 0;
BA_ "GenSigTimeoutTime_VDCM" SG_ 1036 OilLifeLeft 0;
BA_ "GenSigTimeoutTime_ADCAM" SG_ 1036 FANStatus 0;
BA_ "GenSigTimeoutTime_EVCU2" SG_ 1036 FANStatus 0;
BA_ "GenSigTimeoutTime_VDCM" SG_ 1036 FANStatus 0;
BA_ "GenSigTimeoutTime_ADCAM" SG_ 1036 EngineOilTemperature 0;
BA_ "GenSigTimeoutTime_EVCU2" SG_ 1036 EngineOilTemperature 0;
BA_ "GenSigTimeoutTime_VDCM" SG_ 1036 EngineOilTemperature 0;
BA_ "GenSigTimeoutTime_TCM" SG_ 1036 EngineOilTemperature 0;
BA_ "GenSigTimeoutTime_ADCAM" SG_ 1036 DefFuelEcon 0;
BA_ "GenSigTimeoutTime_EVCU2" SG_ 1036 DefFuelEcon 0;
BA_ "GenSigTimeoutTime_VDCM" SG_ 1036 DefFuelEcon 0;
BA_ "GenSigTimeoutTime_ADCAM" SG_ 1036 OilLifeLeftRst 0;
BA_ "GenSigTimeoutTime_EVCU2" SG_ 1036 OilLifeLeftRst 0;
BA_ "GenSigTimeoutTime_VDCM" SG_ 1036 OilLifeLeftRst 0;
BA_ "GenSigSendType" SG_ 1036 CC_SetSpdDspl_MPH 3;
BA_ "GenSigTimeoutTime_AGSM" SG_ 1036 CC_SetSpdDspl_MPH 0;
BA_ "GenSigTimeoutTime_ASBS" SG_ 1036 CC_SetSpdDspl_MPH 0;
BA_ "GenSigTimeoutTime_BCM" SG_ 1036 CC_SetSpdDspl_MPH 0;
BA_ "GenSigTimeoutTime_BSM" SG_ 1036 CC_SetSpdDspl_MPH 0;
BA_ "GenSigTimeoutTime_CADM" SG_ 1036 CC_SetSpdDspl_MPH 0;
BA_ "GenSigTimeoutTime_DMSM" SG_ 1036 CC_SetSpdDspl_MPH 0;
BA_ "GenSigTimeoutTime_DTCM" SG_ 1036 CC_SetSpdDspl_MPH 0;
BA_ "GenSigTimeoutTime_ECM" SG_ 1036 CC_SetSpdDspl_MPH 0;
BA_ "GenSigTimeoutTime_ELSDM" SG_ 1036 CC_SetSpdDspl_MPH 0;
BA_ "GenSigTimeoutTime_ESL" SG_ 1036 CC_SetSpdDspl_MPH 0;
BA_ "GenSigTimeoutTime_GNMM" SG_ 1036 CC_SetSpdDspl_MPH 0;
BA_ "GenSigTimeoutTime_HCP" SG_ 1036 CC_SetSpdDspl_MPH 0;
BA_ "GenSigTimeoutTime_RFHM" SG_ 1036 CC_SetSpdDspl_MPH 0;
BA_ "GenSigTimeoutTime_SGW" SG_ 1036 CC_SetSpdDspl_MPH 0;
BA_ "GenSigTimeoutTime_TCM" SG_ 1036 CC_SetSpdDspl_MPH 0;
BA_ "GenSigStartValue" SG_ 1036 DistOilLifeRst 65535;
BA_ "GenSigSendType" SG_ 1036 DistOilLifeRst 3;
BA_ "GenSigTimeoutTime_AGSM" SG_ 1036 DistOilLifeRst 0;
BA_ "GenSigTimeoutTime_ASBS" SG_ 1036 DistOilLifeRst 0;
BA_ "GenSigTimeoutTime_BSM" SG_ 1036 DistOilLifeRst 0;
BA_ "GenSigTimeoutTime_CADM" SG_ 1036 DistOilLifeRst 0;
BA_ "GenSigTimeoutTime_DMSM" SG_ 1036 DistOilLifeRst 0;
BA_ "GenSigTimeoutTime_DTCM" SG_ 1036 DistOilLifeRst 0;
BA_ "GenSigTimeoutTime_ECM" SG_ 1036 DistOilLifeRst 0;
BA_ "GenSigTimeoutTime_ELSDM" SG_ 1036 DistOilLifeRst 0;
BA_ "GenSigTimeoutTime_ESL" SG_ 1036 DistOilLifeRst 0;
BA_ "GenSigTimeoutTime_GNMM" SG_ 1036 DistOilLifeRst 0;
BA_ "GenSigTimeoutTime_HCP" SG_ 1036 DistOilLifeRst 0;
BA_ "GenSigTimeoutTime_RFHM" SG_ 1036 DistOilLifeRst 0;
BA_ "GenSigTimeoutTime_SGW" SG_ 1036 DistOilLifeRst 0;
BA_ "GenSigTimeoutTime_TCM" SG_ 1036 DistOilLifeRst 0;
BA_ "GenSigSendType" SG_ 1036 OIL_IND_LMP_FLSH 3;
BA_ "GenSigTimeoutTime_AGSM" SG_ 1036 OIL_IND_LMP_FLSH 0;
BA_ "GenSigTimeoutTime_ASBS" SG_ 1036 OIL_IND_LMP_FLSH 0;
BA_ "GenSigTimeoutTime_BCM" SG_ 1036 OIL_IND_LMP_FLSH 0;
BA_ "GenSigTimeoutTime_BSM" SG_ 1036 OIL_IND_LMP_FLSH 0;
BA_ "GenSigTimeoutTime_CADM" SG_ 1036 OIL_IND_LMP_FLSH 0;
BA_ "GenSigTimeoutTime_DMSM" SG_ 1036 OIL_IND_LMP_FLSH 0;
BA_ "GenSigTimeoutTime_DTCM" SG_ 1036 OIL_IND_LMP_FLSH 0;
BA_ "GenSigTimeoutTime_ECM" SG_ 1036 OIL_IND_LMP_FLSH 0;
BA_ "GenSigTimeoutTime_ELSDM" SG_ 1036 OIL_IND_LMP_FLSH 0;
BA_ "GenSigTimeoutTime_ESL" SG_ 1036 OIL_IND_LMP_FLSH 0;
BA_ "GenSigTimeoutTime_GNMM" SG_ 1036 OIL_IND_LMP_FLSH 0;
BA_ "GenSigTimeoutTime_HCP" SG_ 1036 OIL_IND_LMP_FLSH 0;
BA_ "GenSigTimeoutTime_RFHM" SG_ 1036 OIL_IND_LMP_FLSH 0;
BA_ "GenSigTimeoutTime_TCM" SG_ 1036 OIL_IND_LMP_FLSH 0;
BA_ "GenSigSendType" SG_ 1036 OIL_TEMP_CHM_RQ 3;
BA_ "GenSigTimeoutTime_AGSM" SG_ 1036 OIL_TEMP_CHM_RQ 0;
BA_ "GenSigTimeoutTime_ASBS" SG_ 1036 OIL_TEMP_CHM_RQ 0;
BA_ "GenSigTimeoutTime_BCM" SG_ 1036 OIL_TEMP_CHM_RQ 0;
BA_ "GenSigTimeoutTime_BSM" SG_ 1036 OIL_TEMP_CHM_RQ 0;
BA_ "GenSigTimeoutTime_CADM" SG_ 1036 OIL_TEMP_CHM_RQ 0;
BA_ "GenSigTimeoutTime_DMSM" SG_ 1036 OIL_TEMP_CHM_RQ 0;
BA_ "GenSigTimeoutTime_DTCM" SG_ 1036 OIL_TEMP_CHM_RQ 0;
BA_ "GenSigTimeoutTime_ECM" SG_ 1036 OIL_TEMP_CHM_RQ 0;
BA_ "GenSigTimeoutTime_ELSDM" SG_ 1036 OIL_TEMP_CHM_RQ 0;
BA_ "GenSigTimeoutTime_ESL" SG_ 1036 OIL_TEMP_CHM_RQ 0;
BA_ "GenSigTimeoutTime_GNMM" SG_ 1036 OIL_TEMP_CHM_RQ 0;
BA_ "GenSigTimeoutTime_HCP" SG_ 1036 OIL_TEMP_CHM_RQ 0;
BA_ "GenSigTimeoutTime_IPC" SG_ 1036 OIL_TEMP_CHM_RQ 0;
BA_ "GenSigTimeoutTime_RFHM" SG_ 1036 OIL_TEMP_CHM_RQ 0;
BA_ "GenSigTimeoutTime_TCM" SG_ 1036 OIL_TEMP_CHM_RQ 0;
BA_ "GenSigSendType" SG_ 1036 OIL_TEMP_IND_RQ 3;
BA_ "GenSigTimeoutTime_AGSM" SG_ 1036 OIL_TEMP_IND_RQ 0;
BA_ "GenSigTimeoutTime_ASBS" SG_ 1036 OIL_TEMP_IND_RQ 0;
BA_ "GenSigTimeoutTime_BCM" SG_ 1036 OIL_TEMP_IND_RQ 0;
BA_ "GenSigTimeoutTime_BSM" SG_ 1036 OIL_TEMP_IND_RQ 0;
BA_ "GenSigTimeoutTime_CADM" SG_ 1036 OIL_TEMP_IND_RQ 0;
BA_ "GenSigTimeoutTime_DMSM" SG_ 1036 OIL_TEMP_IND_RQ 0;
BA_ "GenSigTimeoutTime_DTCM" SG_ 1036 OIL_TEMP_IND_RQ 0;
BA_ "GenSigTimeoutTime_ECM" SG_ 1036 OIL_TEMP_IND_RQ 0;
BA_ "GenSigTimeoutTime_ELSDM" SG_ 1036 OIL_TEMP_IND_RQ 0;
BA_ "GenSigTimeoutTime_ESL" SG_ 1036 OIL_TEMP_IND_RQ 0;
BA_ "GenSigTimeoutTime_GNMM" SG_ 1036 OIL_TEMP_IND_RQ 0;
BA_ "GenSigTimeoutTime_HCP" SG_ 1036 OIL_TEMP_IND_RQ 0;
BA_ "GenSigTimeoutTime_RFHM" SG_ 1036 OIL_TEMP_IND_RQ 0;
BA_ "GenSigTimeoutTime_TCM" SG_ 1036 OIL_TEMP_IND_RQ 0;
BA_ "GenSigStartValue" SG_ 1036 OilLifeLeft 255;
BA_ "GenSigSendType" SG_ 1036 OilLifeLeft 3;
BA_ "GenSigTimeoutTime_AGSM" SG_ 1036 OilLifeLeft 0;
BA_ "GenSigTimeoutTime_ASBS" SG_ 1036 OilLifeLeft 0;
BA_ "GenSigTimeoutTime_BCM" SG_ 1036 OilLifeLeft 0;
BA_ "GenSigTimeoutTime_BSM" SG_ 1036 OilLifeLeft 0;
BA_ "GenSigTimeoutTime_CADM" SG_ 1036 OilLifeLeft 0;
BA_ "GenSigTimeoutTime_DMSM" SG_ 1036 OilLifeLeft 0;
BA_ "GenSigTimeoutTime_DTCM" SG_ 1036 OilLifeLeft 0;
BA_ "GenSigTimeoutTime_ECM" SG_ 1036 OilLifeLeft 0;
BA_ "GenSigTimeoutTime_ELSDM" SG_ 1036 OilLifeLeft 0;
BA_ "GenSigTimeoutTime_ESL" SG_ 1036 OilLifeLeft 0;
BA_ "GenSigTimeoutTime_GNMM" SG_ 1036 OilLifeLeft 0;
BA_ "GenSigTimeoutTime_HCP" SG_ 1036 OilLifeLeft 0;
BA_ "GenSigTimeoutTime_RFHM" SG_ 1036 OilLifeLeft 0;
BA_ "GenSigTimeoutTime_TCM" SG_ 1036 OilLifeLeft 0;
BA_ "GenSigTimeoutTime_AGSM" SG_ 1036 FANStatus 0;
BA_ "GenSigTimeoutTime_ASBS" SG_ 1036 FANStatus 0;
BA_ "GenSigTimeoutTime_BCM" SG_ 1036 FANStatus 0;
BA_ "GenSigTimeoutTime_BSM" SG_ 1036 FANStatus 0;
BA_ "GenSigTimeoutTime_CADM" SG_ 1036 FANStatus 0;
BA_ "GenSigTimeoutTime_DMSM" SG_ 1036 FANStatus 0;
BA_ "GenSigTimeoutTime_DTCM" SG_ 1036 FANStatus 0;
BA_ "GenSigTimeoutTime_ECM" SG_ 1036 FANStatus 0;
BA_ "GenSigTimeoutTime_ELSDM" SG_ 1036 FANStatus 0;
BA_ "GenSigTimeoutTime_ESL" SG_ 1036 FANStatus 0;
BA_ "GenSigTimeoutTime_GNMM" SG_ 1036 FANStatus 0;
BA_ "GenSigTimeoutTime_HCP" SG_ 1036 FANStatus 0;
BA_ "GenSigTimeoutTime_IPC" SG_ 1036 FANStatus 0;
BA_ "GenSigTimeoutTime_RFHM" SG_ 1036 FANStatus 0;
BA_ "GenSigTimeoutTime_SGW" SG_ 1036 FANStatus 0;
BA_ "GenSigTimeoutTime_TCM" SG_ 1036 FANStatus 0;
BA_ "GenSigSendType" SG_ 1036 ISASts 3;
BA_ "GenSigTimeoutTime_AGSM" SG_ 1036 ISASts 0;
BA_ "GenSigTimeoutTime_ASBS" SG_ 1036 ISASts 0;
BA_ "GenSigTimeoutTime_BSM" SG_ 1036 ISASts 0;
BA_ "GenSigTimeoutTime_CADM" SG_ 1036 ISASts 0;
BA_ "GenSigTimeoutTime_DMSM" SG_ 1036 ISASts 0;
BA_ "GenSigTimeoutTime_DTCM" SG_ 1036 ISASts 0;
BA_ "GenSigTimeoutTime_ECM" SG_ 1036 ISASts 0;
BA_ "GenSigTimeoutTime_ELSDM" SG_ 1036 ISASts 0;
BA_ "GenSigTimeoutTime_ESL" SG_ 1036 ISASts 0;
BA_ "GenSigTimeoutTime_GNMM" SG_ 1036 ISASts 0;
BA_ "GenSigTimeoutTime_HCP" SG_ 1036 ISASts 0;
BA_ "GenSigTimeoutTime_RFHM" SG_ 1036 ISASts 0;
BA_ "GenSigTimeoutTime_SGW" SG_ 1036 ISASts 0;
BA_ "GenSigTimeoutTime_TCM" SG_ 1036 ISASts 0;
BA_ "GenSigTimeoutTime_AGSM" SG_ 1036 MessageCounter_ENGINE3 0;
BA_ "GenSigTimeoutTime_ASBS" SG_ 1036 MessageCounter_ENGINE3 0;
BA_ "GenSigTimeoutTime_BCM" SG_ 1036 MessageCounter_ENGINE3 0;
BA_ "GenSigTimeoutTime_DMSM" SG_ 1036 MessageCounter_ENGINE3 0;
BA_ "GenSigTimeoutTime_DTCM" SG_ 1036 MessageCounter_ENGINE3 0;
BA_ "GenSigTimeoutTime_ECM" SG_ 1036 MessageCounter_ENGINE3 0;
BA_ "GenSigTimeoutTime_ELSDM" SG_ 1036 MessageCounter_ENGINE3 0;
BA_ "GenSigTimeoutTime_ESL" SG_ 1036 MessageCounter_ENGINE3 0;
BA_ "GenSigTimeoutTime_GNMM" SG_ 1036 MessageCounter_ENGINE3 0;
BA_ "GenSigTimeoutTime_HCP" SG_ 1036 MessageCounter_ENGINE3 0;
BA_ "GenSigTimeoutTime_IPC" SG_ 1036 MessageCounter_ENGINE3 0;
BA_ "GenSigTimeoutTime_RFHM" SG_ 1036 MessageCounter_ENGINE3 0;
BA_ "GenSigTimeoutTime_SGW" SG_ 1036 MessageCounter_ENGINE3 0;
BA_ "GenSigSendType" SG_ 1036 CC_SetSpdDspl_KPH 3;
BA_ "GenSigTimeoutTime_AGSM" SG_ 1036 CC_SetSpdDspl_KPH 0;
BA_ "GenSigTimeoutTime_ASBS" SG_ 1036 CC_SetSpdDspl_KPH 0;
BA_ "GenSigTimeoutTime_BCM" SG_ 1036 CC_SetSpdDspl_KPH 0;
BA_ "GenSigTimeoutTime_BSM" SG_ 1036 CC_SetSpdDspl_KPH 0;
BA_ "GenSigTimeoutTime_CADM" SG_ 1036 CC_SetSpdDspl_KPH 0;
BA_ "GenSigTimeoutTime_DMSM" SG_ 1036 CC_SetSpdDspl_KPH 0;
BA_ "GenSigTimeoutTime_DTCM" SG_ 1036 CC_SetSpdDspl_KPH 0;
BA_ "GenSigTimeoutTime_ECM" SG_ 1036 CC_SetSpdDspl_KPH 0;
BA_ "GenSigTimeoutTime_ELSDM" SG_ 1036 CC_SetSpdDspl_KPH 0;
BA_ "GenSigTimeoutTime_ESL" SG_ 1036 CC_SetSpdDspl_KPH 0;
BA_ "GenSigTimeoutTime_GNMM" SG_ 1036 CC_SetSpdDspl_KPH 0;
BA_ "GenSigTimeoutTime_HCP" SG_ 1036 CC_SetSpdDspl_KPH 0;
BA_ "GenSigTimeoutTime_RFHM" SG_ 1036 CC_SetSpdDspl_KPH 0;
BA_ "GenSigTimeoutTime_SGW" SG_ 1036 CC_SetSpdDspl_KPH 0;
BA_ "GenSigTimeoutTime_TCM" SG_ 1036 CC_SetSpdDspl_KPH 0;
BA_ "GenSigStartValue" SG_ 1036 EngineOilTemperature 255;
BA_ "GenSigTimeoutTime_AGSM" SG_ 1036 EngineOilTemperature 0;
BA_ "GenSigTimeoutTime_ASBS" SG_ 1036 EngineOilTemperature 0;
BA_ "GenSigTimeoutTime_BCM" SG_ 1036 EngineOilTemperature 0;
BA_ "GenSigTimeoutTime_BSM" SG_ 1036 EngineOilTemperature 0;
BA_ "GenSigTimeoutTime_CADM" SG_ 1036 EngineOilTemperature 0;
BA_ "GenSigTimeoutTime_DMSM" SG_ 1036 EngineOilTemperature 0;
BA_ "GenSigTimeoutTime_DTCM" SG_ 1036 EngineOilTemperature 0;
BA_ "GenSigTimeoutTime_ECM" SG_ 1036 EngineOilTemperature 0;
BA_ "GenSigTimeoutTime_ELSDM" SG_ 1036 EngineOilTemperature 0;
BA_ "GenSigTimeoutTime_ESL" SG_ 1036 EngineOilTemperature 0;
BA_ "GenSigTimeoutTime_GNMM" SG_ 1036 EngineOilTemperature 0;
BA_ "GenSigTimeoutTime_HCP" SG_ 1036 EngineOilTemperature 0;
BA_ "GenSigTimeoutTime_RFHM" SG_ 1036 EngineOilTemperature 0;
BA_ "GenSigTimeoutTime_AGSM" SG_ 1036 CRC_ENGINE3 0;
BA_ "GenSigTimeoutTime_ASBS" SG_ 1036 CRC_ENGINE3 0;
BA_ "GenSigTimeoutTime_BCM" SG_ 1036 CRC_ENGINE3 0;
BA_ "GenSigTimeoutTime_DMSM" SG_ 1036 CRC_ENGINE3 0;
BA_ "GenSigTimeoutTime_DTCM" SG_ 1036 CRC_ENGINE3 0;
BA_ "GenSigTimeoutTime_ECM" SG_ 1036 CRC_ENGINE3 0;
BA_ "GenSigTimeoutTime_ELSDM" SG_ 1036 CRC_ENGINE3 0;
BA_ "GenSigTimeoutTime_ESL" SG_ 1036 CRC_ENGINE3 0;
BA_ "GenSigTimeoutTime_GNMM" SG_ 1036 CRC_ENGINE3 0;
BA_ "GenSigTimeoutTime_HCP" SG_ 1036 CRC_ENGINE3 0;
BA_ "GenSigTimeoutTime_IPC" SG_ 1036 CRC_ENGINE3 0;
BA_ "GenSigTimeoutTime_RFHM" SG_ 1036 CRC_ENGINE3 0;
BA_ "GenSigTimeoutTime_SGW" SG_ 1036 CRC_ENGINE3 0;
BA_ "GenSigStartValue" SG_ 1036 DefFuelEcon 255;
BA_ "GenSigTimeoutTime_AGSM" SG_ 1036 DefFuelEcon 0;
BA_ "GenSigTimeoutTime_ASBS" SG_ 1036 DefFuelEcon 0;
BA_ "GenSigTimeoutTime_BCM" SG_ 1036 DefFuelEcon 0;
BA_ "GenSigTimeoutTime_BSM" SG_ 1036 DefFuelEcon 0;
BA_ "GenSigTimeoutTime_CADM" SG_ 1036 DefFuelEcon 0;
BA_ "GenSigTimeoutTime_DMSM" SG_ 1036 DefFuelEcon 0;
BA_ "GenSigTimeoutTime_DTCM" SG_ 1036 DefFuelEcon 0;
BA_ "GenSigTimeoutTime_ECM" SG_ 1036 DefFuelEcon 0;
BA_ "GenSigTimeoutTime_ELSDM" SG_ 1036 DefFuelEcon 0;
BA_ "GenSigTimeoutTime_ESL" SG_ 1036 DefFuelEcon 0;
BA_ "GenSigTimeoutTime_GNMM" SG_ 1036 DefFuelEcon 0;
BA_ "GenSigTimeoutTime_HCP" SG_ 1036 DefFuelEcon 0;
BA_ "GenSigTimeoutTime_RFHM" SG_ 1036 DefFuelEcon 0;
BA_ "GenSigTimeoutTime_TCM" SG_ 1036 DefFuelEcon 0;
BA_ "GenSigSendType" SG_ 1036 OilLifeLeftRst 3;
BA_ "GenSigTimeoutTime_AGSM" SG_ 1036 OilLifeLeftRst 0;
BA_ "GenSigTimeoutTime_ASBS" SG_ 1036 OilLifeLeftRst 0;
BA_ "GenSigTimeoutTime_BCM" SG_ 1036 OilLifeLeftRst 0;
BA_ "GenSigTimeoutTime_BSM" SG_ 1036 OilLifeLeftRst 0;
BA_ "GenSigTimeoutTime_CADM" SG_ 1036 OilLifeLeftRst 0;
BA_ "GenSigTimeoutTime_DMSM" SG_ 1036 OilLifeLeftRst 0;
BA_ "GenSigTimeoutTime_DTCM" SG_ 1036 OilLifeLeftRst 0;
BA_ "GenSigTimeoutTime_ECM" SG_ 1036 OilLifeLeftRst 0;
BA_ "GenSigTimeoutTime_ELSDM" SG_ 1036 OilLifeLeftRst 0;
BA_ "GenSigTimeoutTime_ESL" SG_ 1036 OilLifeLeftRst 0;
BA_ "GenSigTimeoutTime_GNMM" SG_ 1036 OilLifeLeftRst 0;
BA_ "GenSigTimeoutTime_HCP" SG_ 1036 OilLifeLeftRst 0;
BA_ "GenSigTimeoutTime_RFHM" SG_ 1036 OilLifeLeftRst 0;
BA_ "GenSigTimeoutTime_SGW" SG_ 1036 OilLifeLeftRst 0;
BA_ "GenSigTimeoutTime_TCM" SG_ 1036 OilLifeLeftRst 0;
BA_ "GenSigSendType" SG_ 1036 Override 3;
BA_ "GenSigTimeoutTime_AGSM" SG_ 1036 Override 0;
BA_ "GenSigTimeoutTime_ASBS" SG_ 1036 Override 0;
BA_ "GenSigTimeoutTime_DMSM" SG_ 1036 Override 0;
BA_ "GenSigTimeoutTime_ECM" SG_ 1036 Override 0;
BA_ "GenSigTimeoutTime_ELSDM" SG_ 1036 Override 0;
BA_ "GenSigTimeoutTime_ESL" SG_ 1036 Override 0;
BA_ "GenSigTimeoutTime_GNMM" SG_ 1036 Override 0;
BA_ "GenSigTimeoutTime_HCP" SG_ 1036 Override 0;
BA_ "GenSigTimeoutTime_IPC" SG_ 1036 Override 0;
BA_ "GenSigTimeoutTime_RFHM" SG_ 1036 Override 0;
BA_ "GenSigTimeoutTime_SGW" SG_ 1036 Override 0;
BA_ "GenSigStartValue" SG_ 1036 SpeedLimitSts 2;
BA_ "GenSigSendType" SG_ 1036 SpeedLimitSts 3;
BA_ "GenSigTimeoutTime_AGSM" SG_ 1036 SpeedLimitSts 0;
BA_ "GenSigTimeoutTime_ASBS" SG_ 1036 SpeedLimitSts 0;
BA_ "GenSigTimeoutTime_BSM" SG_ 1036 SpeedLimitSts 0;
BA_ "GenSigTimeoutTime_CADM" SG_ 1036 SpeedLimitSts 0;
BA_ "GenSigTimeoutTime_DMSM" SG_ 1036 SpeedLimitSts 0;
BA_ "GenSigTimeoutTime_DTCM" SG_ 1036 SpeedLimitSts 0;
BA_ "GenSigTimeoutTime_ECM" SG_ 1036 SpeedLimitSts 0;
BA_ "GenSigTimeoutTime_ELSDM" SG_ 1036 SpeedLimitSts 0;
BA_ "GenSigTimeoutTime_ESL" SG_ 1036 SpeedLimitSts 0;
BA_ "GenSigTimeoutTime_GNMM" SG_ 1036 SpeedLimitSts 0;
BA_ "GenSigTimeoutTime_HCP" SG_ 1036 SpeedLimitSts 0;
BA_ "GenSigTimeoutTime_RFHM" SG_ 1036 SpeedLimitSts 0;
BA_ "GenSigTimeoutTime_SGW" SG_ 1036 SpeedLimitSts 0;
BA_ "GenSigTimeoutTime_TCM" SG_ 1036 SpeedLimitSts 0;
BA_ "GenSigTimeoutTime_ADCAM" SG_ 1035 LTR_PumpSpeedAct 0;
BA_ "GenSigTimeoutTime_EVCU2" SG_ 1035 LTR_PumpSpeedAct 0;
BA_ "GenSigTimeoutTime_VDCM" SG_ 1035 LTR_PumpSpeedAct 0;
BA_ "GenSigTimeoutTime_AGSM" SG_ 1035 LTR_PumpSpeedAct 0;
BA_ "GenSigTimeoutTime_BCM" SG_ 1035 LTR_PumpSpeedAct 0;
BA_ "GenSigTimeoutTime_BSM" SG_ 1035 LTR_PumpSpeedAct 0;
BA_ "GenSigTimeoutTime_DTCM" SG_ 1035 LTR_PumpSpeedAct 0;
BA_ "GenSigTimeoutTime_ECM" SG_ 1035 LTR_PumpSpeedAct 0;
BA_ "GenSigTimeoutTime_ESL" SG_ 1035 LTR_PumpSpeedAct 0;
BA_ "GenSigTimeoutTime_IPC" SG_ 1035 LTR_PumpSpeedAct 0;
BA_ "GenSigTimeoutTime_RFHM" SG_ 1035 LTR_PumpSpeedAct 0;
BA_ "GenSigTimeoutTime_SGW" SG_ 1035 LTR_PumpSpeedAct 0;
BA_ "GenSigTimeoutTime_TCM" SG_ 1035 LTR_PumpSpeedAct 0;
BA_ "GenSigTimeoutTime_AGSM" SG_ 1035 EngCltTmpV 0;
BA_ "GenSigTimeoutTime_ASBS" SG_ 1035 EngCltTmpV 0;
BA_ "GenSigTimeoutTime_BCM" SG_ 1035 EngCltTmpV 0;
BA_ "GenSigTimeoutTime_BSM" SG_ 1035 EngCltTmpV 0;
BA_ "GenSigTimeoutTime_CADM" SG_ 1035 EngCltTmpV 0;
BA_ "GenSigTimeoutTime_DMSM" SG_ 1035 EngCltTmpV 0;
BA_ "GenSigTimeoutTime_DTCM" SG_ 1035 EngCltTmpV 0;
BA_ "GenSigTimeoutTime_ECM" SG_ 1035 EngCltTmpV 0;
BA_ "GenSigTimeoutTime_ELSDM" SG_ 1035 EngCltTmpV 0;
BA_ "GenSigTimeoutTime_ESL" SG_ 1035 EngCltTmpV 0;
BA_ "GenSigTimeoutTime_GNMM" SG_ 1035 EngCltTmpV 0;
BA_ "GenSigTimeoutTime_IPC" SG_ 1035 EngCltTmpV 0;
BA_ "GenSigTimeoutTime_RFHM" SG_ 1035 EngCltTmpV 0;
BA_ "GenSigTimeoutTime_SGW" SG_ 1035 EngCltTmpV 0;
BA_ "GenSigTimeoutTime_TCM" SG_ 1035 EngCltTmpV 0;
BA_ "GenSigTimeoutTime_AGSM" SG_ 1035 EngOutofFuel 0;
BA_ "GenSigTimeoutTime_ASBS" SG_ 1035 EngOutofFuel 0;
BA_ "GenSigTimeoutTime_BCM" SG_ 1035 EngOutofFuel 0;
BA_ "GenSigTimeoutTime_BSM" SG_ 1035 EngOutofFuel 0;
BA_ "GenSigTimeoutTime_CADM" SG_ 1035 EngOutofFuel 0;
BA_ "GenSigTimeoutTime_DMSM" SG_ 1035 EngOutofFuel 0;
BA_ "GenSigTimeoutTime_DTCM" SG_ 1035 EngOutofFuel 0;
BA_ "GenSigTimeoutTime_ECM" SG_ 1035 EngOutofFuel 0;
BA_ "GenSigTimeoutTime_ELSDM" SG_ 1035 EngOutofFuel 0;
BA_ "GenSigTimeoutTime_ESL" SG_ 1035 EngOutofFuel 0;
BA_ "GenSigTimeoutTime_GNMM" SG_ 1035 EngOutofFuel 0;
BA_ "GenSigTimeoutTime_IPC" SG_ 1035 EngOutofFuel 0;
BA_ "GenSigTimeoutTime_RFHM" SG_ 1035 EngOutofFuel 0;
BA_ "GenSigTimeoutTime_SGW" SG_ 1035 EngOutofFuel 0;
BA_ "GenSigTimeoutTime_TCM" SG_ 1035 EngOutofFuel 0;
BA_ "GenSigTimeoutTime_AGSM" SG_ 1035 EngSpd 0;
BA_ "GenSigTimeoutTime_ASBS" SG_ 1035 EngSpd 0;
BA_ "GenSigTimeoutTime_BCM" SG_ 1035 EngSpd 0;
BA_ "GenSigTimeoutTime_BSM" SG_ 1035 EngSpd 0;
BA_ "GenSigTimeoutTime_CADM" SG_ 1035 EngSpd 0;
BA_ "GenSigTimeoutTime_DMSM" SG_ 1035 EngSpd 0;
BA_ "GenSigTimeoutTime_DTCM" SG_ 1035 EngSpd 0;
BA_ "GenSigTimeoutTime_ECM" SG_ 1035 EngSpd 0;
BA_ "GenSigTimeoutTime_ELSDM" SG_ 1035 EngSpd 0;
BA_ "GenSigTimeoutTime_ESL" SG_ 1035 EngSpd 0;
BA_ "GenSigTimeoutTime_GNMM" SG_ 1035 EngSpd 0;
BA_ "GenSigTimeoutTime_IPC" SG_ 1035 EngSpd 0;
BA_ "GenSigTimeoutTime_RFHM" SG_ 1035 EngSpd 0;
BA_ "GenSigTimeoutTime_SGW" SG_ 1035 EngSpd 0;
BA_ "GenSigTimeoutTime_TCM" SG_ 1035 EngSpd 0;
BA_ "GenSigTimeoutTime_AGSM" SG_ 1035 EngSpdStat 0;
BA_ "GenSigTimeoutTime_ASBS" SG_ 1035 EngSpdStat 0;
BA_ "GenSigTimeoutTime_BCM" SG_ 1035 EngSpdStat 0;
BA_ "GenSigTimeoutTime_BSM" SG_ 1035 EngSpdStat 0;
BA_ "GenSigTimeoutTime_CADM" SG_ 1035 EngSpdStat 0;
BA_ "GenSigTimeoutTime_DMSM" SG_ 1035 EngSpdStat 0;
BA_ "GenSigTimeoutTime_DTCM" SG_ 1035 EngSpdStat 0;
BA_ "GenSigTimeoutTime_ECM" SG_ 1035 EngSpdStat 0;
BA_ "GenSigTimeoutTime_ELSDM" SG_ 1035 EngSpdStat 0;
BA_ "GenSigTimeoutTime_ESL" SG_ 1035 EngSpdStat 0;
BA_ "GenSigTimeoutTime_GNMM" SG_ 1035 EngSpdStat 0;
BA_ "GenSigTimeoutTime_IPC" SG_ 1035 EngSpdStat 0;
BA_ "GenSigTimeoutTime_RFHM" SG_ 1035 EngSpdStat 0;
BA_ "GenSigTimeoutTime_SGW" SG_ 1035 EngSpdStat 0;
BA_ "GenSigTimeoutTime_TCM" SG_ 1035 EngSpdStat 0;
BA_ "GenSigTimeoutTime_AGSM" SG_ 1035 MinEngSpdCap 0;
BA_ "GenSigTimeoutTime_ASBS" SG_ 1035 MinEngSpdCap 0;
BA_ "GenSigTimeoutTime_BCM" SG_ 1035 MinEngSpdCap 0;
BA_ "GenSigTimeoutTime_BSM" SG_ 1035 MinEngSpdCap 0;
BA_ "GenSigTimeoutTime_CADM" SG_ 1035 MinEngSpdCap 0;
BA_ "GenSigTimeoutTime_DMSM" SG_ 1035 MinEngSpdCap 0;
BA_ "GenSigTimeoutTime_DTCM" SG_ 1035 MinEngSpdCap 0;
BA_ "GenSigTimeoutTime_ECM" SG_ 1035 MinEngSpdCap 0;
BA_ "GenSigTimeoutTime_ELSDM" SG_ 1035 MinEngSpdCap 0;
BA_ "GenSigTimeoutTime_ESL" SG_ 1035 MinEngSpdCap 0;
BA_ "GenSigTimeoutTime_GNMM" SG_ 1035 MinEngSpdCap 0;
BA_ "GenSigTimeoutTime_IPC" SG_ 1035 MinEngSpdCap 0;
BA_ "GenSigTimeoutTime_RFHM" SG_ 1035 MinEngSpdCap 0;
BA_ "GenSigTimeoutTime_SGW" SG_ 1035 MinEngSpdCap 0;
BA_ "GenSigTimeoutTime_TCM" SG_ 1035 MinEngSpdCap 0;
BA_ "GenSigTimeoutTime_AGSM" SG_ 1035 PECP_PumpFlowReq 0;
BA_ "GenSigTimeoutTime_ASBS" SG_ 1035 PECP_PumpFlowReq 0;
BA_ "GenSigTimeoutTime_BCM" SG_ 1035 PECP_PumpFlowReq 0;
BA_ "GenSigTimeoutTime_BSM" SG_ 1035 PECP_PumpFlowReq 0;
BA_ "GenSigTimeoutTime_CADM" SG_ 1035 PECP_PumpFlowReq 0;
BA_ "GenSigTimeoutTime_DMSM" SG_ 1035 PECP_PumpFlowReq 0;
BA_ "GenSigTimeoutTime_DTCM" SG_ 1035 PECP_PumpFlowReq 0;
BA_ "GenSigTimeoutTime_ECM" SG_ 1035 PECP_PumpFlowReq 0;
BA_ "GenSigTimeoutTime_ELSDM" SG_ 1035 PECP_PumpFlowReq 0;
BA_ "GenSigTimeoutTime_ESL" SG_ 1035 PECP_PumpFlowReq 0;
BA_ "GenSigTimeoutTime_GNMM" SG_ 1035 PECP_PumpFlowReq 0;
BA_ "GenSigTimeoutTime_IPC" SG_ 1035 PECP_PumpFlowReq 0;
BA_ "GenSigTimeoutTime_RFHM" SG_ 1035 PECP_PumpFlowReq 0;
BA_ "GenSigTimeoutTime_SGW" SG_ 1035 PECP_PumpFlowReq 0;
BA_ "GenSigTimeoutTime_TCM" SG_ 1035 PECP_PumpFlowReq 0;
BA_ "GenSigTimeoutTime_AGSM" SG_ 1035 Engine_Maintenance_Sts 0;
BA_ "GenSigTimeoutTime_ASBS" SG_ 1035 Engine_Maintenance_Sts 0;
BA_ "GenSigTimeoutTime_BCM" SG_ 1035 Engine_Maintenance_Sts 0;
BA_ "GenSigTimeoutTime_BSM" SG_ 1035 Engine_Maintenance_Sts 0;
BA_ "GenSigTimeoutTime_CADM" SG_ 1035 Engine_Maintenance_Sts 0;
BA_ "GenSigTimeoutTime_DMSM" SG_ 1035 Engine_Maintenance_Sts 0;
BA_ "GenSigTimeoutTime_DTCM" SG_ 1035 Engine_Maintenance_Sts 0;
BA_ "GenSigTimeoutTime_ECM" SG_ 1035 Engine_Maintenance_Sts 0;
BA_ "GenSigTimeoutTime_ELSDM" SG_ 1035 Engine_Maintenance_Sts 0;
BA_ "GenSigTimeoutTime_ESL" SG_ 1035 Engine_Maintenance_Sts 0;
BA_ "GenSigTimeoutTime_GNMM" SG_ 1035 Engine_Maintenance_Sts 0;
BA_ "GenSigTimeoutTime_IPC" SG_ 1035 Engine_Maintenance_Sts 0;
BA_ "GenSigTimeoutTime_RFHM" SG_ 1035 Engine_Maintenance_Sts 0;
BA_ "GenSigTimeoutTime_SGW" SG_ 1035 Engine_Maintenance_Sts 0;
BA_ "GenSigTimeoutTime_TCM" SG_ 1035 Engine_Maintenance_Sts 0;
BA_ "GenSigTimeoutTime_AGSM" SG_ 1035 CRC_ENGINE_HYBD_FD_3 0;
BA_ "GenSigTimeoutTime_ASBS" SG_ 1035 CRC_ENGINE_HYBD_FD_3 0;
BA_ "GenSigTimeoutTime_BCM" SG_ 1035 CRC_ENGINE_HYBD_FD_3 0;
BA_ "GenSigTimeoutTime_CADM" SG_ 1035 CRC_ENGINE_HYBD_FD_3 0;
BA_ "GenSigTimeoutTime_DMSM" SG_ 1035 CRC_ENGINE_HYBD_FD_3 0;
BA_ "GenSigTimeoutTime_DTCM" SG_ 1035 CRC_ENGINE_HYBD_FD_3 0;
BA_ "GenSigTimeoutTime_ECM" SG_ 1035 CRC_ENGINE_HYBD_FD_3 0;
BA_ "GenSigTimeoutTime_ELSDM" SG_ 1035 CRC_ENGINE_HYBD_FD_3 0;
BA_ "GenSigTimeoutTime_ESL" SG_ 1035 CRC_ENGINE_HYBD_FD_3 0;
BA_ "GenSigTimeoutTime_GNMM" SG_ 1035 CRC_ENGINE_HYBD_FD_3 0;
BA_ "GenSigTimeoutTime_IPC" SG_ 1035 CRC_ENGINE_HYBD_FD_3 0;
BA_ "GenSigTimeoutTime_RFHM" SG_ 1035 CRC_ENGINE_HYBD_FD_3 0;
BA_ "GenSigTimeoutTime_SGW" SG_ 1035 CRC_ENGINE_HYBD_FD_3 0;
BA_ "GenSigTimeoutTime_TCM" SG_ 1035 CRC_ENGINE_HYBD_FD_3 0;
BA_ "GenSigTimeoutTime_AGSM" SG_ 1035 MessageCounter_ENGINE_HYBD_FD_3 0;
BA_ "GenSigTimeoutTime_ASBS" SG_ 1035 MessageCounter_ENGINE_HYBD_FD_3 0;
BA_ "GenSigTimeoutTime_BCM" SG_ 1035 MessageCounter_ENGINE_HYBD_FD_3 0;
BA_ "GenSigTimeoutTime_CADM" SG_ 1035 MessageCounter_ENGINE_HYBD_FD_3 0;
BA_ "GenSigTimeoutTime_DMSM" SG_ 1035 MessageCounter_ENGINE_HYBD_FD_3 0;
BA_ "GenSigTimeoutTime_DTCM" SG_ 1035 MessageCounter_ENGINE_HYBD_FD_3 0;
BA_ "GenSigTimeoutTime_ECM" SG_ 1035 MessageCounter_ENGINE_HYBD_FD_3 0;
BA_ "GenSigTimeoutTime_ELSDM" SG_ 1035 MessageCounter_ENGINE_HYBD_FD_3 0;
BA_ "GenSigTimeoutTime_ESL" SG_ 1035 MessageCounter_ENGINE_HYBD_FD_3 0;
BA_ "GenSigTimeoutTime_GNMM" SG_ 1035 MessageCounter_ENGINE_HYBD_FD_3 0;
BA_ "GenSigTimeoutTime_IPC" SG_ 1035 MessageCounter_ENGINE_HYBD_FD_3 0;
BA_ "GenSigTimeoutTime_RFHM" SG_ 1035 MessageCounter_ENGINE_HYBD_FD_3 0;
BA_ "GenSigTimeoutTime_SGW" SG_ 1035 MessageCounter_ENGINE_HYBD_FD_3 0;
BA_ "GenSigTimeoutTime_TCM" SG_ 1035 MessageCounter_ENGINE_HYBD_FD_3 0;
BA_ "GenSigTimeoutTime_AGSM" SG_ 1035 AfterRunReq 0;
BA_ "GenSigTimeoutTime_ASBS" SG_ 1035 AfterRunReq 0;
BA_ "GenSigTimeoutTime_BCM" SG_ 1035 AfterRunReq 0;
BA_ "GenSigTimeoutTime_BSM" SG_ 1035 AfterRunReq 0;
BA_ "GenSigTimeoutTime_CADM" SG_ 1035 AfterRunReq 0;
BA_ "GenSigTimeoutTime_DMSM" SG_ 1035 AfterRunReq 0;
BA_ "GenSigTimeoutTime_DTCM" SG_ 1035 AfterRunReq 0;
BA_ "GenSigTimeoutTime_ECM" SG_ 1035 AfterRunReq 0;
BA_ "GenSigTimeoutTime_ELSDM" SG_ 1035 AfterRunReq 0;
BA_ "GenSigTimeoutTime_ESL" SG_ 1035 AfterRunReq 0;
BA_ "GenSigTimeoutTime_GNMM" SG_ 1035 AfterRunReq 0;
BA_ "GenSigTimeoutTime_IPC" SG_ 1035 AfterRunReq 0;
BA_ "GenSigTimeoutTime_RFHM" SG_ 1035 AfterRunReq 0;
BA_ "GenSigTimeoutTime_SGW" SG_ 1035 AfterRunReq 0;
BA_ "GenSigTimeoutTime_TCM" SG_ 1035 AfterRunReq 0;
BA_ "GenSigTimeoutTime_AGSM" SG_ 1035 AGSposn 0;
BA_ "GenSigTimeoutTime_ASBS" SG_ 1035 AGSposn 0;
BA_ "GenSigTimeoutTime_BCM" SG_ 1035 AGSposn 0;
BA_ "GenSigTimeoutTime_BSM" SG_ 1035 AGSposn 0;
BA_ "GenSigTimeoutTime_CADM" SG_ 1035 AGSposn 0;
BA_ "GenSigTimeoutTime_DMSM" SG_ 1035 AGSposn 0;
BA_ "GenSigTimeoutTime_DTCM" SG_ 1035 AGSposn 0;
BA_ "GenSigTimeoutTime_ECM" SG_ 1035 AGSposn 0;
BA_ "GenSigTimeoutTime_ELSDM" SG_ 1035 AGSposn 0;
BA_ "GenSigTimeoutTime_ESL" SG_ 1035 AGSposn 0;
BA_ "GenSigTimeoutTime_GNMM" SG_ 1035 AGSposn 0;
BA_ "GenSigTimeoutTime_IPC" SG_ 1035 AGSposn 0;
BA_ "GenSigTimeoutTime_RFHM" SG_ 1035 AGSposn 0;
BA_ "GenSigTimeoutTime_SGW" SG_ 1035 AGSposn 0;
BA_ "GenSigTimeoutTime_TCM" SG_ 1035 AGSposn 0;
BA_ "GenSigStartValue" SG_ 1035 EngCltTmp 255;
BA_ "GenSigTimeoutTime_AGSM" SG_ 1035 EngCltTmp 0;
BA_ "GenSigTimeoutTime_ASBS" SG_ 1035 EngCltTmp 0;
BA_ "GenSigTimeoutTime_BCM" SG_ 1035 EngCltTmp 0;
BA_ "GenSigTimeoutTime_BSM" SG_ 1035 EngCltTmp 0;
BA_ "GenSigTimeoutTime_CADM" SG_ 1035 EngCltTmp 0;
BA_ "GenSigTimeoutTime_DMSM" SG_ 1035 EngCltTmp 0;
BA_ "GenSigTimeoutTime_DTCM" SG_ 1035 EngCltTmp 0;
BA_ "GenSigTimeoutTime_ECM" SG_ 1035 EngCltTmp 0;
BA_ "GenSigTimeoutTime_ELSDM" SG_ 1035 EngCltTmp 0;
BA_ "GenSigTimeoutTime_ESL" SG_ 1035 EngCltTmp 0;
BA_ "GenSigTimeoutTime_GNMM" SG_ 1035 EngCltTmp 0;
BA_ "GenSigTimeoutTime_IPC" SG_ 1035 EngCltTmp 0;
BA_ "GenSigTimeoutTime_RFHM" SG_ 1035 EngCltTmp 0;
BA_ "GenSigTimeoutTime_SGW" SG_ 1035 EngCltTmp 0;
BA_ "GenSigTimeoutTime_TCM" SG_ 1035 EngCltTmp 0;
BA_ "GenSigTimeoutTime_AGSM" SG_ 1035 RadFanReq 0;
BA_ "GenSigTimeoutTime_ASBS" SG_ 1035 RadFanReq 0;
BA_ "GenSigTimeoutTime_BCM" SG_ 1035 RadFanReq 0;
BA_ "GenSigTimeoutTime_CADM" SG_ 1035 RadFanReq 0;
BA_ "GenSigTimeoutTime_DMSM" SG_ 1035 RadFanReq 0;
BA_ "GenSigTimeoutTime_DTCM" SG_ 1035 RadFanReq 0;
BA_ "GenSigTimeoutTime_ECM" SG_ 1035 RadFanReq 0;
BA_ "GenSigTimeoutTime_ELSDM" SG_ 1035 RadFanReq 0;
BA_ "GenSigTimeoutTime_ESL" SG_ 1035 RadFanReq 0;
BA_ "GenSigTimeoutTime_GNMM" SG_ 1035 RadFanReq 0;
BA_ "GenSigTimeoutTime_IPC" SG_ 1035 RadFanReq 0;
BA_ "GenSigTimeoutTime_RFHM" SG_ 1035 RadFanReq 0;
BA_ "GenSigTimeoutTime_SGW" SG_ 1035 RadFanReq 0;
BA_ "GenSigTimeoutTime_TCM" SG_ 1035 RadFanReq 0;
BA_ "GenSigTimeoutTime_AGSM" SG_ 1035 ServiceHybSys 0;
BA_ "GenSigTimeoutTime_ASBS" SG_ 1035 ServiceHybSys 0;
BA_ "GenSigTimeoutTime_BCM" SG_ 1035 ServiceHybSys 0;
BA_ "GenSigTimeoutTime_BSM" SG_ 1035 ServiceHybSys 0;
BA_ "GenSigTimeoutTime_CADM" SG_ 1035 ServiceHybSys 0;
BA_ "GenSigTimeoutTime_DMSM" SG_ 1035 ServiceHybSys 0;
BA_ "GenSigTimeoutTime_DTCM" SG_ 1035 ServiceHybSys 0;
BA_ "GenSigTimeoutTime_ECM" SG_ 1035 ServiceHybSys 0;
BA_ "GenSigTimeoutTime_ELSDM" SG_ 1035 ServiceHybSys 0;
BA_ "GenSigTimeoutTime_ESL" SG_ 1035 ServiceHybSys 0;
BA_ "GenSigTimeoutTime_GNMM" SG_ 1035 ServiceHybSys 0;
BA_ "GenSigTimeoutTime_IPC" SG_ 1035 ServiceHybSys 0;
BA_ "GenSigTimeoutTime_RFHM" SG_ 1035 ServiceHybSys 0;
BA_ "GenSigTimeoutTime_SGW" SG_ 1035 ServiceHybSys 0;
BA_ "GenSigTimeoutTime_TCM" SG_ 1035 ServiceHybSys 0;
BA_ "GenSigTimeoutTime_AGSM" SG_ 1035 EngHalfCylSpdMinLim 0;
BA_ "GenSigTimeoutTime_ASBS" SG_ 1035 EngHalfCylSpdMinLim 0;
BA_ "GenSigTimeoutTime_BCM" SG_ 1035 EngHalfCylSpdMinLim 0;
BA_ "GenSigTimeoutTime_BSM" SG_ 1035 EngHalfCylSpdMinLim 0;
BA_ "GenSigTimeoutTime_CADM" SG_ 1035 EngHalfCylSpdMinLim 0;
BA_ "GenSigTimeoutTime_DMSM" SG_ 1035 EngHalfCylSpdMinLim 0;
BA_ "GenSigTimeoutTime_DTCM" SG_ 1035 EngHalfCylSpdMinLim 0;
BA_ "GenSigTimeoutTime_ECM" SG_ 1035 EngHalfCylSpdMinLim 0;
BA_ "GenSigTimeoutTime_ELSDM" SG_ 1035 EngHalfCylSpdMinLim 0;
BA_ "GenSigTimeoutTime_ESL" SG_ 1035 EngHalfCylSpdMinLim 0;
BA_ "GenSigTimeoutTime_GNMM" SG_ 1035 EngHalfCylSpdMinLim 0;
BA_ "GenSigTimeoutTime_IPC" SG_ 1035 EngHalfCylSpdMinLim 0;
BA_ "GenSigTimeoutTime_RFHM" SG_ 1035 EngHalfCylSpdMinLim 0;
BA_ "GenSigTimeoutTime_SGW" SG_ 1035 EngHalfCylSpdMinLim 0;
BA_ "GenSigTimeoutTime_TCM" SG_ 1035 EngHalfCylSpdMinLim 0;
BA_ "GenSigTimeoutTime_AGSM" SG_ 1035 EngHalfCylSpdMaxLim 0;
BA_ "GenSigTimeoutTime_ASBS" SG_ 1035 EngHalfCylSpdMaxLim 0;
BA_ "GenSigTimeoutTime_BCM" SG_ 1035 EngHalfCylSpdMaxLim 0;
BA_ "GenSigTimeoutTime_BSM" SG_ 1035 EngHalfCylSpdMaxLim 0;
BA_ "GenSigTimeoutTime_CADM" SG_ 1035 EngHalfCylSpdMaxLim 0;
BA_ "GenSigTimeoutTime_DMSM" SG_ 1035 EngHalfCylSpdMaxLim 0;
BA_ "GenSigTimeoutTime_DTCM" SG_ 1035 EngHalfCylSpdMaxLim 0;
BA_ "GenSigTimeoutTime_ECM" SG_ 1035 EngHalfCylSpdMaxLim 0;
BA_ "GenSigTimeoutTime_ELSDM" SG_ 1035 EngHalfCylSpdMaxLim 0;
BA_ "GenSigTimeoutTime_ESL" SG_ 1035 EngHalfCylSpdMaxLim 0;
BA_ "GenSigTimeoutTime_GNMM" SG_ 1035 EngHalfCylSpdMaxLim 0;
BA_ "GenSigTimeoutTime_IPC" SG_ 1035 EngHalfCylSpdMaxLim 0;
BA_ "GenSigTimeoutTime_RFHM" SG_ 1035 EngHalfCylSpdMaxLim 0;
BA_ "GenSigTimeoutTime_SGW" SG_ 1035 EngHalfCylSpdMaxLim 0;
BA_ "GenSigTimeoutTime_TCM" SG_ 1035 EngHalfCylSpdMaxLim 0;
BA_ "GenSigTimeoutTime_AGSM" SG_ 1035 MaxEngSpdCap 0;
BA_ "GenSigTimeoutTime_ASBS" SG_ 1035 MaxEngSpdCap 0;
BA_ "GenSigTimeoutTime_BCM" SG_ 1035 MaxEngSpdCap 0;
BA_ "GenSigTimeoutTime_BSM" SG_ 1035 MaxEngSpdCap 0;
BA_ "GenSigTimeoutTime_CADM" SG_ 1035 MaxEngSpdCap 0;
BA_ "GenSigTimeoutTime_DMSM" SG_ 1035 MaxEngSpdCap 0;
BA_ "GenSigTimeoutTime_DTCM" SG_ 1035 MaxEngSpdCap 0;
BA_ "GenSigTimeoutTime_ECM" SG_ 1035 MaxEngSpdCap 0;
BA_ "GenSigTimeoutTime_ELSDM" SG_ 1035 MaxEngSpdCap 0;
BA_ "GenSigTimeoutTime_ESL" SG_ 1035 MaxEngSpdCap 0;
BA_ "GenSigTimeoutTime_GNMM" SG_ 1035 MaxEngSpdCap 0;
BA_ "GenSigTimeoutTime_IPC" SG_ 1035 MaxEngSpdCap 0;
BA_ "GenSigTimeoutTime_RFHM" SG_ 1035 MaxEngSpdCap 0;
BA_ "GenSigTimeoutTime_SGW" SG_ 1035 MaxEngSpdCap 0;
BA_ "GenSigTimeoutTime_TCM" SG_ 1035 MaxEngSpdCap 0;
BA_ "GenSigTimeoutTime_AGSM" SG_ 1328 EngTorqACCCapability 0;
BA_ "GenSigTimeoutTime_ASBS" SG_ 1328 EngTorqACCCapability 0;
BA_ "GenSigTimeoutTime_BCM" SG_ 1328 EngTorqACCCapability 0;
BA_ "GenSigTimeoutTime_BSM" SG_ 1328 EngTorqACCCapability 0;
BA_ "GenSigTimeoutTime_CADM" SG_ 1328 EngTorqACCCapability 0;
BA_ "GenSigTimeoutTime_DMSM" SG_ 1328 EngTorqACCCapability 0;
BA_ "GenSigTimeoutTime_DTCM" SG_ 1328 EngTorqACCCapability 0;
BA_ "GenSigTimeoutTime_ECM" SG_ 1328 EngTorqACCCapability 0;
BA_ "GenSigTimeoutTime_ELSDM" SG_ 1328 EngTorqACCCapability 0;
BA_ "GenSigTimeoutTime_ESL" SG_ 1328 EngTorqACCCapability 0;
BA_ "GenSigTimeoutTime_GNMM" SG_ 1328 EngTorqACCCapability 0;
BA_ "GenSigTimeoutTime_IPC" SG_ 1328 EngTorqACCCapability 0;
BA_ "GenSigTimeoutTime_RFHM" SG_ 1328 EngTorqACCCapability 0;
BA_ "GenSigTimeoutTime_SGW" SG_ 1328 EngTorqACCCapability 0;
BA_ "GenSigTimeoutTime_TCM" SG_ 1328 EngTorqACCCapability 0;
BA_ "GenSigTimeoutTime_AGSM" SG_ 1328 EngTorqCapbltyEngOpMd 0;
BA_ "GenSigTimeoutTime_ASBS" SG_ 1328 EngTorqCapbltyEngOpMd 0;
BA_ "GenSigTimeoutTime_BCM" SG_ 1328 EngTorqCapbltyEngOpMd 0;
BA_ "GenSigTimeoutTime_BSM" SG_ 1328 EngTorqCapbltyEngOpMd 0;
BA_ "GenSigTimeoutTime_CADM" SG_ 1328 EngTorqCapbltyEngOpMd 0;
BA_ "GenSigTimeoutTime_DMSM" SG_ 1328 EngTorqCapbltyEngOpMd 0;
BA_ "GenSigTimeoutTime_DTCM" SG_ 1328 EngTorqCapbltyEngOpMd 0;
BA_ "GenSigTimeoutTime_ECM" SG_ 1328 EngTorqCapbltyEngOpMd 0;
BA_ "GenSigTimeoutTime_ELSDM" SG_ 1328 EngTorqCapbltyEngOpMd 0;
BA_ "GenSigTimeoutTime_ESL" SG_ 1328 EngTorqCapbltyEngOpMd 0;
BA_ "GenSigTimeoutTime_GNMM" SG_ 1328 EngTorqCapbltyEngOpMd 0;
BA_ "GenSigTimeoutTime_IPC" SG_ 1328 EngTorqCapbltyEngOpMd 0;
BA_ "GenSigTimeoutTime_RFHM" SG_ 1328 EngTorqCapbltyEngOpMd 0;
BA_ "GenSigTimeoutTime_SGW" SG_ 1328 EngTorqCapbltyEngOpMd 0;
BA_ "GenSigTimeoutTime_TCM" SG_ 1328 EngTorqCapbltyEngOpMd 0;
BA_ "GenSigTimeoutTime_AGSM" SG_ 1328 EngTorqCapbltyFrmCntr 0;
BA_ "GenSigTimeoutTime_ASBS" SG_ 1328 EngTorqCapbltyFrmCntr 0;
BA_ "GenSigTimeoutTime_BCM" SG_ 1328 EngTorqCapbltyFrmCntr 0;
BA_ "GenSigTimeoutTime_BSM" SG_ 1328 EngTorqCapbltyFrmCntr 0;
BA_ "GenSigTimeoutTime_CADM" SG_ 1328 EngTorqCapbltyFrmCntr 0;
BA_ "GenSigTimeoutTime_DMSM" SG_ 1328 EngTorqCapbltyFrmCntr 0;
BA_ "GenSigTimeoutTime_DTCM" SG_ 1328 EngTorqCapbltyFrmCntr 0;
BA_ "GenSigTimeoutTime_ECM" SG_ 1328 EngTorqCapbltyFrmCntr 0;
BA_ "GenSigTimeoutTime_ELSDM" SG_ 1328 EngTorqCapbltyFrmCntr 0;
BA_ "GenSigTimeoutTime_ESL" SG_ 1328 EngTorqCapbltyFrmCntr 0;
BA_ "GenSigTimeoutTime_GNMM" SG_ 1328 EngTorqCapbltyFrmCntr 0;
BA_ "GenSigTimeoutTime_IPC" SG_ 1328 EngTorqCapbltyFrmCntr 0;
BA_ "GenSigTimeoutTime_RFHM" SG_ 1328 EngTorqCapbltyFrmCntr 0;
BA_ "GenSigTimeoutTime_SGW" SG_ 1328 EngTorqCapbltyFrmCntr 0;
BA_ "GenSigTimeoutTime_TCM" SG_ 1328 EngTorqCapbltyFrmCntr 0;
BA_ "GenSigStartValue" SG_ 1328 EngTorqCapbltyMinRunTorq 938;
BA_ "GenSigTimeoutTime_AGSM" SG_ 1328 EngTorqCapbltyMinRunTorq 0;
BA_ "GenSigTimeoutTime_ASBS" SG_ 1328 EngTorqCapbltyMinRunTorq 0;
BA_ "GenSigTimeoutTime_BCM" SG_ 1328 EngTorqCapbltyMinRunTorq 0;
BA_ "GenSigTimeoutTime_BSM" SG_ 1328 EngTorqCapbltyMinRunTorq 0;
BA_ "GenSigTimeoutTime_CADM" SG_ 1328 EngTorqCapbltyMinRunTorq 0;
BA_ "GenSigTimeoutTime_DMSM" SG_ 1328 EngTorqCapbltyMinRunTorq 0;
BA_ "GenSigTimeoutTime_DTCM" SG_ 1328 EngTorqCapbltyMinRunTorq 0;
BA_ "GenSigTimeoutTime_ECM" SG_ 1328 EngTorqCapbltyMinRunTorq 0;
BA_ "GenSigTimeoutTime_ELSDM" SG_ 1328 EngTorqCapbltyMinRunTorq 0;
BA_ "GenSigTimeoutTime_ESL" SG_ 1328 EngTorqCapbltyMinRunTorq 0;
BA_ "GenSigTimeoutTime_GNMM" SG_ 1328 EngTorqCapbltyMinRunTorq 0;
BA_ "GenSigTimeoutTime_IPC" SG_ 1328 EngTorqCapbltyMinRunTorq 0;
BA_ "GenSigTimeoutTime_RFHM" SG_ 1328 EngTorqCapbltyMinRunTorq 0;
BA_ "GenSigTimeoutTime_SGW" SG_ 1328 EngTorqCapbltyMinRunTorq 0;
BA_ "GenSigTimeoutTime_TCM" SG_ 1328 EngTorqCapbltyMinRunTorq 0;
BA_ "GenSigTimeoutTime_AGSM" SG_ 1328 EngTorqCapbltyRefEngSpd 0;
BA_ "GenSigTimeoutTime_ASBS" SG_ 1328 EngTorqCapbltyRefEngSpd 0;
BA_ "GenSigTimeoutTime_BCM" SG_ 1328 EngTorqCapbltyRefEngSpd 0;
BA_ "GenSigTimeoutTime_BSM" SG_ 1328 EngTorqCapbltyRefEngSpd 0;
BA_ "GenSigTimeoutTime_CADM" SG_ 1328 EngTorqCapbltyRefEngSpd 0;
BA_ "GenSigTimeoutTime_DMSM" SG_ 1328 EngTorqCapbltyRefEngSpd 0;
BA_ "GenSigTimeoutTime_DTCM" SG_ 1328 EngTorqCapbltyRefEngSpd 0;
BA_ "GenSigTimeoutTime_ECM" SG_ 1328 EngTorqCapbltyRefEngSpd 0;
BA_ "GenSigTimeoutTime_ELSDM" SG_ 1328 EngTorqCapbltyRefEngSpd 0;
BA_ "GenSigTimeoutTime_ESL" SG_ 1328 EngTorqCapbltyRefEngSpd 0;
BA_ "GenSigTimeoutTime_GNMM" SG_ 1328 EngTorqCapbltyRefEngSpd 0;
BA_ "GenSigTimeoutTime_IPC" SG_ 1328 EngTorqCapbltyRefEngSpd 0;
BA_ "GenSigTimeoutTime_RFHM" SG_ 1328 EngTorqCapbltyRefEngSpd 0;
BA_ "GenSigTimeoutTime_SGW" SG_ 1328 EngTorqCapbltyRefEngSpd 0;
BA_ "GenSigTimeoutTime_TCM" SG_ 1328 EngTorqCapbltyRefEngSpd 0;
BA_ "GenSigTimeoutTime_AGSM" SG_ 1328 CatTempMaint 0;
BA_ "GenSigTimeoutTime_ASBS" SG_ 1328 CatTempMaint 0;
BA_ "GenSigTimeoutTime_BCM" SG_ 1328 CatTempMaint 0;
BA_ "GenSigTimeoutTime_BSM" SG_ 1328 CatTempMaint 0;
BA_ "GenSigTimeoutTime_CADM" SG_ 1328 CatTempMaint 0;
BA_ "GenSigTimeoutTime_DMSM" SG_ 1328 CatTempMaint 0;
BA_ "GenSigTimeoutTime_DTCM" SG_ 1328 CatTempMaint 0;
BA_ "GenSigTimeoutTime_ECM" SG_ 1328 CatTempMaint 0;
BA_ "GenSigTimeoutTime_ELSDM" SG_ 1328 CatTempMaint 0;
BA_ "GenSigTimeoutTime_ESL" SG_ 1328 CatTempMaint 0;
BA_ "GenSigTimeoutTime_GNMM" SG_ 1328 CatTempMaint 0;
BA_ "GenSigTimeoutTime_IPC" SG_ 1328 CatTempMaint 0;
BA_ "GenSigTimeoutTime_RFHM" SG_ 1328 CatTempMaint 0;
BA_ "GenSigTimeoutTime_SGW" SG_ 1328 CatTempMaint 0;
BA_ "GenSigTimeoutTime_TCM" SG_ 1328 CatTempMaint 0;
BA_ "GenSigTimeoutTime_AGSM" SG_ 1328 CRC_ENGINE_HYBD_FD_4 0;
BA_ "GenSigTimeoutTime_ASBS" SG_ 1328 CRC_ENGINE_HYBD_FD_4 0;
BA_ "GenSigTimeoutTime_BCM" SG_ 1328 CRC_ENGINE_HYBD_FD_4 0;
BA_ "GenSigTimeoutTime_BSM" SG_ 1328 CRC_ENGINE_HYBD_FD_4 0;
BA_ "GenSigTimeoutTime_CADM" SG_ 1328 CRC_ENGINE_HYBD_FD_4 0;
BA_ "GenSigTimeoutTime_DMSM" SG_ 1328 CRC_ENGINE_HYBD_FD_4 0;
BA_ "GenSigTimeoutTime_DTCM" SG_ 1328 CRC_ENGINE_HYBD_FD_4 0;
BA_ "GenSigTimeoutTime_ECM" SG_ 1328 CRC_ENGINE_HYBD_FD_4 0;
BA_ "GenSigTimeoutTime_ELSDM" SG_ 1328 CRC_ENGINE_HYBD_FD_4 0;
BA_ "GenSigTimeoutTime_ESL" SG_ 1328 CRC_ENGINE_HYBD_FD_4 0;
BA_ "GenSigTimeoutTime_GNMM" SG_ 1328 CRC_ENGINE_HYBD_FD_4 0;
BA_ "GenSigTimeoutTime_IPC" SG_ 1328 CRC_ENGINE_HYBD_FD_4 0;
BA_ "GenSigTimeoutTime_RFHM" SG_ 1328 CRC_ENGINE_HYBD_FD_4 0;
BA_ "GenSigTimeoutTime_SGW" SG_ 1328 CRC_ENGINE_HYBD_FD_4 0;
BA_ "GenSigTimeoutTime_TCM" SG_ 1328 CRC_ENGINE_HYBD_FD_4 0;
BA_ "GenSigTimeoutTime_AGSM" SG_ 1328 MessageCounter_ENGINE_HYBD_FD_4 0;
BA_ "GenSigTimeoutTime_ASBS" SG_ 1328 MessageCounter_ENGINE_HYBD_FD_4 0;
BA_ "GenSigTimeoutTime_BCM" SG_ 1328 MessageCounter_ENGINE_HYBD_FD_4 0;
BA_ "GenSigTimeoutTime_CADM" SG_ 1436 Blower_Diagnostics 0;
BA_ "GenSigTimeoutTime_DMSM" SG_ 1436 Blower_Diagnostics 0;
BA_ "GenSigTimeoutTime_DTCM" SG_ 1436 Blower_Diagnostics 0;
BA_ "GenSigTimeoutTime_ELSDM" SG_ 1436 Blower_Diagnostics 0;
BA_ "GenSigTimeoutTime_ESL" SG_ 1436 Blower_Diagnostics 0;
BA_ "GenSigTimeoutTime_GNMM" SG_ 1436 Blower_Diagnostics 0;
BA_ "GenSigTimeoutTime_HCP" SG_ 1436 Blower_Diagnostics 0;
BA_ "GenSigTimeoutTime_IPC" SG_ 1436 Blower_Diagnostics 0;
BA_ "GenSigTimeoutTime_RFHM" SG_ 1436 Blower_Diagnostics 0;
BA_ "GenSigTimeoutTime_SGW" SG_ 1436 Blower_Diagnostics 0;
BA_ "GenSigTimeoutTime_TCM" SG_ 1436 Blower_Diagnostics 0;
BA_ "GenSigSendType" SG_ 1436 Blower_Speed 3;
BA_ "GenSigTimeoutTime_AGSM" SG_ 1436 Blower_Speed 0;
BA_ "GenSigTimeoutTime_ASBS" SG_ 1436 Blower_Speed 0;
BA_ "GenSigTimeoutTime_BCM" SG_ 1436 Blower_Speed 0;
BA_ "GenSigTimeoutTime_BSM" SG_ 1436 Blower_Speed 0;
BA_ "GenSigTimeoutTime_CADM" SG_ 1436 Blower_Speed 0;
BA_ "GenSigTimeoutTime_DMSM" SG_ 1436 Blower_Speed 0;
BA_ "GenSigTimeoutTime_DTCM" SG_ 1436 Blower_Speed 0;
BA_ "GenSigTimeoutTime_ELSDM" SG_ 1436 Blower_Speed 0;
BA_ "GenSigTimeoutTime_ESL" SG_ 1436 Blower_Speed 0;
BA_ "GenSigTimeoutTime_GNMM" SG_ 1436 Blower_Speed 0;
BA_ "GenSigTimeoutTime_HCP" SG_ 1436 Blower_Speed 0;
BA_ "GenSigTimeoutTime_IPC" SG_ 1436 Blower_Speed 0;
BA_ "GenSigTimeoutTime_RFHM" SG_ 1436 Blower_Speed 0;
BA_ "GenSigTimeoutTime_SGW" SG_ 1436 Blower_Speed 0;
BA_ "GenSigTimeoutTime_TCM" SG_ 1436 Blower_Speed 0;
BA_ "GenSigTimeoutTime_ADCAM" SG_ 750 Battery_Volt_2 0;
BA_ "GenSigTimeoutTime_VDCM" SG_ 750 Battery_Volt_2 0;
BA_ "GenSigTimeoutTime_AGSM" SG_ 750 Battery_Volt_2 0;
BA_ "GenSigTimeoutTime_BCM" SG_ 750 Battery_Volt_2 0;
BA_ "GenSigTimeoutTime_DTCM" SG_ 750 Battery_Volt_2 0;
BA_ "GenSigTimeoutTime_ESL" SG_ 750 Battery_Volt_2 0;
BA_ "GenSigTimeoutTime_IPC" SG_ 750 Battery_Volt_2 0;
BA_ "GenSigTimeoutTime_RFHM" SG_ 750 Battery_Volt_2 0;
BA_ "GenSigTimeoutTime_TCM" SG_ 750 Battery_Volt_2 0;
BA_ "GenSigTimeoutTime_ESL" SG_ 750 Battery_Volt_1 0;
BA_ "GenSigTimeoutTime_BCM" SG_ 750 Battery_Volt_1 0;
BA_ "GenSigTimeoutTime_SGW" SG_ 1029 HVBatChargePower_InstantV 0;
BA_ "GenSigTimeoutTime_TCM" SG_ 1029 HVBatChargePower_InstantV 0;
BA_ "GenSigTimeoutTime_AGSM" SG_ 1834 HVBattery_RealTimeClock 0;
BA_ "GenSigTimeoutTime_ASBS" SG_ 1834 HVBattery_RealTimeClock 0;
BA_ "GenSigTimeoutTime_BCM" SG_ 1834 HVBattery_RealTimeClock 0;
BA_ "GenSigTimeoutTime_BSM" SG_ 1834 HVBattery_RealTimeClock 0;
BA_ "GenSigTimeoutTime_CADM" SG_ 1834 HVBattery_RealTimeClock 0;
BA_ "GenSigTimeoutTime_DMSM" SG_ 1834 HVBattery_RealTimeClock 0;
BA_ "GenSigTimeoutTime_DTCM" SG_ 1834 HVBattery_RealTimeClock 0;
BA_ "GenSigTimeoutTime_ELSDM" SG_ 1834 HVBattery_RealTimeClock 0;
BA_ "GenSigTimeoutTime_ESL" SG_ 1834 HVBattery_RealTimeClock 0;
BA_ "GenSigTimeoutTime_GNMM" SG_ 1834 HVBattery_RealTimeClock 0;
BA_ "GenSigTimeoutTime_HCP" SG_ 1834 HVBattery_RealTimeClock 0;
BA_ "GenSigTimeoutTime_IPC" SG_ 1834 HVBattery_RealTimeClock 0;
BA_ "GenSigTimeoutTime_RFHM" SG_ 1834 HVBattery_RealTimeClock 0;
BA_ "GenSigTimeoutTime_SGW" SG_ 1834 HVBattery_RealTimeClock 0;
BA_ "GenSigTimeoutTime_TCM" SG_ 1834 HVBattery_RealTimeClock 0;
BA_ "GenSigTimeoutTime_AGSM" SG_ 1834 HVBattery_RealTimeClockV 0;
BA_ "GenSigTimeoutTime_ASBS" SG_ 1834 HVBattery_RealTimeClockV 0;
BA_ "GenSigTimeoutTime_BCM" SG_ 1834 HVBattery_RealTimeClockV 0;
BA_ "GenSigTimeoutTime_BSM" SG_ 1834 HVBattery_RealTimeClockV 0;
BA_ "GenSigTimeoutTime_CADM" SG_ 1834 HVBattery_RealTimeClockV 0;
BA_ "GenSigTimeoutTime_DMSM" SG_ 1834 HVBattery_RealTimeClockV 0;
BA_ "GenSigTimeoutTime_DTCM" SG_ 1834 HVBattery_RealTimeClockV 0;
BA_ "GenSigTimeoutTime_ELSDM" SG_ 1834 HVBattery_RealTimeClockV 0;
BA_ "GenSigTimeoutTime_ESL" SG_ 1834 HVBattery_RealTimeClockV 0;
BA_ "GenSigTimeoutTime_GNMM" SG_ 1834 HVBattery_RealTimeClockV 0;
BA_ "GenSigTimeoutTime_HCP" SG_ 1834 HVBattery_RealTimeClockV 0;
BA_ "GenSigTimeoutTime_IPC" SG_ 1834 HVBattery_RealTimeClockV 0;
BA_ "GenSigTimeoutTime_RFHM" SG_ 1834 HVBattery_RealTimeClockV 0;
BA_ "GenSigTimeoutTime_SGW" SG_ 1834 HVBattery_RealTimeClockV 0;
BA_ "GenSigTimeoutTime_TCM" SG_ 1834 HVBattery_RealTimeClockV 0;
BA_ "GenSigTimeoutTime_AGSM" SG_ 1049 HybridMILRequest 0;
BA_ "GenSigTimeoutTime_ASBS" SG_ 1049 HybridMILRequest 0;
BA_ "GenSigTimeoutTime_BCM" SG_ 1049 HybridMILRequest 0;
BA_ "GenSigTimeoutTime_BSM" SG_ 1049 HybridMILRequest 0;
BA_ "GenSigTimeoutTime_CADM" SG_ 1049 HybridMILRequest 0;
BA_ "GenSigTimeoutTime_DMSM" SG_ 1049 HybridMILRequest 0;
BA_ "GenSigTimeoutTime_DTCM" SG_ 1049 HybridMILRequest 0;
BA_ "GenSigTimeoutTime_ELSDM" SG_ 1049 HybridMILRequest 0;
BA_ "GenSigTimeoutTime_ESL" SG_ 1049 HybridMILRequest 0;
BA_ "GenSigTimeoutTime_GNMM" SG_ 1049 HybridMILRequest 0;
BA_ "GenSigTimeoutTime_HCP" SG_ 1049 HybridMILRequest 0;
BA_ "GenSigTimeoutTime_IPC" SG_ 1049 HybridMILRequest 0;
BA_ "GenSigTimeoutTime_RFHM" SG_ 1049 HybridMILRequest 0;
BA_ "GenSigTimeoutTime_TCM" SG_ 1049 HybridMILRequest 0;
BA_ "GenSigStartValue" SG_ 1952 HTAuxPmpMontrngRPM 3;
BA_ "GenSigSendType" SG_ 1952 HTAuxPmpMontrngRPM 3;
BA_ "GenSigTimeoutTime_AGSM" SG_ 1952 HTAuxPmpMontrngRPM 0;
BA_ "GenSigTimeoutTime_ASBS" SG_ 1952 HTAuxPmpMontrngRPM 0;
BA_ "GenSigTimeoutTime_BCM" SG_ 1952 HTAuxPmpMontrngRPM 0;
BA_ "GenSigTimeoutTime_BSM" SG_ 1952 HTAuxPmpMontrngRPM 0;
BA_ "GenSigTimeoutTime_CADM" SG_ 1952 HTAuxPmpMontrngRPM 0;
BA_ "GenSigTimeoutTime_DMSM" SG_ 1952 HTAuxPmpMontrngRPM 0;
BA_ "GenSigTimeoutTime_DTCM" SG_ 1952 HTAuxPmpMontrngRPM 0;
BA_ "GenSigTimeoutTime_ELSDM" SG_ 1952 HTAuxPmpMontrngRPM 0;
BA_ "GenSigTimeoutTime_ESL" SG_ 1952 HTAuxPmpMontrngRPM 0;
BA_ "GenSigTimeoutTime_GNMM" SG_ 1952 HTAuxPmpMontrngRPM 0;
BA_ "GenSigTimeoutTime_HCP" SG_ 1952 HTAuxPmpMontrngRPM 0;
BA_ "GenSigTimeoutTime_IPC" SG_ 1952 HTAuxPmpMontrngRPM 0;
BA_ "GenSigTimeoutTime_RFHM" SG_ 1952 HTAuxPmpMontrngRPM 0;
BA_ "GenSigTimeoutTime_SGW" SG_ 1952 HTAuxPmpMontrngRPM 0;
BA_ "GenSigTimeoutTime_TCM" SG_ 1952 HTAuxPmpMontrngRPM 0;
BA_ "GenSigSendType" SG_ 1952 ElecCoolantHtrPwr 3;
BA_ "GenSigTimeoutTime_AGSM" SG_ 1952 ElecCoolantHtrPwr 0;
BA_ "GenSigTimeoutTime_ASBS" SG_ 1952 ElecCoolantHtrPwr 0;
BA_ "GenSigTimeoutTime_BSM" SG_ 1952 ElecCoolantHtrPwr 0;
BA_ "GenSigTimeoutTime_CADM" SG_ 1952 ElecCoolantHtrPwr 0;
BA_ "GenSigTimeoutTime_DMSM" SG_ 1952 ElecCoolantHtrPwr 0;
BA_ "GenSigTimeoutTime_DTCM" SG_ 1952 ElecCoolantHtrPwr 0;
BA_ "GenSigTimeoutTime_ELSDM" SG_ 1952 ElecCoolantHtrPwr 0;
BA_ "GenSigTimeoutTime_ESL" SG_ 1952 ElecCoolantHtrPwr 0;
BA_ "GenSigTimeoutTime_GNMM" SG_ 1952 ElecCoolantHtrPwr 0;
BA_ "GenSigTimeoutTime_HCP" SG_ 1952 ElecCoolantHtrPwr 0;
BA_ "GenSigTimeoutTime_IPC" SG_ 1952 ElecCoolantHtrPwr 0;
BA_ "GenSigTimeoutTime_RFHM" SG_ 1952 ElecCoolantHtrPwr 0;
BA_ "GenSigTimeoutTime_SGW" SG_ 1952 ElecCoolantHtrPwr 0;
BA_ "GenSigTimeoutTime_TCM" SG_ 1952 ElecCoolantHtrPwr 0;
BA_ "GenSigSendType" SG_ 1952 HeaterCoreInletTemp 3;
BA_ "GenSigTimeoutTime_AGSM" SG_ 1952 HeaterCoreInletTemp 0;
BA_ "GenSigTimeoutTime_ASBS" SG_ 1952 HeaterCoreInletTemp 0;
BA_ "GenSigTimeoutTime_BSM" SG_ 1952 HeaterCoreInletTemp 0;
BA_ "GenSigTimeoutTime_CADM" SG_ 1952 HeaterCoreInletTemp 0;
BA_ "GenSigTimeoutTime_DMSM" SG_ 1952 HeaterCoreInletTemp 0;
BA_ "GenSigTimeoutTime_DTCM" SG_ 1952 HeaterCoreInletTemp 0;
BA_ "GenSigTimeoutTime_ELSDM" SG_ 1952 HeaterCoreInletTemp 0;
BA_ "GenSigTimeoutTime_ESL" SG_ 1952 HeaterCoreInletTemp 0;
BA_ "GenSigTimeoutTime_GNMM" SG_ 1952 HeaterCoreInletTemp 0;
BA_ "GenSigTimeoutTime_HCP" SG_ 1952 HeaterCoreInletTemp 0;
BA_ "GenSigTimeoutTime_IPC" SG_ 1952 HeaterCoreInletTemp 0;
BA_ "GenSigTimeoutTime_RFHM" SG_ 1952 HeaterCoreInletTemp 0;
BA_ "GenSigTimeoutTime_SGW" SG_ 1952 HeaterCoreInletTemp 0;
BA_ "GenSigTimeoutTime_TCM" SG_ 1952 HeaterCoreInletTemp 0;
BA_ "GenSigSendType" SG_ 1952 HTAuxPmpRPMAct 3;
BA_ "GenSigTimeoutTime_AGSM" SG_ 1952 HTAuxPmpRPMAct 0;
BA_ "GenSigTimeoutTime_ASBS" SG_ 1952 HTAuxPmpRPMAct 0;
BA_ "GenSigTimeoutTime_BSM" SG_ 1952 HTAuxPmpRPMAct 0;
BA_ "GenSigTimeoutTime_CADM" SG_ 1952 HTAuxPmpRPMAct 0;
BA_ "GenSigTimeoutTime_DMSM" SG_ 1952 HTAuxPmpRPMAct 0;
BA_ "GenSigTimeoutTime_DTCM" SG_ 1952 HTAuxPmpRPMAct 0;
BA_ "GenSigTimeoutTime_ELSDM" SG_ 1952 HTAuxPmpRPMAct 0;
BA_ "GenSigTimeoutTime_ESL" SG_ 1952 HTAuxPmpRPMAct 0;
BA_ "GenSigTimeoutTime_GNMM" SG_ 1952 HTAuxPmpRPMAct 0;
BA_ "GenSigTimeoutTime_HCP" SG_ 1952 HTAuxPmpRPMAct 0;
BA_ "GenSigTimeoutTime_IPC" SG_ 1952 HTAuxPmpRPMAct 0;
BA_ "GenSigTimeoutTime_RFHM" SG_ 1952 HTAuxPmpRPMAct 0;
BA_ "GenSigTimeoutTime_SGW" SG_ 1952 HTAuxPmpRPMAct 0;
BA_ "GenSigTimeoutTime_TCM" SG_ 1952 HTAuxPmpRPMAct 0;
BA_ "GenSigSendType" SG_ 1952 HTShtOffVlvReq 3;
BA_ "GenSigTimeoutTime_AGSM" SG_ 1952 HTShtOffVlvReq 0;
BA_ "GenSigTimeoutTime_ASBS" SG_ 1952 HTShtOffVlvReq 0;
BA_ "GenSigTimeoutTime_BSM" SG_ 1952 HTShtOffVlvReq 0;
BA_ "GenSigTimeoutTime_CADM" SG_ 1952 HTShtOffVlvReq 0;
BA_ "GenSigTimeoutTime_DMSM" SG_ 1952 HTShtOffVlvReq 0;
BA_ "GenSigTimeoutTime_DTCM" SG_ 1952 HTShtOffVlvReq 0;
BA_ "GenSigTimeoutTime_ELSDM" SG_ 1952 HTShtOffVlvReq 0;
BA_ "GenSigTimeoutTime_ESL" SG_ 1952 HTShtOffVlvReq 0;
BA_ "GenSigTimeoutTime_GNMM" SG_ 1952 HTShtOffVlvReq 0;
BA_ "GenSigTimeoutTime_HCP" SG_ 1952 HTShtOffVlvReq 0;
BA_ "GenSigTimeoutTime_IPC" SG_ 1952 HTShtOffVlvReq 0;
BA_ "GenSigTimeoutTime_RFHM" SG_ 1952 HTShtOffVlvReq 0;
BA_ "GenSigTimeoutTime_SGW" SG_ 1952 HTShtOffVlvReq 0;
BA_ "GenSigTimeoutTime_TCM" SG_ 1952 HTShtOffVlvReq 0;
BA_ "GenSigSendType" SG_ 1952 ElecClntHtrInletTemp 3;
BA_ "GenSigTimeoutTime_AGSM" SG_ 1952 ElecClntHtrInletTemp 0;
BA_ "GenSigTimeoutTime_ASBS" SG_ 1952 ElecClntHtrInletTemp 0;
BA_ "GenSigTimeoutTime_BCM" SG_ 1952 ElecClntHtrInletTemp 0;
BA_ "GenSigTimeoutTime_BSM" SG_ 1952 ElecClntHtrInletTemp 0;
BA_ "GenSigTimeoutTime_CADM" SG_ 1952 ElecClntHtrInletTemp 0;
BA_ "GenSigTimeoutTime_DMSM" SG_ 1952 ElecClntHtrInletTemp 0;
BA_ "GenSigTimeoutTime_DTCM" SG_ 1952 ElecClntHtrInletTemp 0;
BA_ "GenSigTimeoutTime_ELSDM" SG_ 1952 ElecClntHtrInletTemp 0;
BA_ "GenSigTimeoutTime_ESL" SG_ 1952 ElecClntHtrInletTemp 0;
BA_ "GenSigTimeoutTime_GNMM" SG_ 1952 ElecClntHtrInletTemp 0;
BA_ "GenSigTimeoutTime_HCP" SG_ 1952 ElecClntHtrInletTemp 0;
BA_ "GenSigTimeoutTime_IPC" SG_ 1952 ElecClntHtrInletTemp 0;
BA_ "GenSigTimeoutTime_RFHM" SG_ 1952 ElecClntHtrInletTemp 0;
BA_ "GenSigTimeoutTime_SGW" SG_ 1952 ElecClntHtrInletTemp 0;
BA_ "GenSigTimeoutTime_TCM" SG_ 1952 ElecClntHtrInletTemp 0;
BA_ "GenSigTimeoutTime_AGSM" SG_ 1033 CRC_HYBRID_POWERTRAIN5 0;
BA_ "GenSigTimeoutTime_ASBS" SG_ 1033 CRC_HYBRID_POWERTRAIN5 0;
BA_ "GenSigTimeoutTime_BCM" SG_ 1033 CRC_HYBRID_POWERTRAIN5 0;
BA_ "GenSigTimeoutTime_BSM" SG_ 1033 CRC_HYBRID_POWERTRAIN5 0;
BA_ "GenSigTimeoutTime_CADM" SG_ 1033 CRC_HYBRID_POWERTRAIN5 0;
BA_ "GenSigTimeoutTime_DMSM" SG_ 1033 CRC_HYBRID_POWERTRAIN5 0;
BA_ "GenSigTimeoutTime_DTCM" SG_ 1033 CRC_HYBRID_POWERTRAIN5 0;
BA_ "GenSigTimeoutTime_ELSDM" SG_ 1033 CRC_HYBRID_POWERTRAIN5 0;
BA_ "GenSigTimeoutTime_ESL" SG_ 1033 CRC_HYBRID_POWERTRAIN5 0;
BA_ "GenSigTimeoutTime_GNMM" SG_ 1033 CRC_HYBRID_POWERTRAIN5 0;
BA_ "GenSigTimeoutTime_HCP" SG_ 1033 CRC_HYBRID_POWERTRAIN5 0;
BA_ "GenSigTimeoutTime_IPC" SG_ 1033 CRC_HYBRID_POWERTRAIN5 0;
BA_ "GenSigTimeoutTime_RFHM" SG_ 1033 CRC_HYBRID_POWERTRAIN5 0;
BA_ "GenSigTimeoutTime_SGW" SG_ 1033 CRC_HYBRID_POWERTRAIN5 0;
BA_ "GenSigTimeoutTime_AGSM" SG_ 1033 Hybrid_Immobilizer_Status 0;
BA_ "GenSigTimeoutTime_ASBS" SG_ 1033 Hybrid_Immobilizer_Status 0;
BA_ "GenSigTimeoutTime_BSM" SG_ 1033 Hybrid_Immobilizer_Status 0;
BA_ "GenSigTimeoutTime_CADM" SG_ 1033 Hybrid_Immobilizer_Status 0;
BA_ "GenSigTimeoutTime_DMSM" SG_ 1033 Hybrid_Immobilizer_Status 0;
BA_ "GenSigTimeoutTime_DTCM" SG_ 1033 Hybrid_Immobilizer_Status 0;
BA_ "GenSigTimeoutTime_ELSDM" SG_ 1033 Hybrid_Immobilizer_Status 0;
BA_ "GenSigTimeoutTime_ESL" SG_ 1033 Hybrid_Immobilizer_Status 0;
BA_ "GenSigTimeoutTime_GNMM" SG_ 1033 Hybrid_Immobilizer_Status 0;
BA_ "GenSigTimeoutTime_HCP" SG_ 1033 Hybrid_Immobilizer_Status 0;
BA_ "GenSigTimeoutTime_IPC" SG_ 1033 Hybrid_Immobilizer_Status 0;
BA_ "GenSigTimeoutTime_RFHM" SG_ 1033 Hybrid_Immobilizer_Status 0;
BA_ "GenSigTimeoutTime_SGW" SG_ 1033 Hybrid_Immobilizer_Status 0;
BA_ "GenSigTimeoutTime_TCM" SG_ 1033 Hybrid_Immobilizer_Status 0;
BA_ "SystemSignalLongSymbol" SG_ 1033 MessageCounter_HYBRID_POWERTRAI_409 "MessageCounter_HYBRID_POWERTRAIN5";
BA_ "GenSigTimeoutTime_AGSM" SG_ 1033 MessageCounter_HYBRID_POWERTRAI_409 0;
BA_ "GenSigTimeoutTime_ASBS" SG_ 1033 MessageCounter_HYBRID_POWERTRAI_409 0;
BA_ "GenSigTimeoutTime_BCM" SG_ 1033 MessageCounter_HYBRID_POWERTRAI_409 0;
BA_ "GenSigTimeoutTime_BSM" SG_ 1033 MessageCounter_HYBRID_POWERTRAI_409 0;
BA_ "GenSigTimeoutTime_CADM" SG_ 1033 MessageCounter_HYBRID_POWERTRAI_409 0;
BA_ "GenSigTimeoutTime_DMSM" SG_ 1033 MessageCounter_HYBRID_POWERTRAI_409 0;
BA_ "GenSigTimeoutTime_DTCM" SG_ 1033 MessageCounter_HYBRID_POWERTRAI_409 0;
BA_ "GenSigTimeoutTime_ELSDM" SG_ 1033 MessageCounter_HYBRID_POWERTRAI_409 0;
BA_ "GenSigTimeoutTime_ESL" SG_ 1033 MessageCounter_HYBRID_POWERTRAI_409 0;
BA_ "GenSigTimeoutTime_GNMM" SG_ 1033 MessageCounter_HYBRID_POWERTRAI_409 0;
BA_ "GenSigTimeoutTime_HCP" SG_ 1033 MessageCounter_HYBRID_POWERTRAI_409 0;
BA_ "GenSigTimeoutTime_IPC" SG_ 1033 MessageCounter_HYBRID_POWERTRAI_409 0;
BA_ "GenSigTimeoutTime_RFHM" SG_ 1033 MessageCounter_HYBRID_POWERTRAI_409 0;
BA_ "GenSigTimeoutTime_SGW" SG_ 1033 MessageCounter_HYBRID_POWERTRAI_409 0;
BA_ "GenSigTimeoutTime_AGSM" SG_ 1033 ElectricTrqMult4Pedal 0;
BA_ "GenSigTimeoutTime_ASBS" SG_ 1033 ElectricTrqMult4Pedal 0;
BA_ "GenSigTimeoutTime_BCM" SG_ 1033 ElectricTrqMult4Pedal 0;
BA_ "GenSigTimeoutTime_BSM" SG_ 1033 ElectricTrqMult4Pedal 0;
BA_ "GenSigTimeoutTime_CADM" SG_ 1033 ElectricTrqMult4Pedal 0;
BA_ "GenSigTimeoutTime_DMSM" SG_ 1033 ElectricTrqMult4Pedal 0;
BA_ "GenSigTimeoutTime_DTCM" SG_ 1033 ElectricTrqMult4Pedal 0;
BA_ "GenSigTimeoutTime_ELSDM" SG_ 1033 ElectricTrqMult4Pedal 0;
BA_ "GenSigTimeoutTime_ESL" SG_ 1033 ElectricTrqMult4Pedal 0;
BA_ "GenSigTimeoutTime_GNMM" SG_ 1033 ElectricTrqMult4Pedal 0;
BA_ "GenSigTimeoutTime_HCP" SG_ 1033 ElectricTrqMult4Pedal 0;
BA_ "GenSigTimeoutTime_IPC" SG_ 1033 ElectricTrqMult4Pedal 0;
BA_ "GenSigTimeoutTime_RFHM" SG_ 1033 ElectricTrqMult4Pedal 0;
BA_ "GenSigTimeoutTime_SGW" SG_ 1033 ElectricTrqMult4Pedal 0;
BA_ "GenSigTimeoutTime_TCM" SG_ 1033 ElectricTrqMult4Pedal 0;
BA_ "GenSigTimeoutTime_AGSM" SG_ 1033 Force_Park_Neutral 0;
BA_ "GenSigTimeoutTime_ASBS" SG_ 1033 Force_Park_Neutral 0;
BA_ "GenSigTimeoutTime_BCM" SG_ 1033 Force_Park_Neutral 0;
BA_ "GenSigTimeoutTime_BSM" SG_ 1033 Force_Park_Neutral 0;
BA_ "GenSigTimeoutTime_CADM" SG_ 1033 Force_Park_Neutral 0;
BA_ "GenSigTimeoutTime_DMSM" SG_ 1033 Force_Park_Neutral 0;
BA_ "GenSigTimeoutTime_DTCM" SG_ 1033 Force_Park_Neutral 0;
BA_ "GenSigTimeoutTime_ELSDM" SG_ 1033 Force_Park_Neutral 0;
BA_ "GenSigTimeoutTime_ESL" SG_ 1033 Force_Park_Neutral 0;
BA_ "GenSigTimeoutTime_GNMM" SG_ 1033 Force_Park_Neutral 0;
BA_ "GenSigTimeoutTime_HCP" SG_ 1033 Force_Park_Neutral 0;
BA_ "GenSigTimeoutTime_IPC" SG_ 1033 Force_Park_Neutral 0;
BA_ "GenSigTimeoutTime_RFHM" SG_ 1033 Force_Park_Neutral 0;
BA_ "GenSigTimeoutTime_SGW" SG_ 1033 Force_Park_Neutral 0;
BA_ "GenSigStartValue" SG_ 1033 HCPMaxEngRPM 255;
BA_ "GenSigTimeoutTime_AGSM" SG_ 1033 HCPMaxEngRPM 0;
BA_ "GenSigTimeoutTime_ASBS" SG_ 1033 HCPMaxEngRPM 0;
BA_ "GenSigTimeoutTime_BCM" SG_ 1033 HCPMaxEngRPM 0;
BA_ "GenSigTimeoutTime_BSM" SG_ 1033 HCPMaxEngRPM 0;
BA_ "GenSigTimeoutTime_CADM" SG_ 1033 HCPMaxEngRPM 0;
BA_ "GenSigTimeoutTime_DMSM" SG_ 1033 HCPMaxEngRPM 0;
BA_ "GenSigTimeoutTime_DTCM" SG_ 1033 HCPMaxEngRPM 0;
BA_ "GenSigTimeoutTime_ELSDM" SG_ 1033 HCPMaxEngRPM 0;
BA_ "GenSigTimeoutTime_ESL" SG_ 1033 HCPMaxEngRPM 0;
BA_ "GenSigTimeoutTime_GNMM" SG_ 1033 HCPMaxEngRPM 0;
BA_ "GenSigTimeoutTime_HCP" SG_ 1033 HCPMaxEngRPM 0;
BA_ "GenSigTimeoutTime_IPC" SG_ 1033 HCPMaxEngRPM 0;
BA_ "GenSigTimeoutTime_RFHM" SG_ 1033 HCPMaxEngRPM 0;
BA_ "GenSigTimeoutTime_SGW" SG_ 1033 HCPMaxEngRPM 0;
BA_ "GenSigTimeoutTime_TCM" SG_ 1033 HCPMaxEngRPM 0;
BA_ "GenSigTimeoutTime_AGSM" SG_ 1033 HEV_HybPwrtrnRdcdPerfCmnd 0;
BA_ "GenSigTimeoutTime_ASBS" SG_ 1033 HEV_HybPwrtrnRdcdPerfCmnd 0;
BA_ "GenSigTimeoutTime_BCM" SG_ 1033 HEV_HybPwrtrnRdcdPerfCmnd 0;
BA_ "GenSigTimeoutTime_BSM" SG_ 1033 HEV_HybPwrtrnRdcdPerfCmnd 0;
BA_ "GenSigTimeoutTime_CADM" SG_ 1033 HEV_HybPwrtrnRdcdPerfCmnd 0;
BA_ "GenSigTimeoutTime_DMSM" SG_ 1033 HEV_HybPwrtrnRdcdPerfCmnd 0;
BA_ "GenSigTimeoutTime_DTCM" SG_ 1033 HEV_HybPwrtrnRdcdPerfCmnd 0;
BA_ "GenSigTimeoutTime_ELSDM" SG_ 1033 HEV_HybPwrtrnRdcdPerfCmnd 0;
BA_ "GenSigTimeoutTime_ESL" SG_ 1033 HEV_HybPwrtrnRdcdPerfCmnd 0;
BA_ "GenSigTimeoutTime_GNMM" SG_ 1033 HEV_HybPwrtrnRdcdPerfCmnd 0;
BA_ "GenSigTimeoutTime_HCP" SG_ 1033 HEV_HybPwrtrnRdcdPerfCmnd 0;
BA_ "GenSigTimeoutTime_IPC" SG_ 1033 HEV_HybPwrtrnRdcdPerfCmnd 0;
BA_ "GenSigTimeoutTime_RFHM" SG_ 1033 HEV_HybPwrtrnRdcdPerfCmnd 0;
BA_ "GenSigTimeoutTime_SGW" SG_ 1033 HEV_HybPwrtrnRdcdPerfCmnd 0;
BA_ "GenSigTimeoutTime_TCM" SG_ 1033 HEV_HybPwrtrnRdcdPerfCmnd 0;
BA_ "GenSigStartValue" SG_ 1033 IdleCLoopTrq 511;
BA_ "GenSigTimeoutTime_AGSM" SG_ 1033 IdleCLoopTrq 0;
BA_ "GenSigTimeoutTime_ASBS" SG_ 1033 IdleCLoopTrq 0;
BA_ "GenSigTimeoutTime_BCM" SG_ 1033 IdleCLoopTrq 0;
BA_ "GenSigTimeoutTime_BSM" SG_ 1033 IdleCLoopTrq 0;
BA_ "GenSigTimeoutTime_CADM" SG_ 1033 IdleCLoopTrq 0;
BA_ "GenSigTimeoutTime_DMSM" SG_ 1033 IdleCLoopTrq 0;
BA_ "GenSigTimeoutTime_DTCM" SG_ 1033 IdleCLoopTrq 0;
BA_ "GenSigTimeoutTime_ELSDM" SG_ 1033 IdleCLoopTrq 0;
BA_ "GenSigTimeoutTime_ESL" SG_ 1033 IdleCLoopTrq 0;
BA_ "GenSigTimeoutTime_GNMM" SG_ 1033 IdleCLoopTrq 0;
BA_ "GenSigTimeoutTime_BCM" SG_ 752 IBS3_Error_Internal 0;
BA_ "GenSigTimeoutTime_BSM" SG_ 752 IBS3_Error_Internal 0;
BA_ "GenSigTimeoutTime_CADM" SG_ 752 IBS3_Error_Internal 0;
BA_ "GenSigTimeoutTime_DMSM" SG_ 752 IBS3_Error_Internal 0;
BA_ "GenSigTimeoutTime_DTCM" SG_ 752 IBS3_Error_Internal 0;
BA_ "GenSigTimeoutTime_ELSDM" SG_ 752 IBS3_Error_Internal 0;
BA_ "GenSigTimeoutTime_ESL" SG_ 752 IBS3_Error_Internal 0;
BA_ "GenSigTimeoutTime_GNMM" SG_ 752 IBS3_Error_Internal 0;
BA_ "GenSigTimeoutTime_HCP" SG_ 752 IBS3_Error_Internal 0;
BA_ "GenSigTimeoutTime_IPC" SG_ 752 IBS3_Error_Internal 0;
BA_ "GenSigTimeoutTime_RFHM" SG_ 752 IBS3_Error_Internal 0;
BA_ "GenSigTimeoutTime_SGW" SG_ 752 IBS3_Error_Internal 0;
BA_ "GenSigTimeoutTime_TCM" SG_ 752 IBS3_Error_Internal 0;
BA_ "GenSigTimeoutTime_AGSM" SG_ 752 RsErrIBS3 0;
BA_ "GenSigTimeoutTime_ASBS" SG_ 752 RsErrIBS3 0;
BA_ "GenSigTimeoutTime_BCM" SG_ 752 RsErrIBS3 0;
BA_ "GenSigTimeoutTime_BSM" SG_ 752 RsErrIBS3 0;
BA_ "GenSigTimeoutTime_CADM" SG_ 752 RsErrIBS3 0;
BA_ "GenSigTimeoutTime_DMSM" SG_ 752 RsErrIBS3 0;
BA_ "GenSigTimeoutTime_DTCM" SG_ 752 RsErrIBS3 0;
BA_ "GenSigTimeoutTime_ELSDM" SG_ 752 RsErrIBS3 0;
BA_ "GenSigTimeoutTime_ESL" SG_ 752 RsErrIBS3 0;
BA_ "GenSigTimeoutTime_GNMM" SG_ 752 RsErrIBS3 0;
BA_ "GenSigTimeoutTime_HCP" SG_ 752 RsErrIBS3 0;
BA_ "GenSigTimeoutTime_IPC" SG_ 752 RsErrIBS3 0;
BA_ "GenSigTimeoutTime_RFHM" SG_ 752 RsErrIBS3 0;
BA_ "GenSigTimeoutTime_SGW" SG_ 752 RsErrIBS3 0;
BA_ "GenSigTimeoutTime_TCM" SG_ 752 RsErrIBS3 0;
BA_ "GenSigTimeoutTime_AGSM" SG_ 752 VoltBattFailStatus 0;
BA_ "GenSigTimeoutTime_ASBS" SG_ 752 VoltBattFailStatus 0;
BA_ "GenSigTimeoutTime_BCM" SG_ 752 VoltBattFailStatus 0;
BA_ "GenSigTimeoutTime_BSM" SG_ 752 VoltBattFailStatus 0;
BA_ "GenSigTimeoutTime_CADM" SG_ 752 VoltBattFailStatus 0;
BA_ "GenSigTimeoutTime_DMSM" SG_ 752 VoltBattFailStatus 0;
BA_ "GenSigTimeoutTime_DTCM" SG_ 752 VoltBattFailStatus 0;
BA_ "GenSigTimeoutTime_ELSDM" SG_ 752 VoltBattFailStatus 0;
BA_ "GenSigTimeoutTime_ESL" SG_ 752 VoltBattFailStatus 0;
BA_ "GenSigTimeoutTime_GNMM" SG_ 752 VoltBattFailStatus 0;
BA_ "GenSigTimeoutTime_IPC" SG_ 752 VoltBattFailStatus 0;
BA_ "GenSigTimeoutTime_RFHM" SG_ 752 VoltBattFailStatus 0;
BA_ "GenSigTimeoutTime_SGW" SG_ 752 VoltBattFailStatus 0;
BA_ "GenSigTimeoutTime_TCM" SG_ 752 VoltBattFailStatus 0;
BA_ "GenSigStartValue" SG_ 752 IBS3_Ibatt 65535;
BA_ "GenSigTimeoutTime_AGSM" SG_ 752 IBS3_Ibatt 0;
BA_ "GenSigTimeoutTime_ASBS" SG_ 752 IBS3_Ibatt 0;
BA_ "GenSigTimeoutTime_BCM" SG_ 752 IBS3_Ibatt 0;
BA_ "GenSigTimeoutTime_BSM" SG_ 752 IBS3_Ibatt 0;
BA_ "GenSigTimeoutTime_CADM" SG_ 752 IBS3_Ibatt 0;
BA_ "GenSigTimeoutTime_DMSM" SG_ 752 IBS3_Ibatt 0;
BA_ "GenSigTimeoutTime_DTCM" SG_ 752 IBS3_Ibatt 0;
BA_ "GenSigTimeoutTime_ELSDM" SG_ 752 IBS3_Ibatt 0;
BA_ "GenSigTimeoutTime_ESL" SG_ 752 IBS3_Ibatt 0;
BA_ "GenSigTimeoutTime_GNMM" SG_ 752 IBS3_Ibatt 0;
BA_ "GenSigTimeoutTime_IPC" SG_ 752 IBS3_Ibatt 0;
BA_ "GenSigTimeoutTime_RFHM" SG_ 752 IBS3_Ibatt 0;
BA_ "GenSigTimeoutTime_TCM" SG_ 752 IBS3_Ibatt 0;
BA_ "GenSigTimeoutTime_AGSM" SG_ 752 IBS3_SOF_VC 0;
BA_ "GenSigTimeoutTime_ASBS" SG_ 752 IBS3_SOF_VC 0;
BA_ "GenSigTimeoutTime_BCM" SG_ 752 IBS3_SOF_VC 0;
BA_ "GenSigTimeoutTime_BSM" SG_ 752 IBS3_SOF_VC 0;
BA_ "GenSigTimeoutTime_CADM" SG_ 752 IBS3_SOF_VC 0;
BA_ "GenSigTimeoutTime_DMSM" SG_ 752 IBS3_SOF_VC 0;
BA_ "GenSigTimeoutTime_DTCM" SG_ 752 IBS3_SOF_VC 0;
BA_ "GenSigTimeoutTime_ELSDM" SG_ 752 IBS3_SOF_VC 0;
BA_ "GenSigTimeoutTime_ESL" SG_ 752 IBS3_SOF_VC 0;
BA_ "GenSigTimeoutTime_GNMM" SG_ 752 IBS3_SOF_VC 0;
BA_ "GenSigTimeoutTime_HCP" SG_ 752 IBS3_SOF_VC 0;
BA_ "GenSigTimeoutTime_IPC" SG_ 752 IBS3_SOF_VC 0;
BA_ "GenSigTimeoutTime_RFHM" SG_ 752 IBS3_SOF_VC 0;
BA_ "GenSigTimeoutTime_SGW" SG_ 752 IBS3_SOF_VC 0;
BA_ "GenSigTimeoutTime_BSM" SG_ 1328 MessageCounter_ENGINE_HYBD_FD_4 0;
BA_ "GenSigTimeoutTime_CADM" SG_ 1328 MessageCounter_ENGINE_HYBD_FD_4 0;
BA_ "GenSigTimeoutTime_DMSM" SG_ 1328 MessageCounter_ENGINE_HYBD_FD_4 0;
BA_ "GenSigTimeoutTime_DTCM" SG_ 1328 MessageCounter_ENGINE_HYBD_FD_4 0;
BA_ "GenSigTimeoutTime_ECM" SG_ 1328 MessageCounter_ENGINE_HYBD_FD_4 0;
BA_ "GenSigTimeoutTime_ELSDM" SG_ 1328 MessageCounter_ENGINE_HYBD_FD_4 0;
BA_ "GenSigTimeoutTime_ESL" SG_ 1328 MessageCounter_ENGINE_HYBD_FD_4 0;
BA_ "GenSigTimeoutTime_GNMM" SG_ 1328 MessageCounter_ENGINE_HYBD_FD_4 0;
BA_ "GenSigTimeoutTime_IPC" SG_ 1328 MessageCounter_ENGINE_HYBD_FD_4 0;
BA_ "GenSigTimeoutTime_RFHM" SG_ 1328 MessageCounter_ENGINE_HYBD_FD_4 0;
BA_ "GenSigTimeoutTime_SGW" SG_ 1328 MessageCounter_ENGINE_HYBD_FD_4 0;
BA_ "GenSigTimeoutTime_TCM" SG_ 1328 MessageCounter_ENGINE_HYBD_FD_4 0;
BA_ "GenSigTimeoutTime_AGSM" SG_ 1328 CatHtgStateActive 0;
BA_ "GenSigTimeoutTime_ASBS" SG_ 1328 CatHtgStateActive 0;
BA_ "GenSigTimeoutTime_BCM" SG_ 1328 CatHtgStateActive 0;
BA_ "GenSigTimeoutTime_BSM" SG_ 1328 CatHtgStateActive 0;
BA_ "GenSigTimeoutTime_CADM" SG_ 1328 CatHtgStateActive 0;
BA_ "GenSigTimeoutTime_DMSM" SG_ 1328 CatHtgStateActive 0;
BA_ "GenSigTimeoutTime_DTCM" SG_ 1328 CatHtgStateActive 0;
BA_ "GenSigTimeoutTime_ECM" SG_ 1328 CatHtgStateActive 0;
BA_ "GenSigTimeoutTime_ELSDM" SG_ 1328 CatHtgStateActive 0;
BA_ "GenSigTimeoutTime_ESL" SG_ 1328 CatHtgStateActive 0;
BA_ "GenSigTimeoutTime_GNMM" SG_ 1328 CatHtgStateActive 0;
BA_ "GenSigTimeoutTime_IPC" SG_ 1328 CatHtgStateActive 0;
BA_ "GenSigTimeoutTime_RFHM" SG_ 1328 CatHtgStateActive 0;
BA_ "GenSigTimeoutTime_SGW" SG_ 1328 CatHtgStateActive 0;
BA_ "GenSigTimeoutTime_TCM" SG_ 1328 CatHtgStateActive 0;
BA_ "GenSigTimeoutTime_AGSM" SG_ 1328 EngTorqCapbltyMaxOffTorq 0;
BA_ "GenSigTimeoutTime_ASBS" SG_ 1328 EngTorqCapbltyMaxOffTorq 0;
BA_ "GenSigTimeoutTime_BCM" SG_ 1328 EngTorqCapbltyMaxOffTorq 0;
BA_ "GenSigTimeoutTime_BSM" SG_ 1328 EngTorqCapbltyMaxOffTorq 0;
BA_ "GenSigTimeoutTime_CADM" SG_ 1328 EngTorqCapbltyMaxOffTorq 0;
BA_ "GenSigTimeoutTime_DMSM" SG_ 1328 EngTorqCapbltyMaxOffTorq 0;
BA_ "GenSigTimeoutTime_DTCM" SG_ 1328 EngTorqCapbltyMaxOffTorq 0;
BA_ "GenSigTimeoutTime_ECM" SG_ 1328 EngTorqCapbltyMaxOffTorq 0;
BA_ "GenSigTimeoutTime_ELSDM" SG_ 1328 EngTorqCapbltyMaxOffTorq 0;
BA_ "GenSigTimeoutTime_ESL" SG_ 1328 EngTorqCapbltyMaxOffTorq 0;
BA_ "GenSigTimeoutTime_GNMM" SG_ 1328 EngTorqCapbltyMaxOffTorq 0;
BA_ "GenSigTimeoutTime_IPC" SG_ 1328 EngTorqCapbltyMaxOffTorq 0;
BA_ "GenSigTimeoutTime_RFHM" SG_ 1328 EngTorqCapbltyMaxOffTorq 0;
BA_ "GenSigTimeoutTime_SGW" SG_ 1328 EngTorqCapbltyMaxOffTorq 0;
BA_ "GenSigTimeoutTime_TCM" SG_ 1328 EngTorqCapbltyMaxOffTorq 0;
BA_ "GenSigStartValue" SG_ 1328 EngTorqCapbltyMaxTorq 938;
BA_ "GenSigTimeoutTime_AGSM" SG_ 1328 EngTorqCapbltyMaxTorq 0;
BA_ "GenSigTimeoutTime_ASBS" SG_ 1328 EngTorqCapbltyMaxTorq 0;
BA_ "GenSigTimeoutTime_BCM" SG_ 1328 EngTorqCapbltyMaxTorq 0;
BA_ "GenSigTimeoutTime_BSM" SG_ 1328 EngTorqCapbltyMaxTorq 0;
BA_ "GenSigTimeoutTime_CADM" SG_ 1328 EngTorqCapbltyMaxTorq 0;
BA_ "GenSigTimeoutTime_DMSM" SG_ 1328 EngTorqCapbltyMaxTorq 0;
BA_ "GenSigTimeoutTime_DTCM" SG_ 1328 EngTorqCapbltyMaxTorq 0;
BA_ "GenSigTimeoutTime_ECM" SG_ 1328 EngTorqCapbltyMaxTorq 0;
BA_ "GenSigTimeoutTime_ELSDM" SG_ 1328 EngTorqCapbltyMaxTorq 0;
BA_ "GenSigTimeoutTime_ESL" SG_ 1328 EngTorqCapbltyMaxTorq 0;
BA_ "GenSigTimeoutTime_GNMM" SG_ 1328 EngTorqCapbltyMaxTorq 0;
BA_ "GenSigTimeoutTime_IPC" SG_ 1328 EngTorqCapbltyMaxTorq 0;
BA_ "GenSigTimeoutTime_RFHM" SG_ 1328 EngTorqCapbltyMaxTorq 0;
BA_ "GenSigTimeoutTime_SGW" SG_ 1328 EngTorqCapbltyMaxTorq 0;
BA_ "GenSigTimeoutTime_TCM" SG_ 1328 EngTorqCapbltyMaxTorq 0;
BA_ "GenSigStartValue" SG_ 1328 EngTorqCapbltyMinTorq 938;
BA_ "GenSigTimeoutTime_AGSM" SG_ 1328 EngTorqCapbltyMinTorq 0;
BA_ "GenSigTimeoutTime_ASBS" SG_ 1328 EngTorqCapbltyMinTorq 0;
BA_ "GenSigTimeoutTime_BCM" SG_ 1328 EngTorqCapbltyMinTorq 0;
BA_ "GenSigTimeoutTime_BSM" SG_ 1328 EngTorqCapbltyMinTorq 0;
BA_ "GenSigTimeoutTime_CADM" SG_ 1328 EngTorqCapbltyMinTorq 0;
BA_ "GenSigTimeoutTime_DMSM" SG_ 1328 EngTorqCapbltyMinTorq 0;
BA_ "GenSigTimeoutTime_DTCM" SG_ 1328 EngTorqCapbltyMinTorq 0;
BA_ "GenSigTimeoutTime_ECM" SG_ 1328 EngTorqCapbltyMinTorq 0;
BA_ "GenSigTimeoutTime_ELSDM" SG_ 1328 EngTorqCapbltyMinTorq 0;
BA_ "GenSigTimeoutTime_ESL" SG_ 1328 EngTorqCapbltyMinTorq 0;
BA_ "GenSigTimeoutTime_GNMM" SG_ 1328 EngTorqCapbltyMinTorq 0;
BA_ "GenSigTimeoutTime_IPC" SG_ 1328 EngTorqCapbltyMinTorq 0;
BA_ "GenSigTimeoutTime_RFHM" SG_ 1328 EngTorqCapbltyMinTorq 0;
BA_ "GenSigTimeoutTime_SGW" SG_ 1328 EngTorqCapbltyMinTorq 0;
BA_ "GenSigTimeoutTime_TCM" SG_ 1328 EngTorqCapbltyMinTorq 0;
VAL_ 1328 EngTorqCapbltyMinTorq 4095 "SNA";
VAL_ 1328 EngTorqCapbltyMaxTorq 4095 "SNA";
VAL_ 1035 EngHalfCylSpdMaxLim 8191 "SNA";
VAL_ 1952 ElecClntHtrInletTemp 255 "SNA";
VAL_ 1328 EngTorqCapbltyMaxOffTorq 4095 "SNA";
VAL_ 752 IBS3_Vbatt 511 "SNA";
VAL_ 752 IBS3_SOF_VC 127 "SNA";
VAL_ 752 IBS3_Ibatt 65535 "SNA";
VAL_ 1036 SpeedLimitSts 0 "Standby" 1 "Activated" 2 "Not_Actuable" 3 "Override" 4 "Overspeed" 5 "Deactivated" 6 "Off" 7 "SNA";
VAL_ 1036 Override 0 "Not_active" 1 "Active";
VAL_ 1036 OilLifeLeftRst 0 "Not_Active" 1 "Active";
VAL_ 1036 OilLifeLeft 255 "SNA";
VAL_ 1036 OIL_TEMP_IND_RQ 0 "OFF" 1 "ON" 2 "FLASH" 3 "SNA";
VAL_ 1036 OIL_TEMP_CHM_RQ 0 "NONE" 1 "SINGLE" 2 "SLOW" 3 "FAST";
VAL_ 1036 OIL_IND_LMP_FLSH 0 "Not_active" 1 "Active";
VAL_ 1036 EngineOilMin 0 "False" 1 "True";
VAL_ 1036 DistOilLifeRst 65535 "SNA";
VAL_ 1036 CC_SetSpdDspl_MPH 255 "SNA";
VAL_ 1036 CC_SetSpdDspl_KPH 8191 "SNA";
VAL_ 753 LVDC_CurrentFeedback 4095 "SNA";
VAL_ 1443 Traffic_Sign_Info 0 "Off" 1 "On";
VAL_ 1443 Speed_Unit 0 "mph" 1 "kph";
VAL_ 1443 New_Spd_Zone_Ind 0 "Off" 1 "Visual" 2 "Chime" 3 "Visual_Chime";
VAL_ 1443 Dist_Unit 0 "km" 1 "miles";
VAL_ 1032 RadiatorFanSts 127 "SNA";
VAL_ 1032 PECP2_PumpSpeedActual 127 "SNA";
VAL_ 1032 PECP_PumpSpeedActual 127 "SNA";
VAL_ 1032 PE_CoolTempOut 255 "SNA";
VAL_ 1032 AirflowRequest 127 "SNA";
VAL_ 1033 IdleCLoopTrq 1023 "SNA";
VAL_ 1033 HCPMaxEngRPM 255 "SNA";
VAL_ 1033 Force_Park_Neutral 0 "FALSE" 1 "TRUE";
VAL_ 1033 ElectricTrqMult4Pedal 255 "SNA";
VAL_ 1952 HTShtOffVlvReq 0 "Open" 1 "Closed";
VAL_ 1952 HTAuxPmpRPMAct 255 "SNA";
VAL_ 1952 HeaterCoreInletTemp 255 "SNA";
VAL_ 1952 ElecCoolantHtrPwr 255 "SNA";
VAL_ 1049 HybridMILRequest 0 "Not_Active" 1 "Active";
VAL_ 1834 HVBattery_RealTimeClockV 0 "Valid" 1 "Not_Valid";
VAL_ 1834 HVBattery_RealTimeClock 4294967295 "SNA";
VAL_ 1029 HVBatDischargePower_LongV 0 "Valid" 1 "Not_Valid";
VAL_ 1029 HVBatChargePower_ShortV 0 "Valid" 1 "Not_Valid";
VAL_ 1029 HVBatChargePower_Short 255 "SNA";
VAL_ 1029 HVBatChargePower_LongV 0 "Valid" 1 "Not_Valid";
VAL_ 1029 HVBatChargePower_Long 255 "SNA";
VAL_ 1029 HVBatChargePower_InstantV 0 "Valid" 1 "Not_Valid";
VAL_ 1029 HVBatChargePower_Instant 255 "SNA";
VAL_ 1027 HVBatteryMILRequest 0 "FALSE" 1 "TRUE";
VAL_ 833 GPF_T1_Status 0 "PASS" 1 "SHORT_TO_VBAT" 2 "SHORT_TO_GND" 5 "OPEN_CKT" 6 "TC_ASIC" 11 "TC_CJ" 13 "TC_ECU" 16 "NOT_COMPLETE";
VAL_ 1328 EngTorqCapbltyMinRunTorq 4095 "SNA";
VAL_ 1328 EngTorqACCCapability 255 "SNA";
VAL_ 1035 RadFanReq 127 "SNA";
VAL_ 1035 PECP_PumpFlowReq 127 "SNA";
VAL_ 1035 EngSpdStat 0 "NOR_OPR" 1 "DEG_OPR" 3 "SNA";
VAL_ 1035 EngCltTmpV 0 "False" 1 "True";
VAL_ 1035 EngCltTmp 255 "SNA";
VAL_ 1035 AGSposn 127 "SNA";
VAL_ 1035 AfterRunReq 0 "No_Request" 1 "Request_1" 2 "Request_2" 3 "Request_3" 4 "Request_4" 5 "Request_5" 6 "Request_6" 7 "SNA";
VAL_ 1036 ISASts 0 "Not_Active" 1 "Active";
VAL_ 1036 FANStatus 127 "SNA";
VAL_ 1036 DefFuelEcon 255 "SNA";
VAL_ 950 SPMControlSts 0 "Not_Active" 1 "Active_ParallelParking" 2 "Active_PerpendicularParking" 3 "Active_OutParking";
VAL_ 750 Battery_Volt_2 511 "SNA";
VAL_ 750 Battery_Volt_1 511 "SNA";
VAL_ 1436 Blower_Speed 511 "SNA";
VAL_ 1436 Blower_Diagnostics 1023 "SNA";
VAL_ 1435 DRV_TEMP_DR_POS_PCT 255 "SNA";
VAL_ 610 TSRSts 0 "Not_Active" 1 "Active" 2 "Blinded" 3 "Fault";
VAL_ 278 TransLosses 1023 "SNA";
VAL_ 278 TorqueConverterSts 0 "Lock_up_clutch_opened" 1 "Lock_up_clutch_is_slipping" 2 "Lock_up_clutch_closed" 3 "SNA";
VAL_ 278 TorqueConverterSTO 0 "Not_Active" 1 "Active";
VAL_ 278 TCM_Req_EngSpeed_Sts 0 "Inactive" 1 "Active";
VAL_ 278 TCM_Req_EngSpeed 8190 "Initialization" 8191 "SNA";
VAL_ 278 TCM_HillMode 1022 "Initialization" 1023 "SNA";
VAL_ 278 TargetGear 0 "Neutral" 1 "ForwardGear_1" 2 "ForwardGear_2" 3 "ForwardGear_3" 4 "ForwardGear_4" 5 "ForwardGear_5" 6 "ForwardGear_6" 7 "ForwardGear_7" 8 "ForwardGear_8" 9 "ForwardGear_9" 13 "Parking" 14 "ReverseGear" 15 "SNA";
VAL_ 278 MaxTrqDes 2047 "SNA";
VAL_ 278 EngTrq_Rq_TCM 2047 "SNA";
VAL_ 278 DisconnectClutch_Sts 0 "Disengaged" 1 "Prefilled" 2 "Torque_mode" 3 "Slip_control" 4 "Control_closed_5_rpm" 5 "Closed_Overpressure";
VAL_ 1033 Hybrid_Immobilizer_Status 0 "HCPIS" 1 "HCPKILL" 2 "HCPRUN" 3 "SNA";
VAL_ 278 TCM_ParkSL_Request 0 "Initialization" 1 "Request_Engage_Park" 2 "Request_Disengage_Park" 3 "SNA";
VAL_ 278 TCM_Comm_Fail_CAN 0 "No_Fault" 1 "TCM_LOC_CAN_ECM" 2 "TCM_LOC_CAN_HCP" 3 "TCM_LOC_CAN_HCP_ECM" 7 "TCM_Bus_Failure_CAN";
VAL_ 278 REPRGD_PFC_CLR_TCM 0 "Do Nothing" 1 "Set Incomplete";
VAL_ 278 PaddleShiftRequest 0 "PS_OFF" 1 "PS_RIGHT" 2 "PS_LEFT" 3 "PS_BOTH" 7 "SNA";
VAL_ 278 DriveLineRatio 16383 "SNA";
VAL_ 278 CODE_CLR_TCM 0 "Not Clear" 1 "Clear";
VAL_ 752 VoltBattFailStatus 0 "Fail_not_present" 1 "Fail_present";
VAL_ 752 RsErrIBS3 0 "NO_ERROR" 1 "ERROR";
VAL_ 752 IBS3_Error_Internal 0 "NO_ERROR" 1 "ERROR";
VAL_ 752 CurrBattFailStatus 0 "Fail_not_present" 1 "Fail_present";
VAL_ 1032 PE_CoolTempIn 255 "SNA";
VAL_ 1036 EngineOilTemperature 255 "SNA";
VAL_ 1435 HAS_OnOffSts 0 "Not_Pressed" 1 "Pressed";
VAL_ 1456 Set_Speed_KPH 255 "SNA";
VAL_ 1035 LTR_PumpSpeedAct 127 "SNA";
VAL_ 1035 EngHalfCylSpdMinLim 8191 "SNA";
VAL_ 278 TxIdleRq 255 "SNA";
VAL_ 1036 EngineOilOverfill 0 "False" 1 "True";
VAL_ 1036 EngineOilCritical 0 "False" 1 "True";
VAL_ 1036 AfterRunCoolantPumpFailSts 0 "Fault_Not_Present" 1 "Fault_Present";
VAL_ 278 TCASERANGESTATUS_TCM 0 "High" 1 "Neutral" 2 "Low" 3 "SNA";
VAL_ 1036 EngineOilLevel 0 "Level1" 1 "Level2" 2 "Level3" 3 "Level4" 4 "Level5" 5 "Level6" 6 "Level7" 7 "Level8" 8 "Level9" 9 "Level10" 10 "Level11" 11 "Level12" 12 "Level13" 13 "Level14" 31 "SNA";
VAL_ 278 TorqueAmpTransmission 2047 "SNA";
VAL_ 278 TrqCtrlModeReq 0 "None" 1 "TRQ_INC" 2 "TRQ_DEC" 3 "SNA";
VAL_ 752 IBS3_SOF_V_Accuracy 0 "Inaccurate" 1 "Accurate";
VAL_ 1952 HTAuxPmpMontrngRPM 0 "TRUE" 1 "FALSE" 3 "SNA";
VAL_ 1328 CatTempMaint 0 "Not_Active" 1 "Active";
VAL_ 278 TCMLnchCtrlAllowed 0 "Not_Allowed_GenReas" 1 "Not_Allowed_Reas1" 2 "Not_Allowed_Reas2" 3 "Allowed";
VAL_ 278 TransIntakeTorq 2047 "SNA";
VAL_ 1435 HVAC_CLNT_FLW_MIN 0 "OPEN" 254 "CLOSE" 255 "SNA";
VAL_ 1035 Engine_Maintenance_Sts 0 "Inactive" 1 "Stale_Fuel" 2 "Oil_Dilution_Spark_Defouling" 3 "Oil_Change_Req_EV_not_available" 7 "SNA";
VAL_ 1036 Racemode_Popup_ECM 0 "TM0" 1 "TM1" 2 "TM2" 3 "TM3" 4 "TM4" 5 "TM5" 6 "TM6" 7 "TM7" 8 "TM8" 9 "TM9" 10 "TM10" 11 "TM11" 12 "TM12" 13 "TM13" 14 "TM14" 15 "TM15" 16 "TM16" 17 "TM17" 18 "TM18" 19 "TM19" 20 "TM20" 21 "TM21" 22 "TM22" 23 "TM23" 24 "TM24" 25 "TM25" 26 "TM26" 27 "TM27" 28 "TM28" 29 "TM29" 30 "TM30" 31 "TM31" 32 "TM32" 33 "TM33" 34 "TM34" 35 "TM35" 36 "TM36" 37 "TM37" 38 "TM38" 39 "TM39" 40 "TM40" 41 "TM41" 42 "TM42" 43 "TM43" 44 "TM44" 45 "TM45" 46 "TM46" 47 "TM47" 48 "TM48" 49 "TM49" 50 "TM50" 51 "TM51" 52 "TM52" 53 "TM53" 54 "TM54" 55 "TM55" 56 "TM56" 57 "TM57" 58 "TM58" 59 "TM59" 60 "TM60" 61 "TM61" 62 "TM62" 63 "TM63" 64 "TM64" 65 "TM65" 66 "TM66" 67 "TM67" 68 "TM68" 69 "TM69" 70 "TM70" 71 "TM71" 72 "TM72" 73 "TM73" 74 "TM74" 75 "TM75" 76 "TM76" 77 "TM77" 78 "TM78" 79 "TM79" 80 "TM80" 81 "TM81" 82 "TM82" 83 "TM83" 84 "TM84" 85 "TM85" 86 "TM86" 87 "TM87" 88 "TM88" 89 "TM89" 90 "TM90" 91 "TM91" 92 "TM92" 93 "TM93" 94 "TM94" 95 "TM95" 96 "TM96" 97 "TM97" 98 "TM98" 99 "TM99" 100 "TM100" 101 "TM101" 102 "TM102" 103 "TM103" 104 "TM104" 105 "TM105" 106 "TM106" 107 "TM107" 108 "TM108" 109 "TM109" 110 "TM110" 111 "TM111" 112 "TM112" 113 "TM113" 114 "TM114" 115 "TM115" 116 "TM116" 117 "TM117" 118 "TM118" 119 "TM119" 120 "TM120" 121 "TM121" 122 "TM122" 123 "TM123" 124 "TM124" 125 "TM125" 126 "TM126" 127 "Reserved";
VAL_ 1036 Launch_Hard_Btn_LED_ECM 0 "Off" 1 "Cont" 2 "Blink" 3 "SNA";
VAL_ 1456 HAS_TelltaleSts 0 "OFF" 1 "GREY" 2 "GREEN" 3 "YELLOW" 4 "RED" 5 "GREEN_HANDS_FREE" 6 "YELLOW_HANDS_FREE" 7 "RED_HANDS_FREE";
SIG_GROUP_ 753 LV_CHARGER1_Pkt 1 : LVDC_CurrentFeedback MessageCounter_LV_CHARGER1 CRC_LV_CHARGER1;
SIG_GROUP_ 1033 HYBRID_POWERTRAIN5_Pkt 1 : IdleCLoopTrq HEV_HybPwrtrnRdcdPerfCmnd HCPMaxEngRPM Force_Park_Neutral ElectricTrqMult4Pedal Hybrid_Immobilizer_Status CRC_HYBRID_POWERTRAIN5 HCP_Stop_Start_Fault MessageCounter_HYBRID_POWERTRAI_409;
SIG_GROUP_ 278 TRANSM_FD_1_Pkt 1 : TransLosses TorqueConverterSts TorqueConverterSTO TCM_Req_EngSpeed_Sts TCM_Req_EngSpeed TCM_HillMode TargetGear MaxTrqDes EngTrq_Rq_TCM DisconnectClutch_Sts CRC_TRANSM1 TCM_ParkSL_Request TCM_Comm_Fail_CAN REPRGD_PFC_CLR_TCM PaddleShiftRequest MessageCounter_TRANSM1 DriveLineRatio CODE_CLR_TCM TxIdleRq TCASERANGESTATUS_TCM TorqueAmpTransmission TrqCtrlModeReq TCMLnchCtrlAllowed TransIntakeTorq;
