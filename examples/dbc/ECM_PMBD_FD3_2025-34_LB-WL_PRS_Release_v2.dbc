VERSION ""

NS_ :

BS_:

BU_: ECM

BO_ 1055 ENGINE_FD_8: 32 ECM
 SG_ RevOilLifeRst : 167|16@0+ (1000,0) [0|65534000] "Rev's"  Vector__XXX
 SG_ RefuelEvent : 44|3@0+ (1,0) [0|0] "-"  Vector__XXX
 SG_ OIL_PRESS : 159|8@0+ (4,0) [0|1016] "kPaG"  Vector__XXX
 SG_ MdsActforANC : 32|1@0+ (1,0) [0|1] "-"  Vector__XXX
 SG_ MdsAct : 25|1@0+ (1,0) [0|1] "-"  Vector__XXX
 SG_ MAP_4_BAR : 96|9@0+ (0.8,0) [0|408] "kPa"  Vector__XXX
 SG_ GF_Charge : 127|16@0+ (0.2,0) [0|13106.8] "mg/cycle/cyl"  Vector__XXX
 SG_ ENGINE_RESET : 24|1@0+ (1,0) [0|1] "-"  Vector__XXX
 SG_ AM_ECM_Prsnt : 103|2@0+ (1,0) [0|2] "-"  Vector__XXX
 SG_ MessageCounter_ENGINE8 : 179|4@0+ (1,0) [0|15] "-"  Vector__XXX
 SG_ CRC_ENGINE8 : 191|8@0+ (1,0) [0|255] "-"  Vector__XXX
 SG_ RefuelIndication : 47|3@0+ (1,0) [0|7] "-"  Vector__XXX
 SG_ PSI_Max_RPM : 101|5@0+ (100,2000) [2000|8000] "rpm"  Vector__XXX
 SG_ PSI_Gr5_RPM : 55|8@0+ (250,500) [500|7500] "rpm"  Vector__XXX
 SG_ PSI_Gr4_RPM : 63|8@0+ (250,500) [500|7500] "rpm"  Vector__XXX
 SG_ PSI_Gr3_RPM : 71|8@0+ (250,500) [500|7500] "rpm"  Vector__XXX
 SG_ PSI_Gr2_RPM : 79|8@0+ (250,500) [500|7500] "rpm"  Vector__XXX
 SG_ PSI_Gr1_RPM : 87|8@0+ (250,500) [500|7500] "rpm"  Vector__XXX
 SG_ PSI_EnableSts : 7|1@0+ (1,0) [0|1] "-"  Vector__XXX
 SG_ SYSTEM_STATUS : 26|1@0+ (1,0) [0|1] "-"  Vector__XXX
 SG_ RACE_CLDWN_SEL : 19|1@0+ (1,0) [0|1] "-"  Vector__XXX
 SG_ RACE_CLDWN_DEAC_TIME : 137|10@0+ (1,0) [0|1022] "sec"  Vector__XXX
 SG_ RACE_CLDWN_BATT_STAT : 22|1@0+ (1,0) [0|1] "-"  Vector__XXX
 SG_ PCPM_PumpSpeedAct : 6|7@0+ (1,0) [0|126] "%"  Vector__XXX
 SG_ LTR_TARGET_TEMP : 95|8@0+ (1,-40) [-40|214] "deg C"  Vector__XXX
 SG_ HOOD_AJAR_STATUS : 23|1@0+ (1,0) [0|1] "-"  Vector__XXX
 SG_ COOLING_REQUIRED_STATUS : 20|1@0+ (1,0) [0|1] "-"  Vector__XXX
 SG_ AFTER_RUN_STATUS : 21|1@0+ (1,0) [0|1] "-"  Vector__XXX
 SG_ Propulsion_DrvMd_Sts_ECM : 183|4@0+ (1,0) [0|15] "-"  Vector__XXX
 SG_ Actual_DriveMode_Status_ECM : 31|5@0+ (1,0) [0|31] "" Vector__XXX

BO_ 1448 ENGINE_FD_7: 32 ECM
 SG_ ExhaustTemperature : 135|8@0+ (4,0) [0|1020] "°C"  Vector__XXX
 SG_ ETCFailSts : 115|2@0+ (1,0) [0|3] "-"  Vector__XXX
 SG_ EngineOperatingMode : 124|3@0+ (1,0) [0|7] "-"  Vector__XXX
 SG_ EMSFailSts : 82|2@0+ (1,0) [0|3] "-"  Vector__XXX
 SG_ ECM_WARN_BTO : 147|1@0+ (1,0) [0|1] "-"  Vector__XXX
 SG_ ECM_WARN : 159|5@0+ (1,0) [0|31] "-"  Vector__XXX
 SG_ CompressorSts : 85|2@0+ (1,0) [0|3] "-"  Vector__XXX
 SG_ SpStSwStat : 55|2@0+ (1,0) [0|3] "-"  Vector__XXX
 SG_ SpStDispstat : 53|6@0+ (1,0) [0|63] "-"  Vector__XXX
 SG_ OilPressureSts : 119|1@0+ (1,0) [0|1] "-"  Vector__XXX
 SG_ OilLifeSts : 90|2@0+ (1,0) [0|3] "-"  Vector__XXX
 SG_ HoursOilLifeRst : 35|12@0+ (1,0) [0|4000] "Hours"  Vector__XXX
 SG_ FuelMM_Sts : 145|2@0+ (1,0) [0|0] "-"  Vector__XXX
 SG_ MessageCounter_ENGINE7 : 179|4@0+ (1,0) [0|15] "-"  Vector__XXX
 SG_ CRC_ENGINE7 : 191|8@0+ (1,0) [0|255] "-"  Vector__XXX
 SG_ GPFServiceSts : 68|3@0+ (1,0) [0|7] "-"  Vector__XXX
 SG_ KNK_MG_TRIGGER : 71|3@0+ (1,0) [0|3] "" Vector__XXX
 SG_ SpStIndRq : 58|1@0+ (1,0) [0|1] "-"  Vector__XXX
 SG_ MntncSts : 137|2@0+ (1,0) [0|3] "-"  Vector__XXX
 SG_ ECM_WARN_BTO_1 : 138|1@0+ (1,0) [0|1] "-"  Vector__XXX
 SG_ PerfShftRq_HUD : 175|2@0+ (1,0) [0|3] "-"  Vector__XXX
 SG_ HP_EngPwrMd_RED : 1|10@0+ (1,0) [0|1022] "hp"  Vector__XXX

BO_ 751 ENGINE_FD_6: 32 ECM
 SG_ StartRelayECMFeedbackFault : 163|1@0+ (1,0) [0|1] "-"  Vector__XXX
 SG_ StartRelayBCMFeedbackFault : 167|1@0+ (1,0) [0|1] "-"  Vector__XXX
 SG_ StartProtectionInhibit : 183|2@0+ (1,0) [0|0] "-"  Vector__XXX
 SG_ GearShiftIndication : 157|2@0+ (1,0) [0|3] "-"  Vector__XXX
 SG_ FuelConsumption_GAG : 103|16@0+ (0.0022,0) [0|144.1748] "litres/hour"  Vector__XXX
 SG_ EngineWaterTemp : 95|8@0+ (1,-40) [-40|215] "°C"  Vector__XXX
 SG_ TerrainModeStat_ECM : 61|5@0+ (1,0) [0|30] "" Vector__XXX
 SG_ TerrainModeDesiredStat : 28|5@0+ (1,0) [0|30] "0"  Vector__XXX
 SG_ Terrain_HMI_Rq_ECM : 36|5@0+ (1,0) [0|30] "-"  Vector__XXX
 SG_ StarterProtectionTime : 7|8@0+ (1,0) [0|254] "sec"  Vector__XXX
 SG_ SAMInfo : 147|4@0+ (1,0) [0|14] "-"  Vector__XXX
 SG_ MessageCounter_ENGINE6 : 179|4@0+ (1,0) [0|15] "-"  Vector__XXX
 SG_ LeakTestSts : 169|2@0+ (1,0) [0|0] "0"  Vector__XXX
 SG_ LeakTestRequest : 160|1@0+ (1,0) [0|1] "-"  Vector__XXX
 SG_ LeakCheckTimerValue : 56|9@0+ (1,0) [0|510] "min"  Vector__XXX
 SG_ DrvAway_Inhibit : 15|1@0+ (1,0) [0|1] "-"  Vector__XXX
 SG_ DrvAway_Indications : 14|3@0+ (1,0) [0|2] "0"  Vector__XXX
 SG_ DrvAway_Alert : 161|1@0+ (1,0) [0|1] "-"  Vector__XXX
 SG_ CRC_ENGINE6 : 191|8@0+ (1,0) [0|255] "-"  Vector__XXX
 SG_ Selector_SystemFailSts : 172|1@0+ (1,0) [0|1] "0"  Vector__XXX
 SG_ Trns_DrvMdReq_ECM : 77|5@0+ (1,0) [0|30] "-"  Vector__XXX
 SG_ Trns_DrvMd_CfgSts_ECM : 55|8@0+ (1,0) [0|30] "0"  Vector__XXX
 SG_ TerrainModeInterfaceButton_ECM : 11|3@0+ (1,0) [0|6] "-"  Vector__XXX
 SG_ ECM_FOTA_Conflict : 8|1@0+ (1,0) [0|1] "-"  Vector__XXX

BO_ 518 ENGINE_FD_5: 32 ECM
 SG_ RPMOverRev_W : 115|1@0+ (1,0) [0|1] "-"  Vector__XXX
 SG_ PdlPosActual : 87|8@0+ (0.4,0) [0|100] "%"  Vector__XXX
 SG_ MessageCounter_ENGINE5 : 179|4@0+ (1,0) [0|15] "-"  Vector__XXX
 SG_ GrMin_Rq_ECM_W : 139|4@0+ (1,0) [0|15] "-"  Vector__XXX
 SG_ EngTrqMaxCorrFctr_W : 127|8@0+ (0.0078,0) [0|1.98] "Nm"  Vector__XXX
 SG_ EngTrqEnblRq_DAS_W : 101|1@0+ (1,0) [0|1] "-"  Vector__XXX
 SG_ EngineReadyForESS_W : 116|1@0+ (1,0) [0|1] "-"  Vector__XXX
 SG_ ECM_READINESS_RESET_W : 140|1@0+ (1,0) [0|0] "0"  Vector__XXX
 SG_ ECM_CODE_CLR_W : 141|1@0+ (1,0) [0|0] "0"  Vector__XXX
 SG_ CRC_ENGINE5 : 191|8@0+ (1,0) [0|255] "-"  Vector__XXX
 SG_ IntkAirTempIntrClr : 167|8@0+ (1,-64) [-64|190] "°C"  Vector__XXX
 SG_ AirFuelRatio : 175|8@0+ (0.1,5.5) [5.5|18] "Lambda"  Vector__XXX
 SG_ LTR_CoolantTemp : 71|8@0+ (1,-64) [-64|190] "°C"  Vector__XXX
 SG_ RaceModeSts_ECM : 131|3@0+ (1,0) [0|7] "" Vector__XXX
 SG_ Prplsn_Raceoptions_Status_ECM : 183|4@0+ (1,0) [0|15] "" Vector__XXX

BO_ 1054 ENGINE_FD_1: 32 ECM
 SG_ ThrottlePosition : 87|8@0+ (0.392,0) [0|99.96] "%"  Vector__XXX
 SG_ RawPVS2 : 175|8@0+ (0.019607843,0) [0|4.98] "V"  Vector__XXX
 SG_ RawPVS1 : 167|8@0+ (0.019607843,0) [0|4.98] "V"  Vector__XXX
 SG_ ACPressure : 88|9@0+ (0.1,0) [0|40] "bar"  Vector__XXX
 SG_ TransWarmUpReq : 3|1@0+ (1,0) [0|1] "-"  Vector__XXX
 SG_ TransWarmUpMin_RPM : 159|8@0+ (25,0) [0|6375] "rpm"  Vector__XXX
 SG_ ThermalManagementActive_W : 1|1@0+ (1,0) [0|1] "-"  Vector__XXX
 SG_ RawTPS2 : 55|8@0+ (0.019607843,0) [0|4.98] "V"  Vector__XXX
 SG_ RawTPS1 : 63|8@0+ (0.019607843,0) [0|4.98] "V"  Vector__XXX
 SG_ MessageCounter_ENGINE1 : 179|4@0+ (1,0) [0|15] "-"  Vector__XXX
 SG_ Lv1CrsCtrlOff : 7|1@0+ (1,0) [0|1] "-"  Vector__XXX
 SG_ ESP_TrqRqEnabl : 6|1@0+ (1,0) [0|1] "-"  Vector__XXX
 SG_ EngMaxRPM_W : 127|8@0+ (50,0) [0|10000] "-"  Vector__XXX
 SG_ CRC_ENGINE1 : 191|8@0+ (1,0) [0|255] "-"  Vector__XXX
 SG_ BrkSw2Stat : 5|1@0+ (1,0) [0|1] "-"  Vector__XXX
 SG_ BrkSw1Stat : 4|1@0+ (1,0) [0|1] "-"  Vector__XXX
 SG_ AtmosphericPressureFailSts_W : 0|1@0+ (1,0) [0|1] "-"  Vector__XXX
 SG_ AtmosphericPressure_W : 143|8@0+ (3.6,300) [300|1214.4] "mbar"  Vector__XXX
 SG_ ACPressureFailSts : 22|1@0+ (1,0) [0|1] "-"  Vector__XXX
 SG_ HighPressureFuelSystemFailure : 2|1@0+ (1,0) [0|1] "-"  Vector__XXX
 SG_ AGS2Posn : 134|7@0+ (1,0) [0|100] "%"  Vector__XXX
 SG_ BoostVacGauge : 71|8@0+ (2,-200) [-200|310] "kPa"  Vector__XXX

BO_ 1068 DRIVETRAIN_FD_3: 32 Vector__XXX
 SG_ MessageCounter_DRIVETRAIN3 : 179|4@0+ (1,0) [0|15] "-"  ECM
 SG_ CRC__DRIVETRAIN3 : 191|8@0+ (1,0) [0|255] "-"  ECM
 SG_ TCASERANGESTATUS : 89|2@0+ (1,0) [0|2] "" ECM

BO_ 517 DRIVETRAIN_FD_1: 32 Vector__XXX
 SG_ DrvLnTrqRq : 80|9@0+ (2,0) [0|1020] "Nm"  ECM
 SG_ DrvLnMinTrqMd : 84|1@0+ (1,0) [0|1] "-"  ECM
 SG_ AWDSysStat : 87|3@0+ (1,0) [0|7] "-"  ECM
 SG_ MessageCounter_DRIVETRAIN1 : 179|4@0+ (1,0) [0|15] "-"  ECM
 SG_ CRC_DRIVETRAIN1 : 191|8@0+ (1,0) [0|255] "-"  ECM

BO_ 2564682256 DIAGNOSTIC_ROE_FD_ECM: 64 ECM
 SG_ N_PDU_18DDF210 : 7|64@0+ (1,0) [0|0] "" Vector__XXX

BO_ 2564682000 DIAGNOSTIC_ROE_ECM: 8 ECM
 SG_ N_PDU_18DDF110 : 7|64@0+ (1,0) [0|0] "" Vector__XXX

BO_ 2564485648 DIAGNOSTIC_RESPONSE_FD_ECM: 64 ECM
 SG_ N_PDU_18DAF210 : 7|64@0+ (1,0) [0|0] "" Vector__XXX

BO_ 2564554482 DIAGNOSTIC_REQUEST_FD_FUNCTIONAL: 64 Vector__XXX
 SG_ N_PDU_18DBFEF2 : 7|64@0+ (1,0) [0|0] "" ECM

BO_ 2564428018 DIAGNOSTIC_REQUEST_FD_ECM: 64 Vector__XXX
 SG_ N_PDU_18DA10F2 : 7|64@0+ (1,0) [0|0] "" ECM

BO_ 514 BRAKE_FD_7: 32 Vector__XXX
 SG_ MessageCounter_BRAKE7 : 179|4@0+ (1,0) [0|15] "-"  ECM
 SG_ CRC_BRAKE7 : 191|8@0+ (1,0) [0|255] "-"  ECM
 SG_ BrkPdl_Stat : 85|2@0+ (1,0) [0|2] "-"  ECM
 SG_ BrkPdl_Flt : 86|1@0+ (1,0) [0|1] "-"  ECM
 SG_ BrakePdlPosn : 63|8@0+ (0.4,0) [0|100] "%"  ECM
 SG_ AutoVehHoldSts : 30|2@0+ (1,0) [0|3] "-"  ECM
 SG_ BSM_ReadyForESS : 181|2@0+ (1,0) [0|2] "-"  ECM

BO_ 1155 BRAKE_FD_5: 32 Vector__XXX
 SG_ RollsModeAct : 91|1@0+ (1,0) [0|1] "-"  ECM
 SG_ ESCFailSts : 83|1@0+ (1,0) [0|1] "-"  ECM
 SG_ ACCEngaged : 92|1@0+ (1,0) [0|1] "-"  ECM
 SG_ ABSFailSts : 87|1@0+ (1,0) [0|1] "-"  ECM
 SG_ MessageCounter_BRAKE5 : 179|4@0+ (1,0) [0|15] "-"  ECM
 SG_ CRC_BRAKE5 : 191|8@0+ (1,0) [0|255] "-"  ECM

BO_ 609 BRAKE_FD_4: 32 Vector__XXX
 SG_ TravelDistance : 87|8@0+ (1,0) [0|255] "m"  ECM
 SG_ EPBSts : 115|4@0+ (1,0) [0|14] "-"  ECM
 SG_ REPRGD_PFC_CLR_BSM : 175|1@0+ (1,0) [0|1] "-"  ECM
 SG_ MIL_OnRq_BSM : 172|1@0+ (1,0) [0|1] "-"  ECM
 SG_ MessageCounter_BRAKE4 : 179|4@0+ (1,0) [0|15] "-"  ECM
 SG_ CRC_BRAKE4 : 191|8@0+ (1,0) [0|255] "-"  ECM
 SG_ CODE_CLR_BSM : 160|1@0+ (1,0) [0|1] "-"  ECM

BO_ 259 BRAKE_FD_3: 32 Vector__XXX
 SG_ RHR_WheelSensorFailSts : 103|1@0+ (1,0) [0|1] "-"  ECM
 SG_ RHF_WheelSensorFailSts : 182|1@0+ (1,0) [0|1] "-"  ECM
 SG_ LHR_WheelSensorFailSts : 87|1@0+ (1,0) [0|1] "-"  ECM
 SG_ LHF_WheelSensorFailSts : 181|1@0+ (1,0) [0|1] "-"  ECM
 SG_ RHRWheelSpeed : 68|13@0+ (0.0625,0) [0|511.875] "Km/h"  ECM
 SG_ RHFWheelSpeed : 52|13@0+ (0.0625,0) [0|511.875] "Km/h"  ECM
 SG_ MessageCounter_BRAKE3 : 179|4@0+ (1,0) [0|15] "-"  ECM
 SG_ LHRWheelSpeed : 4|13@0+ (0.0625,0) [0|511.875] "Km/h"  ECM
 SG_ LHFWheelSpeed : 20|13@0+ (0.0625,0) [0|511.875] "Km/h"  ECM
 SG_ CRC__BRAKE3 : 191|8@0+ (1,0) [0|255] "-"  ECM

CM_ SG_ 2564485648 N_PDU_18DAF210 "This signal is used for diagnostic purposes";
CM_ SG_ 2564682000 N_PDU_18DDF110 "This signal is used for diagnostic purposes";
CM_ SG_ 2564682256 N_PDU_18DDF210 "This signal is used for diagnostic purposes";
CM_ SG_ 1054 BoostVacGauge "Gauge input for calculated boost/vacuum pressure";
CM_ SG_ 1054 HighPressureFuelSystemFailure "High Pressure Fuel Pump (HPFP) system failure where torque is limited to the amount of available fuel from supply pump.";
CM_ SG_ 1054 TransWarmUpReq "ECM enable flag for transmission warm-up strategy.";
CM_ SG_ 1054 AGS2Posn "ECM AGS2 feedback";
CM_ SG_ 1054 Lv1CrsCtrlOff "EDR ONLY - Level is requested cruise off";
CM_ SG_ 1054 MessageCounter_ENGINE1 "This signal is a counter used for safety checks strategies. This counter is incremented of 1 (one) unit at each frame transmission.";
CM_ SG_ 1054 RawTPS1 "EDR ONLY - Raw throttle position sensor #1";
CM_ SG_ 1054 RawTPS2 "EDR ONLY - Raw throttle position sensor #2";
CM_ SG_ 1054 ThermalManagementActive_W "-";
CM_ SG_ 1054 TransWarmUpMin_RPM "Minimum engine speed for transmission warm-up strategy.";
CM_ SG_ 1054 AtmosphericPressureFailSts_W "-";
CM_ SG_ 1054 BrkSw1Stat "EDR ONLY - Brake switch1 status, off = [0]";
CM_ SG_ 1054 BrkSw2Stat "EDR ONLY - Brake switch2 status, off = [0]";
CM_ SG_ 1054 CRC_ENGINE1 "CRC according to SAE J1850 standard at each frame transmission.";
CM_ SG_ 1054 EngMaxRPM_W "-";
CM_ SG_ 1054 ESP_TrqRqEnabl "EDR ONLY - ESP torque requests are allowed = [1]";
CM_ SG_ 1054 ACPressureFailSts "This signal indicates if the ACpressure sensor is in fail.";
CM_ SG_ 1054 AtmosphericPressure_W "-";
CM_ SG_ 1054 ACPressure "It indicates air conditioning pressure read from the AC linear pressure sensor.";
CM_ SG_ 1054 RawPVS1 "EDR ONLY - Raw pedal value sensor #1";
CM_ SG_ 1054 RawPVS2 "EDR ONLY - Raw pedal value sensor #2";
CM_ SG_ 1054 ThrottlePosition "GASOLINE APPLICATION ONLY This signal represents throttle position evaluated on the basis of throttle position sensor.";
CM_ SG_ 518 Prplsn_Raceoptions_Status_ECM "Race option arbitration status";
CM_ SG_ 518 AirFuelRatio "Air To fuel ratio";
CM_ SG_ 518 IntkAirTempIntrClr "Intake air temperature post intercooler";
CM_ SG_ 518 RaceModeSts_ECM "Racemode Status";
CM_ SG_ 518 LTR_CoolantTemp "Low temp radiator (intercooler) coolant temperature";
CM_ SG_ 518 EngTrqEnblRq_DAS_W "-";
CM_ SG_ 518 EngTrqMaxCorrFctr_W "Factor of reduction from max torque based on ambient conditions";
CM_ SG_ 518 GrMin_Rq_ECM_W "Target gear lower limit (ECM requested limit)";
CM_ SG_ 518 MessageCounter_ENGINE5 "This signal is a counter used for safety checks strategies. This counter is incremented of 1 (one) unit at each frame transmission.";
CM_ SG_ 518 PdlPosActual "Actual pedal position.";
CM_ SG_ 518 RPMOverRev_W "-";
CM_ SG_ 518 CRC_ENGINE5 "CRC according to SAE J1850 standard at each frame transmission.";
CM_ SG_ 518 ECM_CODE_CLR_W "Handshake for not to send";
CM_ SG_ 518 ECM_READINESS_RESET_W "Handshake for not to send";
CM_ SG_ 518 EngineReadyForESS_W "ESS request HIS charget (1=do charge)";
CM_ SG_ 751 Trns_DrvMdReq_ECM "The requested state of the drive mode feature";
CM_ SG_ 751 TerrainModeInterfaceButton_ECM "Signal Indicates G/T or TRX Button activated or Not Activated by driver";
CM_ SG_ 751 FuelConsumption_GAG "It represents istantaneous consumption information sent on network";
CM_ SG_ 751 GearShiftIndication "-";
CM_ SG_ 751 StartProtectionInhibit "Starter protection status";
CM_ SG_ 751 StartRelayBCMFeedbackFault "-";
CM_ SG_ 751 StartRelayECMFeedbackFault "-";
CM_ SG_ 751 Selector_SystemFailSts "Used to require a vehicle modality";
CM_ SG_ 751 EngineWaterTemp "-";
CM_ SG_ 751 MessageCounter_ENGINE6 "This signal is a counter used for safety checks strategies. This counter is incremented of 1 (one) unit at each frame transmission.";
CM_ SG_ 751 SAMInfo "-";
CM_ SG_ 751 StarterProtectionTime "Starter protection time";
CM_ SG_ 751 TerrainModeDesiredStat "Signal indicates customer desired terrain mode status";
CM_ SG_ 751 TerrainModeStat_ECM "Used to require a vehicle modality";
CM_ SG_ 751 DrvAway_Alert "Drive Away Alert; True = [1]";
CM_ SG_ 751 DrvAway_Indications "Drive Away Inhibit Indications";
CM_ SG_ 751 DrvAway_Inhibit "Drive Away Inhibit; True = [1]";
CM_ SG_ 751 LeakCheckTimerValue "Requested leak test timer value";
CM_ SG_ 751 LeakTestRequest "Leak test is requested after powerdown; No request = [0], Leak test requested = [1]";
CM_ SG_ 751 LeakTestSts "Status of leak test";
CM_ SG_ 751 CRC_ENGINE6 "CRC according to SAE J1850 standard at each frame transmission.";
CM_ SG_ 751 ECM_FOTA_Conflict "ECM Conflict with FOTA";
CM_ SG_ 751 Trns_DrvMd_CfgSts_ECM "The requested state of the drive mode feature";
CM_ SG_ 1448 PerfShftRq_HUD "Performance transmission shift request HUD";
CM_ SG_ 1448 ECM_WARN_BTO_1 "A new message will be displayed on cluster when both brake and gas pedal are pressed simultaneously - without ETC lamp";
CM_ SG_ 1448 HP_EngPwrMd_RED "horsepower ratings the engine is able to reach in Red key power mode.";
CM_ SG_ 1448 OilLifeSts "This information is related to engine oil life algorithm, currently used on Diesel engines equipped with DPF.";
CM_ SG_ 1448 OilPressureSts "This signal  indicates oil pressure status (High or low).";
CM_ SG_ 1448 SpStDispstat "Stop start display status";
CM_ SG_ 1448 SpStSwStat "Stop start switch status";
CM_ SG_ 1448 KNK_MG_TRIGGER "Engine is experiencing high levels of LSPI (mega-knock)";
CM_ SG_ 1448 CompressorSts "This signal gives information about the present status of A/C external request and actual A/C activation by ECM.";
CM_ SG_ 1448 SpStIndRq "Stop start indicator request";
CM_ SG_ 1448 GPFServiceSts "ECM enable flag for GPF service indication";
CM_ SG_ 1448 CRC_ENGINE7 "CRC according to SAE J1850 standard at each frame transmission.";
CM_ SG_ 1448 MessageCounter_ENGINE7 "This signal is a counter used for safety checks strategies. This counter is incremented of 1 (one) unit at each frame transmission.";
CM_ SG_ 1448 FuelMM_Sts "Fuel maintenance mode status";
CM_ SG_ 1448 HoursOilLifeRst "Hours since last oil life reset";
CM_ SG_ 1448 MntncSts "Maintenance reminder status";
CM_ SG_ 1448 ECM_WARN "This signal will be used to drive warning messages on Cluster.";
CM_ SG_ 1448 ECM_WARN_BTO "A new message will be displayed on cluster when both brake and gas pedal are pressed simultaneously";
CM_ SG_ 1448 EMSFailSts "This signal is used  to switch on and off the engine control system warning lamp (called MI for EOBD applications)";
CM_ SG_ 1448 EngineOperatingMode "This signal indicates the engine operating mode (normal or after-treatment systems regeneration)";
CM_ SG_ 1448 ETCFailSts "This signal is used  to switch on and off  ETC lamp to give informations about faults not EOBD relevant.";
CM_ SG_ 1448 ExhaustTemperature "This signal indicates the exhaust engine temperature after combustion or after-treatment systems (if applicable)";
CM_ SG_ 1055 Propulsion_DrvMd_Sts_ECM "Propulsion Mode Drive mode status for ICE";
CM_ SG_ 1055 RACE_CLDWN_DEAC_TIME "Race cooldown time remaining before deactivation";
CM_ SG_ 1055 PSI_Max_RPM "Maximum selectable RPM for PSI feature";
CM_ SG_ 1055 LTR_TARGET_TEMP "LTR target temperature in degC";
CM_ SG_ 1055 PSI_Gr1_RPM "Actual rpm set point for performance shift indication; 500 indicates not set";
CM_ SG_ 1055 PSI_Gr2_RPM "Actual rpm set point for performance shift indication; 500 indicates not set";
CM_ SG_ 1055 PSI_Gr3_RPM "Actual rpm set point for performance shift indication; 500 indicates not set";
CM_ SG_ 1055 PSI_Gr4_RPM "Actual rpm set point for performance shift indication; 500 indicates not set";
CM_ SG_ 1055 PSI_Gr5_RPM "Actual rpm set point for performance shift indication; 500 indicates not set";
CM_ SG_ 1055 Actual_DriveMode_Status_ECM "Actual Drive mode status (Current mode based on the customer selection) for ICE";
CM_ SG_ 1055 SYSTEM_STATUS "System faults; Acive faults = [1]";
CM_ SG_ 1055 HOOD_AJAR_STATUS "Hood adjar for cooldown feature; Open = [1]";
CM_ SG_ 1055 RACE_CLDWN_BATT_STAT "Battery health for quick cooldown feature; Acceptable = [1]";
CM_ SG_ 1055 AFTER_RUN_STATUS "Quick cooldown feature; Active = [1]";
CM_ SG_ 1055 COOLING_REQUIRED_STATUS "Status of LTR system requiring cooling; Required = [1]";
CM_ SG_ 1055 RACE_CLDWN_SEL "State of user selected quick cooldown feature; Selected = [1]";
CM_ SG_ 1055 PSI_EnableSts "Performance shift indication enabled status; enabled = [1]";
CM_ SG_ 1055 MdsActforANC "MDS active for ANC; Active = [1]";
CM_ SG_ 1055 OIL_PRESS "Oil pressure";
CM_ SG_ 1055 RefuelEvent "Status of refuel event";
CM_ SG_ 1055 RevOilLifeRst "Engine revolutions since last oil life reset";
CM_ SG_ 1055 MessageCounter_ENGINE8 "This signal is a counter used for safety checks strategies. This counter is incremented of 1 (one) unit at each frame transmission.";
CM_ SG_ 1055 AM_ECM_Prsnt "Aftermarket ECM present";
CM_ SG_ 1055 ENGINE_RESET "ECM Reset Notification";
CM_ SG_ 1055 GF_Charge "EDR ONLY - Port flow per cylinder per stroke";
CM_ SG_ 1055 MAP_4_BAR "Engine manifold pressure (4 bar range)";
CM_ SG_ 1055 MdsAct "MDS Active";
CM_ SG_ 1055 PCPM_PumpSpeedAct "Primary Coolant pump actual speed  in percentage";
CM_ SG_ 1055 RefuelIndication "Indication to the driver about the status of the refuel system";
CM_ SG_ 1055 CRC_ENGINE8 "CRC according to SAE J1850 standard at each frame transmission.";
CM_ SG_ 259 RHF_WheelSensorFailSts "This signal indicates the fail status of RHF sensor";
CM_ SG_ 259 LHF_WheelSensorFailSts "This signal indicates the fail status of LHF sensor";
CM_ SG_ 259 RHR_WheelSensorFailSts "This signal indicates the fail status of RHR sensor";
CM_ SG_ 259 LHR_WheelSensorFailSts "This signal indicates the fail status of LHR sensor";
CM_ SG_ 259 CRC__BRAKE3 "CRC according to SAE J1850 standard at each frame transmission.";
CM_ SG_ 259 LHFWheelSpeed "This is the value of the left front wheel speed";
CM_ SG_ 259 LHRWheelSpeed "This is the value of the left rear wheel speed";
CM_ SG_ 259 MessageCounter_BRAKE3 "This signal is a counter used for safety checks strategies. This counter is incremented of 1 (one) unit at each frame transmission.";
CM_ SG_ 259 RHFWheelSpeed "This is the value of the right front wheel speed";
CM_ SG_ 259 RHRWheelSpeed "This is the value of the right rear wheel speed";
CM_ SG_ 609 CODE_CLR_BSM "Clear emission related faults";
CM_ SG_ 609 CRC_BRAKE4 "CRC according to SAE J1850 standard at each frame transmission.";
CM_ SG_ 609 MessageCounter_BRAKE4 "This signal is a counter used for safety checks strategies. This counter is incremented of 1 (one) unit at each frame transmission.";
CM_ SG_ 609 MIL_OnRq_BSM "MIL switch on request";
CM_ SG_ 609 REPRGD_PFC_CLR_BSM "Set readiness to \"incomplete\"";
CM_ SG_ 609 EPBSts "0";
CM_ SG_ 609 TravelDistance "This signal indicates the travel distance value.";
CM_ SG_ 1155 CRC_BRAKE5 "CRC according to SAE J1850 standard at each frame transmission.";
CM_ SG_ 1155 MessageCounter_BRAKE5 "This signal is a counter used for safety checks strategies. This counter is incremented of 1 (one) unit at each frame transmission.";
CM_ SG_ 1155 ABSFailSts "0";
CM_ SG_ 1155 ACCEngaged "ACC is engaged";
CM_ SG_ 1155 ESCFailSts "0";
CM_ SG_ 1155 RollsModeAct "This signal indicates when the brake system module is in the Rolls Test mode.";
CM_ SG_ 514 BrkPdl_Flt "Brake Pedal Fault is active, 1=Faulted";
CM_ SG_ 514 BrkPdl_Stat "Brake pedal state";
CM_ SG_ 514 CRC_BRAKE7 "CRC according to SAE J1850 standard at each frame transmission.";
CM_ SG_ 514 MessageCounter_BRAKE7 "This signal is a counter used for safety checks strategies. This counter is incremented of 1 (one) unit at each frame transmission.";
CM_ SG_ 514 BSM_ReadyForESS "BSM Stop Start Ready status";
CM_ SG_ 514 AutoVehHoldSts "New ESC comfort feature called auto vehicle hold. Allows driver to remove his foor from the brake and the vehicle will hydraulically hold vehicle still until throttle is applied";
CM_ SG_ 514 BrakePdlPosn "Brake pedal travel sensor 0-100% (0 = upstop)";
CM_ SG_ 2564428018 N_PDU_18DA10F2 "This signal is used for diagnostic purposes";
CM_ SG_ 2564554482 N_PDU_18DBFEF2 "This signal is used for diagnostic purposes";
CM_ SG_ 517 CRC_DRIVETRAIN1 "CRC according to SAE J1850 standard at each frame transmission.";
CM_ SG_ 517 MessageCounter_DRIVETRAIN1 "This signal is a counter used for safety checks strategies. This counter is incremented of 1 (one) unit at each frame transmission.";
CM_ SG_ 517 AWDSysStat "-";
CM_ SG_ 517 DrvLnMinTrqMd "-";
CM_ SG_ 517 DrvLnTrqRq "-";
CM_ SG_ 1068 TCASERANGESTATUS "This signal is used for update the Transfer case Range status";
CM_ SG_ 1068 CRC__DRIVETRAIN3 "CRC according to SAE J1850 standard at each frame transmission.";
CM_ SG_ 1068 MessageCounter_DRIVETRAIN3 "This signal is a counter used for safety checks strategies. This counter is incremented of 1 (one) unit at each frame transmission.";
BA_DEF_ SG_ "GenSigTimeoutTime_ADCAM" INT 0 65535;
BA_DEF_ SG_ "GenSigTimeoutTime_EVCU2" INT 0 65535;
BA_DEF_ SG_ "GenSigTimeoutTime_VDCM" INT 0 65535;
BA_DEF_ SG_ "GenSigStartValue" INT 0 2147483647;
BA_DEF_ SG_ "GenSigInactiveValue" INT 0 2147483647;
BA_DEF_ SG_ "GenSigSendType" ENUM "NotUsed","OnWrite","OnWriteWithRepetition","OnChange","OnChangeWithRepetition","IfActive","IfActiveWithRepetition","NoSigSendType";
BA_DEF_ SG_ "SystemSignalLongSymbol" STRING ;
BA_DEF_ SG_ "GenSigTimeoutTime_AGSM" INT 0 65535;
BA_DEF_ SG_ "GenSigTimeoutTime_ASBS" INT 0 65535;
BA_DEF_ SG_ "GenSigTimeoutTime_BCM" INT 0 65535;
BA_DEF_ SG_ "GenSigTimeoutTime_BSM" INT 0 65535;
BA_DEF_ SG_ "GenSigTimeoutTime_CADM" INT 0 65535;
BA_DEF_ SG_ "GenSigTimeoutTime_DMSM" INT 0 65535;
BA_DEF_ SG_ "GenSigTimeoutTime_DTCM" INT 0 65535;
BA_DEF_ SG_ "GenSigTimeoutTime_ECM" INT 0 65535;
BA_DEF_ SG_ "GenSigTimeoutTime_ELSDM" INT 0 65535;
BA_DEF_ SG_ "GenSigTimeoutTime_ESL" INT 0 65535;
BA_DEF_ SG_ "GenSigTimeoutTime_GNMM" INT 0 65535;
BA_DEF_ SG_ "GenSigTimeoutTime_HCP" INT 0 65535;
BA_DEF_ SG_ "GenSigTimeoutTime_IPC" INT 0 65535;
BA_DEF_ SG_ "GenSigTimeoutTime_RFHM" INT 0 65535;
BA_DEF_ SG_ "GenSigTimeoutTime_SGW" INT 0 65535;
BA_DEF_ SG_ "GenSigTimeoutTime_TCM" INT 0 65535;
BA_DEF_ BO_ "DiagRequest" ENUM "No","Yes";
BA_DEF_ BO_ "Type" ENUM "P","C","PE","COC","PE_Cntrl","E","E_Cntrl","OC","S","BAF","DC","EM","MM","ISO-TP","-";
BA_DEF_ BO_ "DiagResponse" ENUM "No","Yes";
BA_DEF_ BO_ "NmMessage" ENUM "No","Yes";
BA_DEF_ BO_ "GenMsgSendType" ENUM "Cyclic","NotUsed","NotUsed","NotUsed","NotUsed","NotUsed","NotUsed","NotUsed","NoMsgSendType";
BA_DEF_ BO_ "GenMsgNrOfRepetition" INT 0 255;
BA_DEF_ BO_ "GenMsgILSupport" ENUM "No","Yes";
BA_DEF_ BO_ "GenMsgStartDelayTime" INT 0 65535;
BA_DEF_ BO_ "GenMsgCycleTimeFast" INT 0 65535;
BA_DEF_ BO_ "GenMsgCycleTime" INT 0 65535;
BA_DEF_ BO_ "GenMsgDelayTime" INT 0 65535;
BA_DEF_ BO_ "NmAsrMessage" ENUM "No","Yes";
BA_DEF_ BO_ "DiagState" ENUM "No","Yes";
BA_DEF_ BO_ "DiagConnection" HEX 0 65535;
BA_DEF_ BO_ "VFrameFormat" ENUM "StandardCAN","ExtendedCAN","reserved","reserved","reserved","reserved","reserved","reserved","reserved","reserved","reserved","reserved","reserved","reserved","StandardCAN_FD","ExtendedCAN_FD";
BA_DEF_ BO_ "CANFD_BRS" ENUM "0","1";
BA_DEF_DEF_ "GenSigTimeoutTime_ADCAM" 2500;
BA_DEF_DEF_ "GenSigTimeoutTime_EVCU2" 2500;
BA_DEF_DEF_ "GenSigTimeoutTime_VDCM" 2500;
BA_DEF_DEF_ "GenSigStartValue" 0;
BA_DEF_DEF_ "GenSigInactiveValue" 0;
BA_DEF_DEF_ "GenSigSendType" "NoSigSendType";
BA_DEF_DEF_ "SystemSignalLongSymbol" "";
BA_DEF_DEF_ "GenSigTimeoutTime_AGSM" 2500;
BA_DEF_DEF_ "GenSigTimeoutTime_ASBS" 2500;
BA_DEF_DEF_ "GenSigTimeoutTime_BCM" 2500;
BA_DEF_DEF_ "GenSigTimeoutTime_BSM" 2500;
BA_DEF_DEF_ "GenSigTimeoutTime_CADM" 2500;
BA_DEF_DEF_ "GenSigTimeoutTime_DMSM" 2500;
BA_DEF_DEF_ "GenSigTimeoutTime_DTCM" 2500;
BA_DEF_DEF_ "GenSigTimeoutTime_ECM" 2500;
BA_DEF_DEF_ "GenSigTimeoutTime_ELSDM" 2500;
BA_DEF_DEF_ "GenSigTimeoutTime_ESL" 2500;
BA_DEF_DEF_ "GenSigTimeoutTime_GNMM" 2500;
BA_DEF_DEF_ "GenSigTimeoutTime_HCP" 2500;
BA_DEF_DEF_ "GenSigTimeoutTime_IPC" 2500;
BA_DEF_DEF_ "GenSigTimeoutTime_RFHM" 2500;
BA_DEF_DEF_ "GenSigTimeoutTime_SGW" 2500;
BA_DEF_DEF_ "GenSigTimeoutTime_TCM" 2500;
BA_DEF_DEF_ "DiagRequest" "No";
BA_DEF_DEF_ "Type" "-";
BA_DEF_DEF_ "DiagResponse" "No";
BA_DEF_DEF_ "NmMessage" "No";
BA_DEF_DEF_ "GenMsgSendType" "NoMsgSendType";
BA_DEF_DEF_ "GenMsgNrOfRepetition" 0;
BA_DEF_DEF_ "GenMsgILSupport" "No";
BA_DEF_DEF_ "GenMsgStartDelayTime" 0;
BA_DEF_DEF_ "GenMsgCycleTimeFast" 0;
BA_DEF_DEF_ "GenMsgCycleTime" 0;
BA_DEF_DEF_ "GenMsgDelayTime" 0;
BA_DEF_DEF_ "NmAsrMessage" "No";
BA_DEF_DEF_ "DiagState" "No";
BA_DEF_DEF_ "DiagConnection" 0;
BA_DEF_DEF_ "VFrameFormat" "StandardCAN_FD";
BA_DEF_DEF_ "CANFD_BRS" "0";
BA_ "Type" BO_ 259 1;
BA_ "GenMsgSendType" BO_ 259 0;
BA_ "GenMsgILSupport" BO_ 259 1;
BA_ "GenMsgCycleTime" BO_ 259 10;
BA_ "CANFD_BRS" BO_ 259 1;
BA_ "Type" BO_ 609 3;
BA_ "GenMsgSendType" BO_ 609 0;
BA_ "GenMsgNrOfRepetition" BO_ 609 2;
BA_ "GenMsgILSupport" BO_ 609 1;
BA_ "GenMsgCycleTimeFast" BO_ 609 20;
BA_ "GenMsgCycleTime" BO_ 609 100;
BA_ "GenMsgSendType" BO_ 517 0;
BA_ "GenMsgILSupport" BO_ 517 1;
BA_ "GenMsgCycleTime" BO_ 517 20;
BA_ "CANFD_BRS" BO_ 517 1;
BA_ "Type" BO_ 1068 3;
BA_ "GenMsgSendType" BO_ 1068 0;
BA_ "GenMsgNrOfRepetition" BO_ 1068 2;
BA_ "GenMsgILSupport" BO_ 1068 1;
BA_ "GenMsgCycleTimeFast" BO_ 1068 20;
BA_ "GenMsgCycleTime" BO_ 1068 100;
BA_ "GenMsgDelayTime" BO_ 1068 20;
BA_ "CANFD_BRS" BO_ 1068 1;
BA_ "Type" BO_ 2564485648 8;
BA_ "DiagResponse" BO_ 2564485648 1;
BA_ "DiagConnection" BO_ 2564485648 61968;
BA_ "VFrameFormat" BO_ 2564485648 15;
BA_ "CANFD_BRS" BO_ 2564485648 1;
BA_ "Type" BO_ 2564682000 8;
BA_ "DiagResponse" BO_ 2564682000 1;
BA_ "DiagConnection" BO_ 2564682000 61712;
BA_ "VFrameFormat" BO_ 2564682000 1;
BA_ "Type" BO_ 2564682256 8;
BA_ "DiagResponse" BO_ 2564682256 1;
BA_ "DiagConnection" BO_ 2564682256 61968;
BA_ "VFrameFormat" BO_ 2564682256 15;
BA_ "CANFD_BRS" BO_ 2564682256 1;
BA_ "Type" BO_ 1054 1;
BA_ "GenMsgSendType" BO_ 1054 0;
BA_ "GenMsgILSupport" BO_ 1054 1;
BA_ "GenMsgCycleTime" BO_ 1054 100;
BA_ "CANFD_BRS" BO_ 1054 1;
BA_ "Type" BO_ 518 1;
BA_ "GenMsgSendType" BO_ 518 0;
BA_ "GenMsgILSupport" BO_ 518 1;
BA_ "GenMsgCycleTime" BO_ 518 20;
BA_ "CANFD_BRS" BO_ 518 1;
BA_ "Type" BO_ 751 1;
BA_ "GenMsgSendType" BO_ 751 0;
BA_ "GenMsgILSupport" BO_ 751 1;
BA_ "GenMsgCycleTime" BO_ 751 50;
BA_ "CANFD_BRS" BO_ 751 1;
BA_ "Type" BO_ 1448 3;
BA_ "GenMsgSendType" BO_ 1448 0;
BA_ "GenMsgNrOfRepetition" BO_ 1448 2;
BA_ "GenMsgILSupport" BO_ 1448 1;
BA_ "GenMsgCycleTimeFast" BO_ 1448 20;
BA_ "GenMsgCycleTime" BO_ 1448 1000;
BA_ "GenMsgDelayTime" BO_ 1448 20;
BA_ "CANFD_BRS" BO_ 1448 1;
BA_ "Type" BO_ 1055 1;
BA_ "GenMsgSendType" BO_ 1055 0;
BA_ "GenMsgILSupport" BO_ 1055 1;
BA_ "GenMsgCycleTime" BO_ 1055 100;
BA_ "CANFD_BRS" BO_ 1055 1;
BA_ "CANFD_BRS" BO_ 609 1;
BA_ "Type" BO_ 1155 3;
BA_ "GenMsgSendType" BO_ 1155 0;
BA_ "GenMsgNrOfRepetition" BO_ 1155 2;
BA_ "GenMsgILSupport" BO_ 1155 1;
BA_ "GenMsgCycleTimeFast" BO_ 1155 20;
BA_ "GenMsgCycleTime" BO_ 1155 500;
BA_ "GenMsgDelayTime" BO_ 1155 20;
BA_ "CANFD_BRS" BO_ 1155 1;
BA_ "Type" BO_ 514 1;
BA_ "GenMsgSendType" BO_ 514 0;
BA_ "GenMsgILSupport" BO_ 514 1;
BA_ "GenMsgCycleTime" BO_ 514 20;
BA_ "CANFD_BRS" BO_ 514 1;
BA_ "DiagRequest" BO_ 2564428018 1;
BA_ "Type" BO_ 2564428018 8;
BA_ "DiagConnection" BO_ 2564428018 61968;
BA_ "VFrameFormat" BO_ 2564428018 15;
BA_ "CANFD_BRS" BO_ 2564428018 1;
BA_ "Type" BO_ 2564554482 8;
BA_ "DiagState" BO_ 2564554482 1;
BA_ "DiagConnection" BO_ 2564554482 62206;
BA_ "VFrameFormat" BO_ 2564554482 15;
BA_ "CANFD_BRS" BO_ 2564554482 1;
BA_ "Type" BO_ 517 1;
BA_ "GenSigTimeoutTime_ADCAM" SG_ 259 RHFWheelSpeed 0;
BA_ "GenSigTimeoutTime_DMSM" SG_ 518 EngTrqMaxCorrFctr_W 0;
BA_ "GenSigTimeoutTime_DTCM" SG_ 518 EngTrqMaxCorrFctr_W 0;
BA_ "GenSigTimeoutTime_ECM" SG_ 518 EngTrqMaxCorrFctr_W 0;
BA_ "GenSigTimeoutTime_ELSDM" SG_ 518 EngTrqMaxCorrFctr_W 0;
BA_ "GenSigTimeoutTime_ESL" SG_ 518 EngTrqMaxCorrFctr_W 0;
BA_ "GenSigTimeoutTime_GNMM" SG_ 518 EngTrqMaxCorrFctr_W 0;
BA_ "GenSigTimeoutTime_HCP" SG_ 518 EngTrqMaxCorrFctr_W 0;
BA_ "GenSigTimeoutTime_IPC" SG_ 518 EngTrqMaxCorrFctr_W 0;
BA_ "GenSigTimeoutTime_RFHM" SG_ 518 EngTrqMaxCorrFctr_W 0;
BA_ "GenSigTimeoutTime_SGW" SG_ 518 EngTrqMaxCorrFctr_W 0;
BA_ "GenSigTimeoutTime_AGSM" SG_ 518 GrMin_Rq_ECM_W 0;
BA_ "GenSigTimeoutTime_ASBS" SG_ 518 GrMin_Rq_ECM_W 0;
BA_ "GenSigTimeoutTime_BCM" SG_ 518 GrMin_Rq_ECM_W 0;
BA_ "GenSigTimeoutTime_BSM" SG_ 518 GrMin_Rq_ECM_W 0;
BA_ "GenSigTimeoutTime_CADM" SG_ 518 GrMin_Rq_ECM_W 0;
BA_ "GenSigTimeoutTime_DMSM" SG_ 518 GrMin_Rq_ECM_W 0;
BA_ "GenSigTimeoutTime_DTCM" SG_ 518 GrMin_Rq_ECM_W 0;
BA_ "GenSigTimeoutTime_ECM" SG_ 518 GrMin_Rq_ECM_W 0;
BA_ "GenSigTimeoutTime_ELSDM" SG_ 518 GrMin_Rq_ECM_W 0;
BA_ "GenSigTimeoutTime_ESL" SG_ 518 GrMin_Rq_ECM_W 0;
BA_ "GenSigTimeoutTime_GNMM" SG_ 518 GrMin_Rq_ECM_W 0;
BA_ "GenSigTimeoutTime_HCP" SG_ 518 GrMin_Rq_ECM_W 0;
BA_ "GenSigTimeoutTime_IPC" SG_ 518 GrMin_Rq_ECM_W 0;
BA_ "GenSigTimeoutTime_RFHM" SG_ 518 GrMin_Rq_ECM_W 0;
BA_ "GenSigTimeoutTime_SGW" SG_ 518 GrMin_Rq_ECM_W 0;
BA_ "GenSigTimeoutTime_AGSM" SG_ 518 MessageCounter_ENGINE5 0;
BA_ "GenSigTimeoutTime_ASBS" SG_ 518 MessageCounter_ENGINE5 0;
BA_ "GenSigTimeoutTime_DMSM" SG_ 518 MessageCounter_ENGINE5 0;
BA_ "GenSigTimeoutTime_DTCM" SG_ 518 MessageCounter_ENGINE5 0;
BA_ "GenSigTimeoutTime_ECM" SG_ 518 MessageCounter_ENGINE5 0;
BA_ "GenSigTimeoutTime_ELSDM" SG_ 518 MessageCounter_ENGINE5 0;
BA_ "GenSigTimeoutTime_ESL" SG_ 518 MessageCounter_ENGINE5 0;
BA_ "GenSigTimeoutTime_GNMM" SG_ 518 MessageCounter_ENGINE5 0;
BA_ "GenSigTimeoutTime_IPC" SG_ 518 MessageCounter_ENGINE5 0;
BA_ "GenSigTimeoutTime_RFHM" SG_ 518 MessageCounter_ENGINE5 0;
BA_ "GenSigTimeoutTime_SGW" SG_ 518 MessageCounter_ENGINE5 0;
BA_ "GenSigStartValue" SG_ 518 PdlPosActual 1;
BA_ "GenSigTimeoutTime_AGSM" SG_ 518 PdlPosActual 0;
BA_ "GenSigTimeoutTime_ASBS" SG_ 518 PdlPosActual 0;
BA_ "GenSigTimeoutTime_DMSM" SG_ 518 PdlPosActual 0;
BA_ "GenSigTimeoutTime_DTCM" SG_ 518 PdlPosActual 0;
BA_ "GenSigTimeoutTime_ECM" SG_ 518 PdlPosActual 0;
BA_ "GenSigTimeoutTime_ELSDM" SG_ 518 PdlPosActual 0;
BA_ "GenSigTimeoutTime_ESL" SG_ 518 PdlPosActual 0;
BA_ "GenSigTimeoutTime_GNMM" SG_ 518 PdlPosActual 0;
BA_ "GenSigTimeoutTime_HCP" SG_ 518 PdlPosActual 0;
BA_ "GenSigTimeoutTime_IPC" SG_ 518 PdlPosActual 0;
BA_ "GenSigTimeoutTime_RFHM" SG_ 518 PdlPosActual 0;
BA_ "GenSigTimeoutTime_TCM" SG_ 518 PdlPosActual 0;
BA_ "GenSigTimeoutTime_AGSM" SG_ 518 RPMOverRev_W 0;
BA_ "GenSigTimeoutTime_ASBS" SG_ 518 RPMOverRev_W 0;
BA_ "GenSigTimeoutTime_BCM" SG_ 518 RPMOverRev_W 0;
BA_ "GenSigTimeoutTime_BSM" SG_ 518 RPMOverRev_W 0;
BA_ "GenSigTimeoutTime_CADM" SG_ 518 RPMOverRev_W 0;
BA_ "GenSigTimeoutTime_DMSM" SG_ 518 RPMOverRev_W 0;
BA_ "GenSigTimeoutTime_DTCM" SG_ 518 RPMOverRev_W 0;
BA_ "GenSigTimeoutTime_ECM" SG_ 518 RPMOverRev_W 0;
BA_ "GenSigTimeoutTime_ELSDM" SG_ 518 RPMOverRev_W 0;
BA_ "GenSigTimeoutTime_ESL" SG_ 518 RPMOverRev_W 0;
BA_ "GenSigTimeoutTime_GNMM" SG_ 518 RPMOverRev_W 0;
BA_ "GenSigTimeoutTime_IPC" SG_ 518 RPMOverRev_W 0;
BA_ "GenSigTimeoutTime_RFHM" SG_ 518 RPMOverRev_W 0;
BA_ "GenSigTimeoutTime_SGW" SG_ 518 RPMOverRev_W 0;
BA_ "GenSigTimeoutTime_AGSM" SG_ 518 CRC_ENGINE5 0;
BA_ "GenSigTimeoutTime_ASBS" SG_ 518 CRC_ENGINE5 0;
BA_ "GenSigTimeoutTime_DMSM" SG_ 518 CRC_ENGINE5 0;
BA_ "GenSigTimeoutTime_DTCM" SG_ 518 CRC_ENGINE5 0;
BA_ "GenSigTimeoutTime_ECM" SG_ 518 CRC_ENGINE5 0;
BA_ "GenSigTimeoutTime_ELSDM" SG_ 518 CRC_ENGINE5 0;
BA_ "GenSigTimeoutTime_ESL" SG_ 518 CRC_ENGINE5 0;
BA_ "GenSigTimeoutTime_GNMM" SG_ 518 CRC_ENGINE5 0;
BA_ "GenSigTimeoutTime_IPC" SG_ 518 CRC_ENGINE5 0;
BA_ "GenSigTimeoutTime_RFHM" SG_ 518 CRC_ENGINE5 0;
BA_ "GenSigTimeoutTime_SGW" SG_ 518 CRC_ENGINE5 0;
BA_ "GenSigTimeoutTime_AGSM" SG_ 518 ECM_CODE_CLR_W 0;
BA_ "GenSigTimeoutTime_ASBS" SG_ 518 ECM_CODE_CLR_W 0;
BA_ "GenSigTimeoutTime_BCM" SG_ 518 ECM_CODE_CLR_W 0;
BA_ "GenSigTimeoutTime_CADM" SG_ 518 ECM_CODE_CLR_W 0;
BA_ "GenSigTimeoutTime_DMSM" SG_ 518 ECM_CODE_CLR_W 0;
BA_ "GenSigTimeoutTime_DTCM" SG_ 518 ECM_CODE_CLR_W 0;
BA_ "GenSigTimeoutTime_ECM" SG_ 518 ECM_CODE_CLR_W 0;
BA_ "GenSigTimeoutTime_ELSDM" SG_ 518 ECM_CODE_CLR_W 0;
BA_ "GenSigTimeoutTime_ESL" SG_ 518 ECM_CODE_CLR_W 0;
BA_ "GenSigTimeoutTime_GNMM" SG_ 518 ECM_CODE_CLR_W 0;
BA_ "GenSigTimeoutTime_IPC" SG_ 518 ECM_CODE_CLR_W 0;
BA_ "GenSigTimeoutTime_RFHM" SG_ 518 ECM_CODE_CLR_W 0;
BA_ "GenSigTimeoutTime_SGW" SG_ 518 ECM_CODE_CLR_W 0;
BA_ "GenSigTimeoutTime_AGSM" SG_ 518 ECM_READINESS_RESET_W 0;
BA_ "GenSigTimeoutTime_ASBS" SG_ 518 ECM_READINESS_RESET_W 0;
BA_ "GenSigTimeoutTime_BCM" SG_ 518 ECM_READINESS_RESET_W 0;
BA_ "GenSigTimeoutTime_CADM" SG_ 518 ECM_READINESS_RESET_W 0;
BA_ "GenSigTimeoutTime_DMSM" SG_ 518 ECM_READINESS_RESET_W 0;
BA_ "GenSigTimeoutTime_DTCM" SG_ 518 ECM_READINESS_RESET_W 0;
BA_ "GenSigTimeoutTime_ECM" SG_ 518 ECM_READINESS_RESET_W 0;
BA_ "GenSigTimeoutTime_ELSDM" SG_ 518 ECM_READINESS_RESET_W 0;
BA_ "GenSigTimeoutTime_ESL" SG_ 518 ECM_READINESS_RESET_W 0;
BA_ "GenSigTimeoutTime_GNMM" SG_ 518 ECM_READINESS_RESET_W 0;
BA_ "GenSigTimeoutTime_IPC" SG_ 518 ECM_READINESS_RESET_W 0;
BA_ "GenSigTimeoutTime_RFHM" SG_ 518 ECM_READINESS_RESET_W 0;
BA_ "GenSigTimeoutTime_SGW" SG_ 518 ECM_READINESS_RESET_W 0;
BA_ "GenSigTimeoutTime_AGSM" SG_ 518 EngineReadyForESS_W 0;
BA_ "GenSigTimeoutTime_ASBS" SG_ 518 EngineReadyForESS_W 0;
BA_ "GenSigTimeoutTime_BCM" SG_ 518 EngineReadyForESS_W 0;
BA_ "GenSigTimeoutTime_BSM" SG_ 518 EngineReadyForESS_W 0;
BA_ "GenSigTimeoutTime_CADM" SG_ 518 EngineReadyForESS_W 0;
BA_ "GenSigTimeoutTime_DMSM" SG_ 518 EngineReadyForESS_W 0;
BA_ "GenSigTimeoutTime_DTCM" SG_ 518 EngineReadyForESS_W 0;
BA_ "GenSigTimeoutTime_ECM" SG_ 518 EngineReadyForESS_W 0;
BA_ "GenSigTimeoutTime_ELSDM" SG_ 518 EngineReadyForESS_W 0;
BA_ "GenSigTimeoutTime_ESL" SG_ 518 EngineReadyForESS_W 0;
BA_ "GenSigTimeoutTime_GNMM" SG_ 518 EngineReadyForESS_W 0;
BA_ "GenSigTimeoutTime_HCP" SG_ 518 EngineReadyForESS_W 0;
BA_ "GenSigTimeoutTime_IPC" SG_ 518 EngineReadyForESS_W 0;
BA_ "GenSigTimeoutTime_RFHM" SG_ 518 EngineReadyForESS_W 0;
BA_ "GenSigTimeoutTime_SGW" SG_ 518 EngineReadyForESS_W 0;
BA_ "GenSigTimeoutTime_ADCAM" SG_ 751 Trns_DrvMdReq_ECM 0;
BA_ "GenSigTimeoutTime_EVCU2" SG_ 751 Trns_DrvMdReq_ECM 0;
BA_ "GenSigTimeoutTime_VDCM" SG_ 751 Trns_DrvMdReq_ECM 0;
BA_ "GenSigTimeoutTime_AGSM" SG_ 751 Trns_DrvMdReq_ECM 0;
BA_ "GenSigTimeoutTime_BCM" SG_ 751 Trns_DrvMdReq_ECM 0;
BA_ "GenSigTimeoutTime_BSM" SG_ 751 Trns_DrvMdReq_ECM 0;
BA_ "GenSigTimeoutTime_ECM" SG_ 751 Trns_DrvMdReq_ECM 0;
BA_ "GenSigTimeoutTime_ESL" SG_ 751 Trns_DrvMdReq_ECM 0;
BA_ "GenSigTimeoutTime_IPC" SG_ 751 Trns_DrvMdReq_ECM 0;
BA_ "GenSigTimeoutTime_RFHM" SG_ 751 Trns_DrvMdReq_ECM 0;
BA_ "GenSigTimeoutTime_SGW" SG_ 751 Trns_DrvMdReq_ECM 0;
BA_ "GenSigTimeoutTime_TCM" SG_ 751 Trns_DrvMdReq_ECM 0;
BA_ "GenSigTimeoutTime_ADCAM" SG_ 751 TerrainModeInterfaceButton_ECM 0;
BA_ "GenSigTimeoutTime_EVCU2" SG_ 751 TerrainModeInterfaceButton_ECM 0;
BA_ "GenSigTimeoutTime_VDCM" SG_ 751 TerrainModeInterfaceButton_ECM 0;
BA_ "GenSigTimeoutTime_AGSM" SG_ 751 TerrainModeInterfaceButton_ECM 0;
BA_ "GenSigTimeoutTime_BCM" SG_ 751 TerrainModeInterfaceButton_ECM 0;
BA_ "GenSigTimeoutTime_BSM" SG_ 751 TerrainModeInterfaceButton_ECM 0;
BA_ "GenSigTimeoutTime_DTCM" SG_ 751 TerrainModeInterfaceButton_ECM 0;
BA_ "GenSigTimeoutTime_ECM" SG_ 751 TerrainModeInterfaceButton_ECM 0;
BA_ "GenSigTimeoutTime_ESL" SG_ 751 TerrainModeInterfaceButton_ECM 0;
BA_ "GenSigTimeoutTime_IPC" SG_ 751 TerrainModeInterfaceButton_ECM 0;
BA_ "GenSigTimeoutTime_RFHM" SG_ 751 TerrainModeInterfaceButton_ECM 0;
BA_ "GenSigTimeoutTime_TCM" SG_ 751 TerrainModeInterfaceButton_ECM 0;
BA_ "GenSigTimeoutTime_ADCAM" SG_ 751 FuelConsumption_GAG 0;
BA_ "GenSigTimeoutTime_EVCU2" SG_ 751 FuelConsumption_GAG 0;
BA_ "GenSigTimeoutTime_VDCM" SG_ 751 FuelConsumption_GAG 0;
BA_ "GenSigTimeoutTime_ADCAM" SG_ 751 GearShiftIndication 0;
BA_ "GenSigTimeoutTime_EVCU2" SG_ 751 GearShiftIndication 0;
BA_ "GenSigTimeoutTime_VDCM" SG_ 751 GearShiftIndication 0;
BA_ "GenSigTimeoutTime_IPC" SG_ 751 GearShiftIndication 0;
BA_ "GenSigTimeoutTime_ADCAM" SG_ 751 StartProtectionInhibit 0;
BA_ "GenSigTimeoutTime_EVCU2" SG_ 751 StartProtectionInhibit 0;
BA_ "GenSigTimeoutTime_VDCM" SG_ 751 StartProtectionInhibit 0;
BA_ "GenSigTimeoutTime_ADCAM" SG_ 751 StartRelayBCMFeedbackFault 0;
BA_ "GenSigTimeoutTime_EVCU2" SG_ 751 StartRelayBCMFeedbackFault 0;
BA_ "GenSigTimeoutTime_VDCM" SG_ 751 StartRelayBCMFeedbackFault 0;
BA_ "GenSigTimeoutTime_ADCAM" SG_ 751 StartRelayECMFeedbackFault 0;
BA_ "GenSigTimeoutTime_EVCU2" SG_ 751 StartRelayECMFeedbackFault 0;
BA_ "GenSigTimeoutTime_VDCM" SG_ 751 StartRelayECMFeedbackFault 0;
BA_ "GenSigTimeoutTime_ADCAM" SG_ 751 Selector_SystemFailSts 0;
BA_ "GenSigTimeoutTime_EVCU2" SG_ 751 Selector_SystemFailSts 0;
BA_ "GenSigTimeoutTime_VDCM" SG_ 751 Selector_SystemFailSts 0;
BA_ "GenSigTimeoutTime_ADCAM" SG_ 751 EngineWaterTemp 0;
BA_ "GenSigTimeoutTime_EVCU2" SG_ 751 EngineWaterTemp 0;
BA_ "GenSigTimeoutTime_VDCM" SG_ 751 EngineWaterTemp 0;
BA_ "GenSigTimeoutTime_BSM" SG_ 751 EngineWaterTemp 0;
BA_ "GenSigTimeoutTime_DTCM" SG_ 751 EngineWaterTemp 0;
BA_ "GenSigTimeoutTime_TCM" SG_ 751 EngineWaterTemp 0;
BA_ "GenSigTimeoutTime_EVCU2" SG_ 751 MessageCounter_ENGINE6 0;
BA_ "GenSigTimeoutTime_VDCM" SG_ 751 MessageCounter_ENGINE6 0;
BA_ "GenSigTimeoutTime_BCM" SG_ 751 MessageCounter_ENGINE6 0;
BA_ "GenSigTimeoutTime_TCM" SG_ 751 MessageCounter_ENGINE6 0;
BA_ "GenSigTimeoutTime_ADCAM" SG_ 751 SAMInfo 0;
BA_ "GenSigTimeoutTime_EVCU2" SG_ 751 SAMInfo 0;
BA_ "GenSigTimeoutTime_VDCM" SG_ 751 SAMInfo 0;
BA_ "GenSigTimeoutTime_ADCAM" SG_ 751 StarterProtectionTime 0;
BA_ "GenSigTimeoutTime_EVCU2" SG_ 751 StarterProtectionTime 0;
BA_ "GenSigTimeoutTime_VDCM" SG_ 751 StarterProtectionTime 0;
BA_ "GenSigTimeoutTime_ADCAM" SG_ 751 Terrain_HMI_Rq_ECM 0;
BA_ "GenSigTimeoutTime_EVCU2" SG_ 751 Terrain_HMI_Rq_ECM 0;
BA_ "GenSigTimeoutTime_VDCM" SG_ 751 Terrain_HMI_Rq_ECM 0;
BA_ "GenSigTimeoutTime_BCM" SG_ 751 Terrain_HMI_Rq_ECM 0;
BA_ "GenSigTimeoutTime_ADCAM" SG_ 751 TerrainModeDesiredStat 0;
BA_ "GenSigTimeoutTime_EVCU2" SG_ 751 TerrainModeDesiredStat 0;
BA_ "GenSigTimeoutTime_VDCM" SG_ 751 TerrainModeDesiredStat 0;
BA_ "GenSigTimeoutTime_RFHM" SG_ 751 TerrainModeDesiredStat 0;
BA_ "GenSigTimeoutTime_EVCU2" SG_ 751 TerrainModeStat_ECM 0;
BA_ "GenSigTimeoutTime_VDCM" SG_ 751 TerrainModeStat_ECM 0;
BA_ "GenSigTimeoutTime_TCM" SG_ 751 TerrainModeStat_ECM 0;
BA_ "GenSigTimeoutTime_ADCAM" SG_ 751 DrvAway_Alert 0;
BA_ "GenSigTimeoutTime_EVCU2" SG_ 751 DrvAway_Alert 0;
BA_ "GenSigTimeoutTime_VDCM" SG_ 751 DrvAway_Alert 0;
BA_ "GenSigTimeoutTime_ADCAM" SG_ 751 DrvAway_Indications 0;
BA_ "GenSigTimeoutTime_EVCU2" SG_ 751 DrvAway_Indications 0;
BA_ "GenSigTimeoutTime_VDCM" SG_ 751 DrvAway_Indications 0;
BA_ "GenSigTimeoutTime_ADCAM" SG_ 751 DrvAway_Inhibit 0;
BA_ "GenSigTimeoutTime_EVCU2" SG_ 751 DrvAway_Inhibit 0;
BA_ "GenSigTimeoutTime_VDCM" SG_ 751 DrvAway_Inhibit 0;
BA_ "GenSigTimeoutTime_EVCU2" SG_ 751 CRC_ENGINE6 0;
BA_ "GenSigTimeoutTime_VDCM" SG_ 751 CRC_ENGINE6 0;
BA_ "GenSigTimeoutTime_BCM" SG_ 751 CRC_ENGINE6 0;
BA_ "GenSigTimeoutTime_TCM" SG_ 751 CRC_ENGINE6 0;
BA_ "GenSigTimeoutTime_ADCAM" SG_ 751 Trns_DrvMd_CfgSts_ECM 0;
BA_ "GenSigTimeoutTime_EVCU2" SG_ 751 Trns_DrvMd_CfgSts_ECM 0;
BA_ "GenSigTimeoutTime_VDCM" SG_ 751 Trns_DrvMd_CfgSts_ECM 0;
BA_ "GenSigTimeoutTime_AGSM" SG_ 751 FuelConsumption_GAG 0;
BA_ "GenSigTimeoutTime_ASBS" SG_ 751 FuelConsumption_GAG 0;
BA_ "GenSigTimeoutTime_BCM" SG_ 751 FuelConsumption_GAG 0;
BA_ "GenSigTimeoutTime_BSM" SG_ 751 FuelConsumption_GAG 0;
BA_ "GenSigTimeoutTime_CADM" SG_ 751 FuelConsumption_GAG 0;
BA_ "GenSigTimeoutTime_DMSM" SG_ 751 FuelConsumption_GAG 0;
BA_ "GenSigTimeoutTime_DTCM" SG_ 751 FuelConsumption_GAG 0;
BA_ "GenSigTimeoutTime_ECM" SG_ 751 FuelConsumption_GAG 0;
BA_ "GenSigTimeoutTime_ELSDM" SG_ 751 FuelConsumption_GAG 0;
BA_ "GenSigTimeoutTime_ESL" SG_ 751 FuelConsumption_GAG 0;
BA_ "GenSigTimeoutTime_GNMM" SG_ 751 FuelConsumption_GAG 0;
BA_ "GenSigTimeoutTime_IPC" SG_ 751 FuelConsumption_GAG 0;
BA_ "GenSigTimeoutTime_RFHM" SG_ 751 FuelConsumption_GAG 0;
BA_ "GenSigTimeoutTime_TCM" SG_ 751 FuelConsumption_GAG 0;
BA_ "GenSigTimeoutTime_AGSM" SG_ 751 GearShiftIndication 0;
BA_ "GenSigTimeoutTime_ASBS" SG_ 751 GearShiftIndication 0;
BA_ "GenSigTimeoutTime_BCM" SG_ 751 GearShiftIndication 0;
BA_ "GenSigTimeoutTime_BSM" SG_ 751 GearShiftIndication 0;
BA_ "GenSigTimeoutTime_CADM" SG_ 751 GearShiftIndication 0;
BA_ "GenSigTimeoutTime_DMSM" SG_ 751 GearShiftIndication 0;
BA_ "GenSigTimeoutTime_DTCM" SG_ 751 GearShiftIndication 0;
BA_ "GenSigTimeoutTime_ECM" SG_ 751 GearShiftIndication 0;
BA_ "GenSigTimeoutTime_ELSDM" SG_ 751 GearShiftIndication 0;
BA_ "GenSigTimeoutTime_ESL" SG_ 751 GearShiftIndication 0;
BA_ "GenSigTimeoutTime_GNMM" SG_ 751 GearShiftIndication 0;
BA_ "GenSigTimeoutTime_HCP" SG_ 751 GearShiftIndication 0;
BA_ "GenSigTimeoutTime_RFHM" SG_ 751 GearShiftIndication 0;
BA_ "GenSigTimeoutTime_TCM" SG_ 751 GearShiftIndication 0;
BA_ "GenSigTimeoutTime_AGSM" SG_ 751 StartProtectionInhibit 0;
BA_ "GenSigTimeoutTime_ASBS" SG_ 751 StartProtectionInhibit 0;
BA_ "GenSigTimeoutTime_BCM" SG_ 751 StartProtectionInhibit 0;
BA_ "GenSigTimeoutTime_BSM" SG_ 751 StartProtectionInhibit 0;
BA_ "GenSigTimeoutTime_CADM" SG_ 751 StartProtectionInhibit 0;
BA_ "GenSigTimeoutTime_DMSM" SG_ 751 StartProtectionInhibit 0;
BA_ "GenSigTimeoutTime_DTCM" SG_ 751 StartProtectionInhibit 0;
BA_ "GenSigTimeoutTime_ECM" SG_ 751 StartProtectionInhibit 0;
BA_ "GenSigTimeoutTime_ELSDM" SG_ 751 StartProtectionInhibit 0;
BA_ "GenSigTimeoutTime_ESL" SG_ 751 StartProtectionInhibit 0;
BA_ "GenSigTimeoutTime_GNMM" SG_ 751 StartProtectionInhibit 0;
BA_ "GenSigTimeoutTime_HCP" SG_ 751 StartProtectionInhibit 0;
BA_ "GenSigTimeoutTime_RFHM" SG_ 751 StartProtectionInhibit 0;
BA_ "GenSigTimeoutTime_SGW" SG_ 751 StartProtectionInhibit 0;
BA_ "GenSigTimeoutTime_TCM" SG_ 751 StartProtectionInhibit 0;
BA_ "GenSigTimeoutTime_AGSM" SG_ 751 StartRelayBCMFeedbackFault 0;
BA_ "GenSigTimeoutTime_ASBS" SG_ 751 StartRelayBCMFeedbackFault 0;
BA_ "GenSigTimeoutTime_BSM" SG_ 751 StartRelayBCMFeedbackFault 0;
BA_ "GenSigTimeoutTime_CADM" SG_ 751 StartRelayBCMFeedbackFault 0;
BA_ "GenSigTimeoutTime_DMSM" SG_ 751 StartRelayBCMFeedbackFault 0;
BA_ "GenSigTimeoutTime_DTCM" SG_ 751 StartRelayBCMFeedbackFault 0;
BA_ "GenSigTimeoutTime_ECM" SG_ 751 StartRelayBCMFeedbackFault 0;
BA_ "GenSigTimeoutTime_ELSDM" SG_ 751 StartRelayBCMFeedbackFault 0;
BA_ "GenSigTimeoutTime_ESL" SG_ 751 StartRelayBCMFeedbackFault 0;
BA_ "GenSigTimeoutTime_GNMM" SG_ 751 StartRelayBCMFeedbackFault 0;
BA_ "GenSigTimeoutTime_HCP" SG_ 751 StartRelayBCMFeedbackFault 0;
BA_ "GenSigTimeoutTime_IPC" SG_ 751 StartRelayBCMFeedbackFault 0;
BA_ "GenSigTimeoutTime_RFHM" SG_ 751 StartRelayBCMFeedbackFault 0;
BA_ "GenSigTimeoutTime_SGW" SG_ 751 StartRelayBCMFeedbackFault 0;
BA_ "GenSigTimeoutTime_TCM" SG_ 751 StartRelayBCMFeedbackFault 0;
BA_ "GenSigTimeoutTime_AGSM" SG_ 751 StartRelayECMFeedbackFault 0;
BA_ "GenSigTimeoutTime_ASBS" SG_ 751 StartRelayECMFeedbackFault 0;
BA_ "GenSigTimeoutTime_BSM" SG_ 751 StartRelayECMFeedbackFault 0;
BA_ "GenSigTimeoutTime_CADM" SG_ 751 StartRelayECMFeedbackFault 0;
BA_ "GenSigTimeoutTime_DMSM" SG_ 751 StartRelayECMFeedbackFault 0;
BA_ "GenSigTimeoutTime_DTCM" SG_ 751 StartRelayECMFeedbackFault 0;
BA_ "GenSigTimeoutTime_ECM" SG_ 751 StartRelayECMFeedbackFault 0;
BA_ "GenSigTimeoutTime_ELSDM" SG_ 751 StartRelayECMFeedbackFault 0;
BA_ "GenSigTimeoutTime_ESL" SG_ 751 StartRelayECMFeedbackFault 0;
BA_ "GenSigTimeoutTime_GNMM" SG_ 751 StartRelayECMFeedbackFault 0;
BA_ "GenSigTimeoutTime_HCP" SG_ 751 StartRelayECMFeedbackFault 0;
BA_ "GenSigTimeoutTime_IPC" SG_ 751 StartRelayECMFeedbackFault 0;
BA_ "GenSigTimeoutTime_RFHM" SG_ 751 StartRelayECMFeedbackFault 0;
BA_ "GenSigTimeoutTime_TCM" SG_ 751 StartRelayECMFeedbackFault 0;
BA_ "GenSigTimeoutTime_AGSM" SG_ 751 Selector_SystemFailSts 0;
BA_ "GenSigTimeoutTime_ASBS" SG_ 751 Selector_SystemFailSts 0;
BA_ "GenSigTimeoutTime_BCM" SG_ 751 Selector_SystemFailSts 0;
BA_ "GenSigTimeoutTime_BSM" SG_ 751 Selector_SystemFailSts 0;
BA_ "GenSigTimeoutTime_CADM" SG_ 751 Selector_SystemFailSts 0;
BA_ "GenSigTimeoutTime_DMSM" SG_ 751 Selector_SystemFailSts 0;
BA_ "GenSigTimeoutTime_DTCM" SG_ 751 Selector_SystemFailSts 0;
BA_ "GenSigTimeoutTime_ECM" SG_ 751 Selector_SystemFailSts 0;
BA_ "GenSigTimeoutTime_ELSDM" SG_ 751 Selector_SystemFailSts 0;
BA_ "GenSigTimeoutTime_ESL" SG_ 751 Selector_SystemFailSts 0;
BA_ "GenSigTimeoutTime_GNMM" SG_ 751 Selector_SystemFailSts 0;
BA_ "GenSigTimeoutTime_HCP" SG_ 751 Selector_SystemFailSts 0;
BA_ "GenSigTimeoutTime_IPC" SG_ 751 Selector_SystemFailSts 0;
BA_ "GenSigTimeoutTime_RFHM" SG_ 751 Selector_SystemFailSts 0;
BA_ "GenSigTimeoutTime_SGW" SG_ 751 Selector_SystemFailSts 0;
BA_ "GenSigTimeoutTime_TCM" SG_ 751 Selector_SystemFailSts 0;
BA_ "GenSigTimeoutTime_AGSM" SG_ 751 EngineWaterTemp 0;
BA_ "GenSigTimeoutTime_ASBS" SG_ 751 EngineWaterTemp 0;
BA_ "GenSigTimeoutTime_CADM" SG_ 751 EngineWaterTemp 0;
BA_ "GenSigTimeoutTime_DMSM" SG_ 751 EngineWaterTemp 0;
BA_ "GenSigTimeoutTime_ECM" SG_ 751 EngineWaterTemp 0;
BA_ "GenSigTimeoutTime_ELSDM" SG_ 751 EngineWaterTemp 0;
BA_ "GenSigTimeoutTime_ESL" SG_ 751 EngineWaterTemp 0;
BA_ "GenSigTimeoutTime_GNMM" SG_ 751 EngineWaterTemp 0;
BA_ "GenSigTimeoutTime_RFHM" SG_ 751 EngineWaterTemp 0;
BA_ "GenSigTimeoutTime_AGSM" SG_ 751 MessageCounter_ENGINE6 0;
BA_ "GenSigTimeoutTime_ASBS" SG_ 751 MessageCounter_ENGINE6 0;
BA_ "GenSigTimeoutTime_DMSM" SG_ 751 MessageCounter_ENGINE6 0;
BA_ "GenSigTimeoutTime_ECM" SG_ 751 MessageCounter_ENGINE6 0;
BA_ "GenSigTimeoutTime_ELSDM" SG_ 751 MessageCounter_ENGINE6 0;
BA_ "GenSigTimeoutTime_ESL" SG_ 751 MessageCounter_ENGINE6 0;
BA_ "GenSigTimeoutTime_GNMM" SG_ 751 MessageCounter_ENGINE6 0;
BA_ "GenSigTimeoutTime_HCP" SG_ 751 MessageCounter_ENGINE6 0;
BA_ "GenSigTimeoutTime_RFHM" SG_ 751 MessageCounter_ENGINE6 0;
BA_ "GenSigTimeoutTime_SGW" SG_ 751 MessageCounter_ENGINE6 0;
BA_ "GenSigStartValue" SG_ 751 SAMInfo 15;
BA_ "GenSigTimeoutTime_AGSM" SG_ 751 SAMInfo 0;
BA_ "GenSigTimeoutTime_ASBS" SG_ 751 SAMInfo 0;
BA_ "GenSigTimeoutTime_BSM" SG_ 751 SAMInfo 0;
BA_ "GenSigTimeoutTime_CADM" SG_ 751 SAMInfo 0;
BA_ "GenSigTimeoutTime_DMSM" SG_ 751 SAMInfo 0;
BA_ "GenSigTimeoutTime_DTCM" SG_ 751 SAMInfo 0;
BA_ "GenSigTimeoutTime_ECM" SG_ 751 SAMInfo 0;
BA_ "GenSigTimeoutTime_ELSDM" SG_ 751 SAMInfo 0;
BA_ "GenSigTimeoutTime_ESL" SG_ 751 SAMInfo 0;
BA_ "GenSigTimeoutTime_GNMM" SG_ 751 SAMInfo 0;
BA_ "GenSigTimeoutTime_HCP" SG_ 751 SAMInfo 0;
BA_ "GenSigTimeoutTime_IPC" SG_ 751 SAMInfo 0;
BA_ "GenSigTimeoutTime_RFHM" SG_ 751 SAMInfo 0;
BA_ "GenSigTimeoutTime_SGW" SG_ 751 SAMInfo 0;
BA_ "GenSigTimeoutTime_TCM" SG_ 751 SAMInfo 0;
BA_ "GenSigTimeoutTime_AGSM" SG_ 751 StarterProtectionTime 0;
BA_ "GenSigTimeoutTime_ASBS" SG_ 751 StarterProtectionTime 0;
BA_ "GenSigTimeoutTime_BCM" SG_ 751 StarterProtectionTime 0;
BA_ "GenSigTimeoutTime_BSM" SG_ 751 StarterProtectionTime 0;
BA_ "GenSigTimeoutTime_CADM" SG_ 751 StarterProtectionTime 0;
BA_ "GenSigTimeoutTime_DMSM" SG_ 751 StarterProtectionTime 0;
BA_ "GenSigTimeoutTime_DTCM" SG_ 751 StarterProtectionTime 0;
BA_ "GenSigTimeoutTime_ECM" SG_ 751 StarterProtectionTime 0;
BA_ "GenSigTimeoutTime_ELSDM" SG_ 751 StarterProtectionTime 0;
BA_ "GenSigTimeoutTime_ESL" SG_ 751 StarterProtectionTime 0;
BA_ "GenSigTimeoutTime_GNMM" SG_ 751 StarterProtectionTime 0;
BA_ "GenSigTimeoutTime_HCP" SG_ 751 StarterProtectionTime 0;
BA_ "GenSigTimeoutTime_RFHM" SG_ 751 StarterProtectionTime 0;
BA_ "GenSigTimeoutTime_SGW" SG_ 751 StarterProtectionTime 0;
BA_ "GenSigTimeoutTime_TCM" SG_ 751 StarterProtectionTime 0;
BA_ "GenSigSendType" SG_ 751 Terrain_HMI_Rq_ECM 3;
BA_ "GenSigTimeoutTime_AGSM" SG_ 751 Terrain_HMI_Rq_ECM 0;
BA_ "GenSigTimeoutTime_ASBS" SG_ 751 Terrain_HMI_Rq_ECM 0;
BA_ "GenSigTimeoutTime_BSM" SG_ 751 Terrain_HMI_Rq_ECM 0;
BA_ "GenSigTimeoutTime_CADM" SG_ 751 Terrain_HMI_Rq_ECM 0;
BA_ "GenSigTimeoutTime_DMSM" SG_ 751 Terrain_HMI_Rq_ECM 0;
BA_ "GenSigTimeoutTime_DTCM" SG_ 751 Terrain_HMI_Rq_ECM 0;
BA_ "GenSigTimeoutTime_ECM" SG_ 751 Terrain_HMI_Rq_ECM 0;
BA_ "GenSigTimeoutTime_ELSDM" SG_ 751 Terrain_HMI_Rq_ECM 0;
BA_ "GenSigTimeoutTime_ESL" SG_ 751 Terrain_HMI_Rq_ECM 0;
BA_ "GenSigTimeoutTime_GNMM" SG_ 751 Terrain_HMI_Rq_ECM 0;
BA_ "GenSigTimeoutTime_HCP" SG_ 751 Terrain_HMI_Rq_ECM 0;
BA_ "GenSigTimeoutTime_RFHM" SG_ 751 Terrain_HMI_Rq_ECM 0;
BA_ "GenSigTimeoutTime_SGW" SG_ 751 Terrain_HMI_Rq_ECM 0;
BA_ "GenSigTimeoutTime_TCM" SG_ 751 Terrain_HMI_Rq_ECM 0;
BA_ "GenSigSendType" SG_ 751 TerrainModeDesiredStat 3;
BA_ "GenSigTimeoutTime_AGSM" SG_ 751 TerrainModeDesiredStat 0;
BA_ "GenSigTimeoutTime_ASBS" SG_ 751 TerrainModeDesiredStat 0;
BA_ "GenSigTimeoutTime_BSM" SG_ 751 TerrainModeDesiredStat 0;
BA_ "GenSigTimeoutTime_CADM" SG_ 751 TerrainModeDesiredStat 0;
BA_ "GenSigTimeoutTime_DMSM" SG_ 751 TerrainModeDesiredStat 0;
BA_ "GenSigTimeoutTime_DTCM" SG_ 751 TerrainModeDesiredStat 0;
BA_ "GenSigTimeoutTime_ECM" SG_ 751 TerrainModeDesiredStat 0;
BA_ "GenSigTimeoutTime_ELSDM" SG_ 751 TerrainModeDesiredStat 0;
BA_ "GenSigTimeoutTime_ESL" SG_ 751 TerrainModeDesiredStat 0;
BA_ "GenSigTimeoutTime_GNMM" SG_ 751 TerrainModeDesiredStat 0;
BA_ "GenSigTimeoutTime_HCP" SG_ 751 TerrainModeDesiredStat 0;
BA_ "GenSigTimeoutTime_IPC" SG_ 751 TerrainModeDesiredStat 0;
BA_ "GenSigTimeoutTime_SGW" SG_ 751 TerrainModeDesiredStat 0;
BA_ "GenSigTimeoutTime_TCM" SG_ 751 TerrainModeDesiredStat 0;
BA_ "GenSigStartValue" SG_ 751 TerrainModeStat_ECM 31;
BA_ "GenSigTimeoutTime_AGSM" SG_ 751 TerrainModeStat_ECM 0;
BA_ "GenSigTimeoutTime_ASBS" SG_ 751 TerrainModeStat_ECM 0;
BA_ "GenSigTimeoutTime_DMSM" SG_ 751 TerrainModeStat_ECM 0;
BA_ "GenSigTimeoutTime_ECM" SG_ 751 TerrainModeStat_ECM 0;
BA_ "GenSigTimeoutTime_ELSDM" SG_ 751 TerrainModeStat_ECM 0;
BA_ "GenSigTimeoutTime_ESL" SG_ 751 TerrainModeStat_ECM 0;
BA_ "GenSigTimeoutTime_GNMM" SG_ 751 TerrainModeStat_ECM 0;
BA_ "GenSigTimeoutTime_RFHM" SG_ 751 TerrainModeStat_ECM 0;
BA_ "GenSigTimeoutTime_AGSM" SG_ 751 DrvAway_Alert 0;
BA_ "GenSigTimeoutTime_ASBS" SG_ 751 DrvAway_Alert 0;
BA_ "GenSigTimeoutTime_BSM" SG_ 751 DrvAway_Alert 0;
BA_ "GenSigTimeoutTime_CADM" SG_ 751 DrvAway_Alert 0;
BA_ "GenSigTimeoutTime_DMSM" SG_ 751 DrvAway_Alert 0;
BA_ "GenSigTimeoutTime_DTCM" SG_ 751 DrvAway_Alert 0;
BA_ "GenSigTimeoutTime_ECM" SG_ 751 DrvAway_Alert 0;
BA_ "GenSigTimeoutTime_ELSDM" SG_ 751 DrvAway_Alert 0;
BA_ "GenSigTimeoutTime_ESL" SG_ 751 DrvAway_Alert 0;
BA_ "GenSigTimeoutTime_GNMM" SG_ 751 DrvAway_Alert 0;
BA_ "GenSigTimeoutTime_HCP" SG_ 751 DrvAway_Alert 0;
BA_ "GenSigTimeoutTime_RFHM" SG_ 751 DrvAway_Alert 0;
BA_ "GenSigTimeoutTime_SGW" SG_ 751 DrvAway_Alert 0;
BA_ "GenSigTimeoutTime_TCM" SG_ 751 DrvAway_Alert 0;
BA_ "GenSigSendType" SG_ 751 DrvAway_Indications 3;
BA_ "GenSigTimeoutTime_AGSM" SG_ 751 DrvAway_Indications 0;
BA_ "GenSigTimeoutTime_ASBS" SG_ 751 DrvAway_Indications 0;
BA_ "GenSigTimeoutTime_BCM" SG_ 751 DrvAway_Indications 0;
BA_ "GenSigTimeoutTime_BSM" SG_ 751 DrvAway_Indications 0;
BA_ "GenSigTimeoutTime_CADM" SG_ 751 DrvAway_Indications 0;
BA_ "GenSigTimeoutTime_DMSM" SG_ 751 DrvAway_Indications 0;
BA_ "GenSigTimeoutTime_DTCM" SG_ 751 DrvAway_Indications 0;
BA_ "GenSigTimeoutTime_ECM" SG_ 751 DrvAway_Indications 0;
BA_ "GenSigTimeoutTime_ELSDM" SG_ 751 DrvAway_Indications 0;
BA_ "GenSigTimeoutTime_ESL" SG_ 751 DrvAway_Indications 0;
BA_ "GenSigTimeoutTime_GNMM" SG_ 751 DrvAway_Indications 0;
BA_ "GenSigTimeoutTime_HCP" SG_ 751 DrvAway_Indications 0;
BA_ "GenSigTimeoutTime_RFHM" SG_ 751 DrvAway_Indications 0;
BA_ "GenSigTimeoutTime_SGW" SG_ 751 DrvAway_Indications 0;
BA_ "GenSigTimeoutTime_TCM" SG_ 751 DrvAway_Indications 0;
BA_ "GenSigTimeoutTime_AGSM" SG_ 751 DrvAway_Inhibit 0;
BA_ "GenSigTimeoutTime_ASBS" SG_ 751 DrvAway_Inhibit 0;
BA_ "GenSigTimeoutTime_BCM" SG_ 751 DrvAway_Inhibit 0;
BA_ "GenSigTimeoutTime_BSM" SG_ 751 DrvAway_Inhibit 0;
BA_ "GenSigTimeoutTime_CADM" SG_ 751 DrvAway_Inhibit 0;
BA_ "GenSigTimeoutTime_DMSM" SG_ 751 DrvAway_Inhibit 0;
BA_ "GenSigTimeoutTime_DTCM" SG_ 751 DrvAway_Inhibit 0;
BA_ "GenSigTimeoutTime_ECM" SG_ 751 DrvAway_Inhibit 0;
BA_ "GenSigTimeoutTime_ELSDM" SG_ 751 DrvAway_Inhibit 0;
BA_ "GenSigTimeoutTime_ESL" SG_ 751 DrvAway_Inhibit 0;
BA_ "GenSigTimeoutTime_GNMM" SG_ 751 DrvAway_Inhibit 0;
BA_ "GenSigTimeoutTime_HCP" SG_ 751 DrvAway_Inhibit 0;
BA_ "GenSigTimeoutTime_RFHM" SG_ 751 DrvAway_Inhibit 0;
BA_ "GenSigTimeoutTime_SGW" SG_ 751 DrvAway_Inhibit 0;
BA_ "GenSigTimeoutTime_TCM" SG_ 751 DrvAway_Inhibit 0;
BA_ "GenSigTimeoutTime_AGSM" SG_ 751 LeakCheckTimerValue 0;
BA_ "GenSigTimeoutTime_ASBS" SG_ 751 LeakCheckTimerValue 0;
BA_ "GenSigTimeoutTime_BSM" SG_ 751 LeakCheckTimerValue 0;
BA_ "GenSigTimeoutTime_CADM" SG_ 751 LeakCheckTimerValue 0;
BA_ "GenSigTimeoutTime_DMSM" SG_ 751 LeakCheckTimerValue 0;
BA_ "GenSigTimeoutTime_DTCM" SG_ 751 LeakCheckTimerValue 0;
BA_ "GenSigTimeoutTime_ECM" SG_ 751 LeakCheckTimerValue 0;
BA_ "GenSigTimeoutTime_ELSDM" SG_ 751 LeakCheckTimerValue 0;
BA_ "GenSigTimeoutTime_ESL" SG_ 751 LeakCheckTimerValue 0;
BA_ "GenSigTimeoutTime_GNMM" SG_ 751 LeakCheckTimerValue 0;
BA_ "GenSigTimeoutTime_HCP" SG_ 751 LeakCheckTimerValue 0;
BA_ "GenSigTimeoutTime_IPC" SG_ 751 LeakCheckTimerValue 0;
BA_ "GenSigTimeoutTime_RFHM" SG_ 751 LeakCheckTimerValue 0;
BA_ "GenSigTimeoutTime_SGW" SG_ 751 LeakCheckTimerValue 0;
BA_ "GenSigTimeoutTime_TCM" SG_ 751 LeakCheckTimerValue 0;
BA_ "GenSigTimeoutTime_AGSM" SG_ 751 LeakTestRequest 0;
BA_ "GenSigTimeoutTime_ASBS" SG_ 751 LeakTestRequest 0;
BA_ "GenSigTimeoutTime_BSM" SG_ 751 LeakTestRequest 0;
BA_ "GenSigTimeoutTime_CADM" SG_ 751 LeakTestRequest 0;
BA_ "GenSigTimeoutTime_DMSM" SG_ 751 LeakTestRequest 0;
BA_ "GenSigTimeoutTime_DTCM" SG_ 751 LeakTestRequest 0;
BA_ "GenSigTimeoutTime_ECM" SG_ 751 LeakTestRequest 0;
BA_ "GenSigTimeoutTime_ELSDM" SG_ 751 LeakTestRequest 0;
BA_ "GenSigTimeoutTime_ESL" SG_ 751 LeakTestRequest 0;
BA_ "GenSigTimeoutTime_GNMM" SG_ 751 LeakTestRequest 0;
BA_ "GenSigTimeoutTime_HCP" SG_ 751 LeakTestRequest 0;
BA_ "GenSigTimeoutTime_IPC" SG_ 751 LeakTestRequest 0;
BA_ "GenSigTimeoutTime_RFHM" SG_ 751 LeakTestRequest 0;
BA_ "GenSigTimeoutTime_SGW" SG_ 751 LeakTestRequest 0;
BA_ "GenSigTimeoutTime_TCM" SG_ 751 LeakTestRequest 0;
BA_ "GenSigTimeoutTime_AGSM" SG_ 751 LeakTestSts 0;
BA_ "GenSigTimeoutTime_ASBS" SG_ 751 LeakTestSts 0;
BA_ "GenSigTimeoutTime_BSM" SG_ 751 LeakTestSts 0;
BA_ "GenSigTimeoutTime_CADM" SG_ 751 LeakTestSts 0;
BA_ "GenSigTimeoutTime_DMSM" SG_ 751 LeakTestSts 0;
BA_ "GenSigTimeoutTime_DTCM" SG_ 751 LeakTestSts 0;
BA_ "GenSigTimeoutTime_ECM" SG_ 751 LeakTestSts 0;
BA_ "GenSigTimeoutTime_ELSDM" SG_ 751 LeakTestSts 0;
BA_ "GenSigTimeoutTime_ESL" SG_ 751 LeakTestSts 0;
BA_ "GenSigTimeoutTime_GNMM" SG_ 751 LeakTestSts 0;
BA_ "GenSigTimeoutTime_HCP" SG_ 751 LeakTestSts 0;
BA_ "GenSigTimeoutTime_IPC" SG_ 751 LeakTestSts 0;
BA_ "GenSigTimeoutTime_RFHM" SG_ 751 LeakTestSts 0;
BA_ "GenSigTimeoutTime_SGW" SG_ 751 LeakTestSts 0;
BA_ "GenSigTimeoutTime_TCM" SG_ 751 LeakTestSts 0;
BA_ "GenSigTimeoutTime_AGSM" SG_ 751 CRC_ENGINE6 0;
BA_ "GenSigTimeoutTime_ASBS" SG_ 751 CRC_ENGINE6 0;
BA_ "GenSigTimeoutTime_DMSM" SG_ 751 CRC_ENGINE6 0;
BA_ "GenSigTimeoutTime_ECM" SG_ 751 CRC_ENGINE6 0;
BA_ "GenSigTimeoutTime_ELSDM" SG_ 751 CRC_ENGINE6 0;
BA_ "GenSigTimeoutTime_ESL" SG_ 751 CRC_ENGINE6 0;
BA_ "GenSigTimeoutTime_GNMM" SG_ 751 CRC_ENGINE6 0;
BA_ "GenSigTimeoutTime_HCP" SG_ 751 CRC_ENGINE6 0;
BA_ "GenSigTimeoutTime_RFHM" SG_ 751 CRC_ENGINE6 0;
BA_ "GenSigTimeoutTime_SGW" SG_ 751 CRC_ENGINE6 0;
BA_ "GenSigTimeoutTime_AGSM" SG_ 751 ECM_FOTA_Conflict 0;
BA_ "GenSigTimeoutTime_ASBS" SG_ 751 ECM_FOTA_Conflict 0;
BA_ "GenSigTimeoutTime_BCM" SG_ 751 ECM_FOTA_Conflict 0;
BA_ "GenSigTimeoutTime_BSM" SG_ 751 ECM_FOTA_Conflict 0;
BA_ "GenSigTimeoutTime_CADM" SG_ 751 ECM_FOTA_Conflict 0;
BA_ "GenSigTimeoutTime_DMSM" SG_ 751 ECM_FOTA_Conflict 0;
BA_ "GenSigTimeoutTime_DTCM" SG_ 751 ECM_FOTA_Conflict 0;
BA_ "GenSigTimeoutTime_ECM" SG_ 751 ECM_FOTA_Conflict 0;
BA_ "GenSigTimeoutTime_ELSDM" SG_ 751 ECM_FOTA_Conflict 0;
BA_ "GenSigTimeoutTime_ESL" SG_ 751 ECM_FOTA_Conflict 0;
BA_ "GenSigTimeoutTime_GNMM" SG_ 751 ECM_FOTA_Conflict 0;
BA_ "GenSigTimeoutTime_HCP" SG_ 751 ECM_FOTA_Conflict 0;
BA_ "GenSigTimeoutTime_IPC" SG_ 751 ECM_FOTA_Conflict 0;
BA_ "GenSigTimeoutTime_RFHM" SG_ 751 ECM_FOTA_Conflict 0;
BA_ "GenSigTimeoutTime_TCM" SG_ 751 ECM_FOTA_Conflict 0;
BA_ "GenSigTimeoutTime_AGSM" SG_ 751 Trns_DrvMd_CfgSts_ECM 0;
BA_ "GenSigTimeoutTime_ASBS" SG_ 751 Trns_DrvMd_CfgSts_ECM 0;
BA_ "GenSigTimeoutTime_BCM" SG_ 751 Trns_DrvMd_CfgSts_ECM 0;
BA_ "GenSigTimeoutTime_BSM" SG_ 751 Trns_DrvMd_CfgSts_ECM 0;
BA_ "GenSigTimeoutTime_CADM" SG_ 751 Trns_DrvMd_CfgSts_ECM 0;
BA_ "GenSigTimeoutTime_DMSM" SG_ 751 Trns_DrvMd_CfgSts_ECM 0;
BA_ "GenSigTimeoutTime_DTCM" SG_ 751 Trns_DrvMd_CfgSts_ECM 0;
BA_ "GenSigTimeoutTime_ECM" SG_ 751 Trns_DrvMd_CfgSts_ECM 0;
BA_ "GenSigTimeoutTime_ELSDM" SG_ 751 Trns_DrvMd_CfgSts_ECM 0;
BA_ "GenSigTimeoutTime_ESL" SG_ 751 Trns_DrvMd_CfgSts_ECM 0;
BA_ "GenSigTimeoutTime_GNMM" SG_ 751 Trns_DrvMd_CfgSts_ECM 0;
BA_ "GenSigTimeoutTime_HCP" SG_ 751 Trns_DrvMd_CfgSts_ECM 0;
BA_ "GenSigTimeoutTime_IPC" SG_ 751 Trns_DrvMd_CfgSts_ECM 0;
BA_ "GenSigTimeoutTime_RFHM" SG_ 751 Trns_DrvMd_CfgSts_ECM 0;
BA_ "GenSigTimeoutTime_TCM" SG_ 751 Trns_DrvMd_CfgSts_ECM 0;
BA_ "GenSigTimeoutTime_ADCAM" SG_ 1448 PerfShftRq_HUD 0;
BA_ "GenSigTimeoutTime_EVCU2" SG_ 1448 PerfShftRq_HUD 0;
BA_ "GenSigTimeoutTime_VDCM" SG_ 1448 PerfShftRq_HUD 0;
BA_ "GenSigSendType" SG_ 1448 PerfShftRq_HUD 3;
BA_ "GenSigTimeoutTime_AGSM" SG_ 1448 PerfShftRq_HUD 0;
BA_ "GenSigTimeoutTime_BCM" SG_ 1448 PerfShftRq_HUD 0;
BA_ "GenSigTimeoutTime_BSM" SG_ 1448 PerfShftRq_HUD 0;
BA_ "GenSigTimeoutTime_DTCM" SG_ 1448 PerfShftRq_HUD 0;
BA_ "GenSigTimeoutTime_ECM" SG_ 1448 PerfShftRq_HUD 0;
BA_ "GenSigTimeoutTime_ESL" SG_ 1448 PerfShftRq_HUD 0;
BA_ "GenSigTimeoutTime_RFHM" SG_ 1448 PerfShftRq_HUD 0;
BA_ "GenSigTimeoutTime_SGW" SG_ 1448 PerfShftRq_HUD 0;
BA_ "GenSigTimeoutTime_TCM" SG_ 1448 PerfShftRq_HUD 0;
BA_ "GenSigTimeoutTime_ADCAM" SG_ 1448 ECM_WARN_BTO_1 0;
BA_ "GenSigTimeoutTime_EVCU2" SG_ 1448 ECM_WARN_BTO_1 0;
BA_ "GenSigTimeoutTime_VDCM" SG_ 1448 ECM_WARN_BTO_1 0;
BA_ "GenSigSendType" SG_ 1448 ECM_WARN_BTO_1 3;
BA_ "GenSigTimeoutTime_AGSM" SG_ 1448 ECM_WARN_BTO_1 0;
BA_ "GenSigTimeoutTime_BCM" SG_ 1448 ECM_WARN_BTO_1 0;
BA_ "GenSigTimeoutTime_BSM" SG_ 1448 ECM_WARN_BTO_1 0;
BA_ "GenSigTimeoutTime_DTCM" SG_ 1448 ECM_WARN_BTO_1 0;
BA_ "GenSigTimeoutTime_ECM" SG_ 1448 ECM_WARN_BTO_1 0;
BA_ "GenSigTimeoutTime_ESL" SG_ 1448 ECM_WARN_BTO_1 0;
BA_ "GenSigTimeoutTime_RFHM" SG_ 1448 ECM_WARN_BTO_1 0;
BA_ "GenSigTimeoutTime_SGW" SG_ 1448 ECM_WARN_BTO_1 0;
BA_ "GenSigTimeoutTime_TCM" SG_ 1448 ECM_WARN_BTO_1 0;
BA_ "GenSigTimeoutTime_ADCAM" SG_ 1448 HP_EngPwrMd_RED 0;
BA_ "GenSigTimeoutTime_EVCU2" SG_ 1448 HP_EngPwrMd_RED 0;
BA_ "GenSigTimeoutTime_VDCM" SG_ 1448 HP_EngPwrMd_RED 0;
BA_ "GenSigStartValue" SG_ 1448 HP_EngPwrMd_RED 1022;
BA_ "GenSigTimeoutTime_AGSM" SG_ 1448 HP_EngPwrMd_RED 0;
BA_ "GenSigTimeoutTime_BCM" SG_ 1448 HP_EngPwrMd_RED 0;
BA_ "GenSigTimeoutTime_BSM" SG_ 1448 HP_EngPwrMd_RED 0;
BA_ "GenSigTimeoutTime_DTCM" SG_ 1448 HP_EngPwrMd_RED 0;
BA_ "GenSigTimeoutTime_ECM" SG_ 1448 HP_EngPwrMd_RED 0;
BA_ "GenSigTimeoutTime_ESL" SG_ 1448 HP_EngPwrMd_RED 0;
BA_ "GenSigTimeoutTime_RFHM" SG_ 1448 HP_EngPwrMd_RED 0;
BA_ "GenSigTimeoutTime_TCM" SG_ 1448 HP_EngPwrMd_RED 0;
BA_ "GenSigTimeoutTime_ADCAM" SG_ 1448 OilLifeSts 0;
BA_ "GenSigTimeoutTime_EVCU2" SG_ 1448 OilLifeSts 0;
BA_ "GenSigTimeoutTime_VDCM" SG_ 1448 OilLifeSts 0;
BA_ "GenSigTimeoutTime_ADCAM" SG_ 1448 OilPressureSts 0;
BA_ "GenSigTimeoutTime_EVCU2" SG_ 1448 OilPressureSts 0;
BA_ "GenSigTimeoutTime_VDCM" SG_ 1448 OilPressureSts 0;
BA_ "GenSigTimeoutTime_ADCAM" SG_ 1448 SpStDispstat 0;
BA_ "GenSigTimeoutTime_EVCU2" SG_ 1448 SpStDispstat 0;
BA_ "GenSigTimeoutTime_VDCM" SG_ 1448 SpStDispstat 0;
BA_ "GenSigTimeoutTime_ADCAM" SG_ 1448 SpStSwStat 0;
BA_ "GenSigTimeoutTime_EVCU2" SG_ 1448 SpStSwStat 0;
BA_ "GenSigTimeoutTime_VDCM" SG_ 1448 SpStSwStat 0;
BA_ "GenSigTimeoutTime_ADCAM" SG_ 1448 KNK_MG_TRIGGER 0;
BA_ "GenSigTimeoutTime_EVCU2" SG_ 1448 KNK_MG_TRIGGER 0;
BA_ "GenSigTimeoutTime_VDCM" SG_ 1448 KNK_MG_TRIGGER 0;
BA_ "GenSigTimeoutTime_ADCAM" SG_ 1448 CompressorSts 0;
BA_ "GenSigTimeoutTime_EVCU2" SG_ 1448 CompressorSts 0;
BA_ "GenSigTimeoutTime_VDCM" SG_ 1448 CompressorSts 0;
BA_ "GenSigTimeoutTime_ADCAM" SG_ 1448 SpStIndRq 0;
BA_ "GenSigTimeoutTime_EVCU2" SG_ 1448 SpStIndRq 0;
BA_ "GenSigTimeoutTime_VDCM" SG_ 1448 SpStIndRq 0;
BA_ "GenSigTimeoutTime_ADCAM" SG_ 1448 CRC_ENGINE7 0;
BA_ "GenSigTimeoutTime_EVCU2" SG_ 1448 CRC_ENGINE7 0;
BA_ "GenSigTimeoutTime_VDCM" SG_ 1448 CRC_ENGINE7 0;
BA_ "GenSigTimeoutTime_TCM" SG_ 1448 CRC_ENGINE7 0;
BA_ "GenSigTimeoutTime_ADCAM" SG_ 1448 MessageCounter_ENGINE7 0;
BA_ "GenSigTimeoutTime_EVCU2" SG_ 1448 MessageCounter_ENGINE7 0;
BA_ "GenSigTimeoutTime_VDCM" SG_ 1448 MessageCounter_ENGINE7 0;
BA_ "GenSigTimeoutTime_TCM" SG_ 1448 MessageCounter_ENGINE7 0;
BA_ "GenSigTimeoutTime_ADCAM" SG_ 1448 HoursOilLifeRst 0;
BA_ "GenSigTimeoutTime_EVCU2" SG_ 1448 HoursOilLifeRst 0;
BA_ "GenSigTimeoutTime_VDCM" SG_ 1448 HoursOilLifeRst 0;
BA_ "GenSigTimeoutTime_ADCAM" SG_ 1448 MntncSts 0;
BA_ "GenSigTimeoutTime_EVCU2" SG_ 1448 MntncSts 0;
BA_ "GenSigTimeoutTime_VDCM" SG_ 1448 MntncSts 0;
BA_ "GenSigTimeoutTime_ADCAM" SG_ 1448 ECM_WARN_BTO 0;
BA_ "GenSigTimeoutTime_EVCU2" SG_ 1448 ECM_WARN_BTO 0;
BA_ "GenSigTimeoutTime_VDCM" SG_ 1448 ECM_WARN_BTO 0;
BA_ "GenSigTimeoutTime_ADCAM" SG_ 1448 EMSFailSts 0;
BA_ "GenSigTimeoutTime_EVCU2" SG_ 1448 EMSFailSts 0;
BA_ "GenSigTimeoutTime_VDCM" SG_ 1448 EMSFailSts 0;
BA_ "GenSigTimeoutTime_ADCAM" SG_ 1448 EngineOperatingMode 0;
BA_ "GenSigTimeoutTime_EVCU2" SG_ 1448 EngineOperatingMode 0;
BA_ "GenSigTimeoutTime_VDCM" SG_ 1448 EngineOperatingMode 0;
BA_ "GenSigTimeoutTime_ADCAM" SG_ 1448 ETCFailSts 0;
BA_ "GenSigTimeoutTime_EVCU2" SG_ 1448 ETCFailSts 0;
BA_ "GenSigTimeoutTime_VDCM" SG_ 1448 ETCFailSts 0;
BA_ "GenSigTimeoutTime_ADCAM" SG_ 1448 ExhaustTemperature 0;
BA_ "GenSigTimeoutTime_EVCU2" SG_ 1448 ExhaustTemperature 0;
BA_ "GenSigTimeoutTime_VDCM" SG_ 1448 ExhaustTemperature 0;
BA_ "GenSigSendType" SG_ 1448 OilLifeSts 3;
BA_ "GenSigTimeoutTime_AGSM" SG_ 1448 OilLifeSts 0;
BA_ "GenSigTimeoutTime_ASBS" SG_ 1448 OilLifeSts 0;
BA_ "GenSigTimeoutTime_BCM" SG_ 1448 OilLifeSts 0;
BA_ "GenSigTimeoutTime_BSM" SG_ 1448 OilLifeSts 0;
BA_ "GenSigTimeoutTime_CADM" SG_ 1448 OilLifeSts 0;
BA_ "GenSigTimeoutTime_DMSM" SG_ 1448 OilLifeSts 0;
BA_ "GenSigTimeoutTime_DTCM" SG_ 1448 OilLifeSts 0;
BA_ "GenSigTimeoutTime_ECM" SG_ 1448 OilLifeSts 0;
BA_ "GenSigTimeoutTime_ELSDM" SG_ 1448 OilLifeSts 0;
BA_ "GenSigTimeoutTime_ESL" SG_ 1448 OilLifeSts 0;
BA_ "GenSigTimeoutTime_GNMM" SG_ 1448 OilLifeSts 0;
BA_ "GenSigTimeoutTime_HCP" SG_ 1448 OilLifeSts 0;
BA_ "GenSigTimeoutTime_IPC" SG_ 1448 OilLifeSts 0;
BA_ "GenSigTimeoutTime_RFHM" SG_ 1448 OilLifeSts 0;
BA_ "GenSigTimeoutTime_TCM" SG_ 1448 OilLifeSts 0;
BA_ "GenSigStartValue" SG_ 1448 OilPressureSts 1;
BA_ "GenSigSendType" SG_ 1448 OilPressureSts 3;
BA_ "GenSigTimeoutTime_AGSM" SG_ 1448 OilPressureSts 0;
BA_ "GenSigTimeoutTime_ASBS" SG_ 1448 OilPressureSts 0;
BA_ "GenSigTimeoutTime_BSM" SG_ 1448 OilPressureSts 0;
BA_ "GenSigTimeoutTime_CADM" SG_ 1448 OilPressureSts 0;
BA_ "GenSigTimeoutTime_DMSM" SG_ 1448 OilPressureSts 0;
BA_ "GenSigTimeoutTime_DTCM" SG_ 1448 OilPressureSts 0;
BA_ "GenSigTimeoutTime_ECM" SG_ 1448 OilPressureSts 0;
BA_ "GenSigTimeoutTime_ELSDM" SG_ 1448 OilPressureSts 0;
BA_ "GenSigTimeoutTime_ESL" SG_ 1448 OilPressureSts 0;
BA_ "GenSigTimeoutTime_GNMM" SG_ 1448 OilPressureSts 0;
BA_ "GenSigTimeoutTime_HCP" SG_ 1448 OilPressureSts 0;
BA_ "GenSigTimeoutTime_RFHM" SG_ 1448 OilPressureSts 0;
BA_ "GenSigTimeoutTime_TCM" SG_ 1448 OilPressureSts 0;
BA_ "GenSigSendType" SG_ 1448 SpStDispstat 3;
BA_ "GenSigTimeoutTime_AGSM" SG_ 1448 SpStDispstat 0;
BA_ "GenSigTimeoutTime_ASBS" SG_ 1448 SpStDispstat 0;
BA_ "GenSigTimeoutTime_BSM" SG_ 1448 SpStDispstat 0;
BA_ "GenSigTimeoutTime_CADM" SG_ 1448 SpStDispstat 0;
BA_ "GenSigTimeoutTime_DMSM" SG_ 1448 SpStDispstat 0;
BA_ "GenSigTimeoutTime_DTCM" SG_ 1448 SpStDispstat 0;
BA_ "GenSigTimeoutTime_ECM" SG_ 1448 SpStDispstat 0;
BA_ "GenSigTimeoutTime_ELSDM" SG_ 1448 SpStDispstat 0;
BA_ "GenSigTimeoutTime_ESL" SG_ 1448 SpStDispstat 0;
BA_ "GenSigTimeoutTime_GNMM" SG_ 1448 SpStDispstat 0;
BA_ "GenSigTimeoutTime_HCP" SG_ 1448 SpStDispstat 0;
BA_ "GenSigTimeoutTime_RFHM" SG_ 1448 SpStDispstat 0;
BA_ "GenSigTimeoutTime_TCM" SG_ 1448 SpStDispstat 0;
BA_ "GenSigSendType" SG_ 1448 SpStSwStat 3;
BA_ "GenSigTimeoutTime_AGSM" SG_ 1448 SpStSwStat 0;
BA_ "GenSigTimeoutTime_ASBS" SG_ 1448 SpStSwStat 0;
BA_ "GenSigTimeoutTime_BSM" SG_ 1448 SpStSwStat 0;
BA_ "GenSigTimeoutTime_CADM" SG_ 1448 SpStSwStat 0;
BA_ "GenSigTimeoutTime_DMSM" SG_ 1448 SpStSwStat 0;
BA_ "GenSigTimeoutTime_DTCM" SG_ 1448 SpStSwStat 0;
BA_ "GenSigTimeoutTime_ECM" SG_ 1448 SpStSwStat 0;
BA_ "GenSigTimeoutTime_ELSDM" SG_ 1448 SpStSwStat 0;
BA_ "GenSigTimeoutTime_ESL" SG_ 1448 SpStSwStat 0;
BA_ "GenSigTimeoutTime_GNMM" SG_ 1448 SpStSwStat 0;
BA_ "GenSigTimeoutTime_HCP" SG_ 1448 SpStSwStat 0;
BA_ "GenSigTimeoutTime_IPC" SG_ 1448 SpStSwStat 0;
BA_ "GenSigTimeoutTime_RFHM" SG_ 1448 SpStSwStat 0;
BA_ "GenSigTimeoutTime_TCM" SG_ 1448 SpStSwStat 0;
BA_ "GenSigSendType" SG_ 1448 KNK_MG_TRIGGER 3;
BA_ "GenSigTimeoutTime_AGSM" SG_ 1448 KNK_MG_TRIGGER 0;
BA_ "GenSigTimeoutTime_ASBS" SG_ 1448 KNK_MG_TRIGGER 0;
BA_ "GenSigTimeoutTime_BCM" SG_ 1448 KNK_MG_TRIGGER 0;
BA_ "GenSigTimeoutTime_BSM" SG_ 1448 KNK_MG_TRIGGER 0;
BA_ "GenSigTimeoutTime_CADM" SG_ 1448 KNK_MG_TRIGGER 0;
BA_ "GenSigTimeoutTime_DMSM" SG_ 1448 KNK_MG_TRIGGER 0;
BA_ "GenSigTimeoutTime_DTCM" SG_ 1448 KNK_MG_TRIGGER 0;
BA_ "GenSigTimeoutTime_ECM" SG_ 1448 KNK_MG_TRIGGER 0;
BA_ "GenSigTimeoutTime_ELSDM" SG_ 1448 KNK_MG_TRIGGER 0;
BA_ "GenSigTimeoutTime_ESL" SG_ 1448 KNK_MG_TRIGGER 0;
BA_ "GenSigTimeoutTime_GNMM" SG_ 1448 KNK_MG_TRIGGER 0;
BA_ "GenSigTimeoutTime_HCP" SG_ 1448 KNK_MG_TRIGGER 0;
BA_ "GenSigTimeoutTime_RFHM" SG_ 1448 KNK_MG_TRIGGER 0;
BA_ "GenSigTimeoutTime_SGW" SG_ 1448 KNK_MG_TRIGGER 0;
BA_ "GenSigTimeoutTime_TCM" SG_ 1448 KNK_MG_TRIGGER 0;
BA_ "GenSigStartValue" SG_ 1448 CompressorSts 2;
BA_ "GenSigSendType" SG_ 1448 CompressorSts 3;
BA_ "GenSigTimeoutTime_AGSM" SG_ 1448 CompressorSts 0;
BA_ "GenSigTimeoutTime_ASBS" SG_ 1448 CompressorSts 0;
BA_ "GenSigTimeoutTime_BSM" SG_ 1448 CompressorSts 0;
BA_ "GenSigTimeoutTime_CADM" SG_ 1448 CompressorSts 0;
BA_ "GenSigTimeoutTime_DMSM" SG_ 1448 CompressorSts 0;
BA_ "GenSigTimeoutTime_DTCM" SG_ 1448 CompressorSts 0;
BA_ "GenSigTimeoutTime_ECM" SG_ 1448 CompressorSts 0;
BA_ "GenSigTimeoutTime_ELSDM" SG_ 1448 CompressorSts 0;
BA_ "GenSigTimeoutTime_ESL" SG_ 1448 CompressorSts 0;
BA_ "GenSigTimeoutTime_GNMM" SG_ 1448 CompressorSts 0;
BA_ "GenSigTimeoutTime_HCP" SG_ 1448 CompressorSts 0;
BA_ "GenSigTimeoutTime_IPC" SG_ 1448 CompressorSts 0;
BA_ "GenSigTimeoutTime_RFHM" SG_ 1448 CompressorSts 0;
BA_ "GenSigTimeoutTime_TCM" SG_ 1448 CompressorSts 0;
BA_ "GenSigSendType" SG_ 1448 SpStIndRq 3;
BA_ "GenSigTimeoutTime_AGSM" SG_ 1448 SpStIndRq 0;
BA_ "GenSigTimeoutTime_ASBS" SG_ 1448 SpStIndRq 0;
BA_ "GenSigTimeoutTime_BCM" SG_ 1448 SpStIndRq 0;
BA_ "GenSigTimeoutTime_AGSM" SG_ 514 BrkPdl_Flt 0;
BA_ "GenSigTimeoutTime_ASBS" SG_ 514 BrkPdl_Flt 0;
BA_ "GenSigTimeoutTime_BSM" SG_ 514 BrkPdl_Flt 0;
BA_ "GenSigTimeoutTime_CADM" SG_ 514 BrkPdl_Flt 0;
BA_ "GenSigTimeoutTime_DMSM" SG_ 514 BrkPdl_Flt 0;
BA_ "GenSigTimeoutTime_ELSDM" SG_ 514 BrkPdl_Flt 0;
BA_ "GenSigTimeoutTime_ESL" SG_ 514 BrkPdl_Flt 0;
BA_ "GenSigTimeoutTime_GNMM" SG_ 514 BrkPdl_Flt 0;
BA_ "GenSigTimeoutTime_IPC" SG_ 514 BrkPdl_Flt 0;
BA_ "GenSigTimeoutTime_RFHM" SG_ 514 BrkPdl_Flt 0;
BA_ "GenSigTimeoutTime_TCM" SG_ 514 BrkPdl_Flt 0;
BA_ "GenSigStartValue" SG_ 514 BrkPdl_Stat 3;
BA_ "GenSigTimeoutTime_AGSM" SG_ 514 BrkPdl_Stat 0;
BA_ "GenSigTimeoutTime_ASBS" SG_ 514 BrkPdl_Stat 0;
BA_ "GenSigTimeoutTime_BSM" SG_ 514 BrkPdl_Stat 0;
BA_ "GenSigTimeoutTime_DMSM" SG_ 514 BrkPdl_Stat 0;
BA_ "GenSigTimeoutTime_ELSDM" SG_ 514 BrkPdl_Stat 0;
BA_ "GenSigTimeoutTime_ESL" SG_ 514 BrkPdl_Stat 0;
BA_ "GenSigTimeoutTime_GNMM" SG_ 514 BrkPdl_Stat 0;
BA_ "GenSigTimeoutTime_IPC" SG_ 514 BrkPdl_Stat 0;
BA_ "GenSigTimeoutTime_AGSM" SG_ 514 CRC_BRAKE7 0;
BA_ "GenSigTimeoutTime_ASBS" SG_ 514 CRC_BRAKE7 0;
BA_ "GenSigTimeoutTime_BSM" SG_ 514 CRC_BRAKE7 0;
BA_ "GenSigTimeoutTime_DMSM" SG_ 514 CRC_BRAKE7 0;
BA_ "GenSigTimeoutTime_ESL" SG_ 514 CRC_BRAKE7 0;
BA_ "GenSigTimeoutTime_GNMM" SG_ 514 CRC_BRAKE7 0;
BA_ "GenSigTimeoutTime_IPC" SG_ 514 CRC_BRAKE7 0;
BA_ "GenSigTimeoutTime_RFHM" SG_ 514 CRC_BRAKE7 0;
BA_ "GenSigTimeoutTime_SGW" SG_ 514 CRC_BRAKE7 0;
BA_ "GenSigTimeoutTime_AGSM" SG_ 514 MessageCounter_BRAKE7 0;
BA_ "GenSigTimeoutTime_ASBS" SG_ 514 MessageCounter_BRAKE7 0;
BA_ "GenSigTimeoutTime_BSM" SG_ 514 MessageCounter_BRAKE7 0;
BA_ "GenSigTimeoutTime_DMSM" SG_ 514 MessageCounter_BRAKE7 0;
BA_ "GenSigTimeoutTime_ESL" SG_ 514 MessageCounter_BRAKE7 0;
BA_ "GenSigTimeoutTime_GNMM" SG_ 514 MessageCounter_BRAKE7 0;
BA_ "GenSigTimeoutTime_IPC" SG_ 514 MessageCounter_BRAKE7 0;
BA_ "GenSigTimeoutTime_RFHM" SG_ 514 MessageCounter_BRAKE7 0;
BA_ "GenSigTimeoutTime_SGW" SG_ 514 MessageCounter_BRAKE7 0;
BA_ "GenSigTimeoutTime_AGSM" SG_ 514 BSM_ReadyForESS 0;
BA_ "GenSigTimeoutTime_ASBS" SG_ 514 BSM_ReadyForESS 0;
BA_ "GenSigTimeoutTime_BSM" SG_ 514 BSM_ReadyForESS 0;
BA_ "GenSigTimeoutTime_CADM" SG_ 514 BSM_ReadyForESS 0;
BA_ "GenSigTimeoutTime_DMSM" SG_ 514 BSM_ReadyForESS 0;
BA_ "GenSigTimeoutTime_DTCM" SG_ 514 BSM_ReadyForESS 0;
BA_ "GenSigTimeoutTime_ELSDM" SG_ 514 BSM_ReadyForESS 0;
BA_ "GenSigTimeoutTime_ESL" SG_ 514 BSM_ReadyForESS 0;
BA_ "GenSigTimeoutTime_GNMM" SG_ 514 BSM_ReadyForESS 0;
BA_ "GenSigTimeoutTime_HCP" SG_ 514 BSM_ReadyForESS 0;
BA_ "GenSigTimeoutTime_IPC" SG_ 514 BSM_ReadyForESS 0;
BA_ "GenSigTimeoutTime_RFHM" SG_ 514 BSM_ReadyForESS 0;
BA_ "GenSigTimeoutTime_SGW" SG_ 514 BSM_ReadyForESS 0;
BA_ "GenSigTimeoutTime_TCM" SG_ 514 BSM_ReadyForESS 0;
BA_ "GenSigTimeoutTime_AGSM" SG_ 514 AutoVehHoldSts 0;
BA_ "GenSigTimeoutTime_ASBS" SG_ 514 AutoVehHoldSts 0;
BA_ "GenSigTimeoutTime_BSM" SG_ 514 AutoVehHoldSts 0;
BA_ "GenSigTimeoutTime_CADM" SG_ 514 AutoVehHoldSts 0;
BA_ "GenSigTimeoutTime_DMSM" SG_ 514 AutoVehHoldSts 0;
BA_ "GenSigTimeoutTime_DTCM" SG_ 514 AutoVehHoldSts 0;
BA_ "GenSigTimeoutTime_ELSDM" SG_ 514 AutoVehHoldSts 0;
BA_ "GenSigTimeoutTime_ESL" SG_ 514 AutoVehHoldSts 0;
BA_ "GenSigTimeoutTime_GNMM" SG_ 514 AutoVehHoldSts 0;
BA_ "GenSigTimeoutTime_HCP" SG_ 514 AutoVehHoldSts 0;
BA_ "GenSigTimeoutTime_RFHM" SG_ 514 AutoVehHoldSts 0;
BA_ "GenSigTimeoutTime_AGSM" SG_ 514 BrakePdlPosn 0;
BA_ "GenSigTimeoutTime_ASBS" SG_ 514 BrakePdlPosn 0;
BA_ "GenSigTimeoutTime_BSM" SG_ 514 BrakePdlPosn 0;
BA_ "GenSigTimeoutTime_CADM" SG_ 514 BrakePdlPosn 0;
BA_ "GenSigTimeoutTime_DMSM" SG_ 514 BrakePdlPosn 0;
BA_ "GenSigTimeoutTime_DTCM" SG_ 514 BrakePdlPosn 0;
BA_ "GenSigTimeoutTime_ELSDM" SG_ 514 BrakePdlPosn 0;
BA_ "GenSigTimeoutTime_ESL" SG_ 514 BrakePdlPosn 0;
BA_ "GenSigTimeoutTime_GNMM" SG_ 514 BrakePdlPosn 0;
BA_ "GenSigTimeoutTime_HCP" SG_ 514 BrakePdlPosn 0;
BA_ "GenSigTimeoutTime_IPC" SG_ 514 BrakePdlPosn 0;
BA_ "GenSigTimeoutTime_RFHM" SG_ 514 BrakePdlPosn 0;
BA_ "GenSigTimeoutTime_ADCAM" SG_ 2564428018 N_PDU_18DA10F2 0;
BA_ "GenSigTimeoutTime_EVCU2" SG_ 2564428018 N_PDU_18DA10F2 0;
BA_ "GenSigTimeoutTime_VDCM" SG_ 2564428018 N_PDU_18DA10F2 0;
BA_ "GenSigTimeoutTime_AGSM" SG_ 2564428018 N_PDU_18DA10F2 0;
BA_ "GenSigTimeoutTime_ASBS" SG_ 2564428018 N_PDU_18DA10F2 0;
BA_ "GenSigTimeoutTime_BCM" SG_ 2564428018 N_PDU_18DA10F2 0;
BA_ "GenSigTimeoutTime_BSM" SG_ 2564428018 N_PDU_18DA10F2 0;
BA_ "GenSigTimeoutTime_CADM" SG_ 2564428018 N_PDU_18DA10F2 0;
BA_ "GenSigTimeoutTime_DMSM" SG_ 2564428018 N_PDU_18DA10F2 0;
BA_ "GenSigTimeoutTime_DTCM" SG_ 2564428018 N_PDU_18DA10F2 0;
BA_ "GenSigTimeoutTime_ECM" SG_ 2564428018 N_PDU_18DA10F2 0;
BA_ "GenSigTimeoutTime_ELSDM" SG_ 2564428018 N_PDU_18DA10F2 0;
BA_ "GenSigTimeoutTime_ESL" SG_ 2564428018 N_PDU_18DA10F2 0;
BA_ "GenSigTimeoutTime_GNMM" SG_ 2564428018 N_PDU_18DA10F2 0;
BA_ "GenSigTimeoutTime_HCP" SG_ 2564428018 N_PDU_18DA10F2 0;
BA_ "GenSigTimeoutTime_IPC" SG_ 2564428018 N_PDU_18DA10F2 0;
BA_ "GenSigTimeoutTime_RFHM" SG_ 2564428018 N_PDU_18DA10F2 0;
BA_ "GenSigTimeoutTime_SGW" SG_ 2564428018 N_PDU_18DA10F2 0;
BA_ "GenSigTimeoutTime_TCM" SG_ 2564428018 N_PDU_18DA10F2 0;
BA_ "GenSigTimeoutTime_ADCAM" SG_ 2564554482 N_PDU_18DBFEF2 0;
BA_ "GenSigTimeoutTime_EVCU2" SG_ 2564554482 N_PDU_18DBFEF2 0;
BA_ "GenSigTimeoutTime_VDCM" SG_ 2564554482 N_PDU_18DBFEF2 0;
BA_ "GenSigTimeoutTime_AGSM" SG_ 2564554482 N_PDU_18DBFEF2 0;
BA_ "GenSigTimeoutTime_ASBS" SG_ 2564554482 N_PDU_18DBFEF2 0;
BA_ "GenSigTimeoutTime_BCM" SG_ 2564554482 N_PDU_18DBFEF2 0;
BA_ "GenSigTimeoutTime_BSM" SG_ 2564554482 N_PDU_18DBFEF2 0;
BA_ "GenSigTimeoutTime_CADM" SG_ 2564554482 N_PDU_18DBFEF2 0;
BA_ "GenSigTimeoutTime_DMSM" SG_ 2564554482 N_PDU_18DBFEF2 0;
BA_ "GenSigTimeoutTime_DTCM" SG_ 2564554482 N_PDU_18DBFEF2 0;
BA_ "GenSigTimeoutTime_ECM" SG_ 2564554482 N_PDU_18DBFEF2 0;
BA_ "GenSigTimeoutTime_ELSDM" SG_ 2564554482 N_PDU_18DBFEF2 0;
BA_ "GenSigTimeoutTime_ESL" SG_ 2564554482 N_PDU_18DBFEF2 0;
BA_ "GenSigTimeoutTime_GNMM" SG_ 2564554482 N_PDU_18DBFEF2 0;
BA_ "GenSigTimeoutTime_HCP" SG_ 2564554482 N_PDU_18DBFEF2 0;
BA_ "GenSigTimeoutTime_IPC" SG_ 2564554482 N_PDU_18DBFEF2 0;
BA_ "GenSigTimeoutTime_RFHM" SG_ 2564554482 N_PDU_18DBFEF2 0;
BA_ "GenSigTimeoutTime_SGW" SG_ 2564554482 N_PDU_18DBFEF2 0;
BA_ "GenSigTimeoutTime_TCM" SG_ 2564554482 N_PDU_18DBFEF2 0;
BA_ "GenSigTimeoutTime_ADCAM" SG_ 517 CRC_DRIVETRAIN1 0;
BA_ "GenSigTimeoutTime_EVCU2" SG_ 517 CRC_DRIVETRAIN1 0;
BA_ "GenSigTimeoutTime_VDCM" SG_ 517 CRC_DRIVETRAIN1 0;
BA_ "GenSigTimeoutTime_BCM" SG_ 517 CRC_DRIVETRAIN1 0;
BA_ "GenSigTimeoutTime_ADCAM" SG_ 517 MessageCounter_DRIVETRAIN1 0;
BA_ "GenSigTimeoutTime_EVCU2" SG_ 517 MessageCounter_DRIVETRAIN1 0;
BA_ "GenSigTimeoutTime_VDCM" SG_ 517 MessageCounter_DRIVETRAIN1 0;
BA_ "GenSigTimeoutTime_BCM" SG_ 517 MessageCounter_DRIVETRAIN1 0;
BA_ "GenSigTimeoutTime_ADCAM" SG_ 517 AWDSysStat 0;
BA_ "GenSigTimeoutTime_EVCU2" SG_ 517 AWDSysStat 0;
BA_ "GenSigTimeoutTime_VDCM" SG_ 517 AWDSysStat 0;
BA_ "GenSigTimeoutTime_ADCAM" SG_ 517 DrvLnMinTrqMd 0;
BA_ "GenSigTimeoutTime_EVCU2" SG_ 517 DrvLnMinTrqMd 0;
BA_ "GenSigTimeoutTime_VDCM" SG_ 517 DrvLnMinTrqMd 0;
BA_ "GenSigTimeoutTime_ADCAM" SG_ 517 DrvLnTrqRq 0;
BA_ "GenSigTimeoutTime_EVCU2" SG_ 517 DrvLnTrqRq 0;
BA_ "GenSigTimeoutTime_VDCM" SG_ 517 DrvLnTrqRq 0;
BA_ "GenSigTimeoutTime_AGSM" SG_ 517 CRC_DRIVETRAIN1 0;
BA_ "GenSigTimeoutTime_ASBS" SG_ 517 CRC_DRIVETRAIN1 0;
BA_ "GenSigTimeoutTime_CADM" SG_ 517 CRC_DRIVETRAIN1 0;
BA_ "GenSigTimeoutTime_DMSM" SG_ 517 CRC_DRIVETRAIN1 0;
BA_ "GenSigTimeoutTime_DTCM" SG_ 517 CRC_DRIVETRAIN1 0;
BA_ "GenSigTimeoutTime_ESL" SG_ 517 CRC_DRIVETRAIN1 0;
BA_ "GenSigTimeoutTime_IPC" SG_ 517 CRC_DRIVETRAIN1 0;
BA_ "GenSigTimeoutTime_RFHM" SG_ 517 CRC_DRIVETRAIN1 0;
BA_ "GenSigTimeoutTime_SGW" SG_ 517 CRC_DRIVETRAIN1 0;
BA_ "GenSigTimeoutTime_AGSM" SG_ 517 MessageCounter_DRIVETRAIN1 0;
BA_ "GenSigTimeoutTime_ASBS" SG_ 517 MessageCounter_DRIVETRAIN1 0;
BA_ "GenSigTimeoutTime_CADM" SG_ 517 MessageCounter_DRIVETRAIN1 0;
BA_ "GenSigTimeoutTime_DMSM" SG_ 517 MessageCounter_DRIVETRAIN1 0;
BA_ "GenSigTimeoutTime_DTCM" SG_ 517 MessageCounter_DRIVETRAIN1 0;
BA_ "GenSigTimeoutTime_ESL" SG_ 517 MessageCounter_DRIVETRAIN1 0;
BA_ "GenSigTimeoutTime_IPC" SG_ 517 MessageCounter_DRIVETRAIN1 0;
BA_ "GenSigTimeoutTime_RFHM" SG_ 517 MessageCounter_DRIVETRAIN1 0;
BA_ "GenSigTimeoutTime_SGW" SG_ 517 MessageCounter_DRIVETRAIN1 0;
BA_ "GenSigStartValue" SG_ 517 AWDSysStat 7;
BA_ "GenSigTimeoutTime_AGSM" SG_ 517 AWDSysStat 0;
BA_ "GenSigTimeoutTime_CADM" SG_ 517 AWDSysStat 0;
BA_ "GenSigTimeoutTime_DMSM" SG_ 517 AWDSysStat 0;
BA_ "GenSigTimeoutTime_DTCM" SG_ 517 AWDSysStat 0;
BA_ "GenSigTimeoutTime_ELSDM" SG_ 517 AWDSysStat 0;
BA_ "GenSigTimeoutTime_ESL" SG_ 517 AWDSysStat 0;
BA_ "GenSigTimeoutTime_AGSM" SG_ 517 DrvLnMinTrqMd 0;
BA_ "GenSigTimeoutTime_ASBS" SG_ 517 DrvLnMinTrqMd 0;
BA_ "GenSigTimeoutTime_BCM" SG_ 517 DrvLnMinTrqMd 0;
BA_ "GenSigTimeoutTime_BSM" SG_ 517 DrvLnMinTrqMd 0;
BA_ "GenSigTimeoutTime_CADM" SG_ 517 DrvLnMinTrqMd 0;
BA_ "GenSigTimeoutTime_DMSM" SG_ 517 DrvLnMinTrqMd 0;
BA_ "GenSigTimeoutTime_DTCM" SG_ 517 DrvLnMinTrqMd 0;
BA_ "GenSigTimeoutTime_ELSDM" SG_ 517 DrvLnMinTrqMd 0;
BA_ "GenSigTimeoutTime_ESL" SG_ 517 DrvLnMinTrqMd 0;
BA_ "GenSigTimeoutTime_GNMM" SG_ 517 DrvLnMinTrqMd 0;
BA_ "GenSigTimeoutTime_HCP" SG_ 517 DrvLnMinTrqMd 0;
BA_ "GenSigTimeoutTime_IPC" SG_ 517 DrvLnMinTrqMd 0;
BA_ "GenSigTimeoutTime_RFHM" SG_ 517 DrvLnMinTrqMd 0;
BA_ "GenSigTimeoutTime_SGW" SG_ 517 DrvLnMinTrqMd 0;
BA_ "GenSigTimeoutTime_TCM" SG_ 517 DrvLnMinTrqMd 0;
BA_ "GenSigStartValue" SG_ 517 DrvLnTrqRq 511;
BA_ "GenSigTimeoutTime_AGSM" SG_ 517 DrvLnTrqRq 0;
BA_ "GenSigTimeoutTime_ASBS" SG_ 517 DrvLnTrqRq 0;
BA_ "GenSigTimeoutTime_BCM" SG_ 517 DrvLnTrqRq 0;
BA_ "GenSigTimeoutTime_BSM" SG_ 1448 SpStIndRq 0;
BA_ "GenSigTimeoutTime_CADM" SG_ 1448 SpStIndRq 0;
BA_ "GenSigTimeoutTime_DMSM" SG_ 1448 SpStIndRq 0;
BA_ "GenSigTimeoutTime_DTCM" SG_ 1448 SpStIndRq 0;
BA_ "GenSigTimeoutTime_ECM" SG_ 1448 SpStIndRq 0;
BA_ "GenSigTimeoutTime_ELSDM" SG_ 1448 SpStIndRq 0;
BA_ "GenSigTimeoutTime_ESL" SG_ 1448 SpStIndRq 0;
BA_ "GenSigTimeoutTime_GNMM" SG_ 1448 SpStIndRq 0;
BA_ "GenSigTimeoutTime_HCP" SG_ 1448 SpStIndRq 0;
BA_ "GenSigTimeoutTime_RFHM" SG_ 1448 SpStIndRq 0;
BA_ "GenSigTimeoutTime_SGW" SG_ 1448 SpStIndRq 0;
BA_ "GenSigTimeoutTime_TCM" SG_ 1448 SpStIndRq 0;
BA_ "GenSigSendType" SG_ 1448 GPFServiceSts 3;
BA_ "GenSigTimeoutTime_AGSM" SG_ 1448 GPFServiceSts 0;
BA_ "GenSigTimeoutTime_ASBS" SG_ 1448 GPFServiceSts 0;
BA_ "GenSigTimeoutTime_BCM" SG_ 1448 GPFServiceSts 0;
BA_ "GenSigTimeoutTime_BSM" SG_ 1448 GPFServiceSts 0;
BA_ "GenSigTimeoutTime_CADM" SG_ 1448 GPFServiceSts 0;
BA_ "GenSigTimeoutTime_DMSM" SG_ 1448 GPFServiceSts 0;
BA_ "GenSigTimeoutTime_DTCM" SG_ 1448 GPFServiceSts 0;
BA_ "GenSigTimeoutTime_ECM" SG_ 1448 GPFServiceSts 0;
BA_ "GenSigTimeoutTime_ELSDM" SG_ 1448 GPFServiceSts 0;
BA_ "GenSigTimeoutTime_ESL" SG_ 1448 GPFServiceSts 0;
BA_ "GenSigTimeoutTime_GNMM" SG_ 1448 GPFServiceSts 0;
BA_ "GenSigTimeoutTime_HCP" SG_ 1448 GPFServiceSts 0;
BA_ "GenSigTimeoutTime_RFHM" SG_ 1448 GPFServiceSts 0;
BA_ "GenSigTimeoutTime_SGW" SG_ 1448 GPFServiceSts 0;
BA_ "GenSigTimeoutTime_TCM" SG_ 1448 GPFServiceSts 0;
BA_ "GenSigTimeoutTime_AGSM" SG_ 1448 CRC_ENGINE7 0;
BA_ "GenSigTimeoutTime_ASBS" SG_ 1448 CRC_ENGINE7 0;
BA_ "GenSigTimeoutTime_BCM" SG_ 1448 CRC_ENGINE7 0;
BA_ "GenSigTimeoutTime_BSM" SG_ 1448 CRC_ENGINE7 0;
BA_ "GenSigTimeoutTime_DMSM" SG_ 1448 CRC_ENGINE7 0;
BA_ "GenSigTimeoutTime_DTCM" SG_ 1448 CRC_ENGINE7 0;
BA_ "GenSigTimeoutTime_ECM" SG_ 1448 CRC_ENGINE7 0;
BA_ "GenSigTimeoutTime_ELSDM" SG_ 1448 CRC_ENGINE7 0;
BA_ "GenSigTimeoutTime_ESL" SG_ 1448 CRC_ENGINE7 0;
BA_ "GenSigTimeoutTime_GNMM" SG_ 1448 CRC_ENGINE7 0;
BA_ "GenSigTimeoutTime_HCP" SG_ 1448 CRC_ENGINE7 0;
BA_ "GenSigTimeoutTime_RFHM" SG_ 1448 CRC_ENGINE7 0;
BA_ "GenSigTimeoutTime_SGW" SG_ 1448 CRC_ENGINE7 0;
BA_ "GenSigTimeoutTime_AGSM" SG_ 1448 MessageCounter_ENGINE7 0;
BA_ "GenSigTimeoutTime_ASBS" SG_ 1448 MessageCounter_ENGINE7 0;
BA_ "GenSigTimeoutTime_BCM" SG_ 1448 MessageCounter_ENGINE7 0;
BA_ "GenSigTimeoutTime_BSM" SG_ 1448 MessageCounter_ENGINE7 0;
BA_ "GenSigTimeoutTime_DMSM" SG_ 1448 MessageCounter_ENGINE7 0;
BA_ "GenSigTimeoutTime_DTCM" SG_ 1448 MessageCounter_ENGINE7 0;
BA_ "GenSigTimeoutTime_ECM" SG_ 1448 MessageCounter_ENGINE7 0;
BA_ "GenSigTimeoutTime_ELSDM" SG_ 1448 MessageCounter_ENGINE7 0;
BA_ "GenSigTimeoutTime_ESL" SG_ 1448 MessageCounter_ENGINE7 0;
BA_ "GenSigTimeoutTime_GNMM" SG_ 1448 MessageCounter_ENGINE7 0;
BA_ "GenSigTimeoutTime_HCP" SG_ 1448 MessageCounter_ENGINE7 0;
BA_ "GenSigTimeoutTime_RFHM" SG_ 1448 MessageCounter_ENGINE7 0;
BA_ "GenSigTimeoutTime_SGW" SG_ 1448 MessageCounter_ENGINE7 0;
BA_ "GenSigTimeoutTime_AGSM" SG_ 1448 FuelMM_Sts 0;
BA_ "GenSigTimeoutTime_ASBS" SG_ 1448 FuelMM_Sts 0;
BA_ "GenSigTimeoutTime_BCM" SG_ 1448 FuelMM_Sts 0;
BA_ "GenSigTimeoutTime_BSM" SG_ 1448 FuelMM_Sts 0;
BA_ "GenSigTimeoutTime_CADM" SG_ 1448 FuelMM_Sts 0;
BA_ "GenSigTimeoutTime_DMSM" SG_ 1448 FuelMM_Sts 0;
BA_ "GenSigTimeoutTime_DTCM" SG_ 1448 FuelMM_Sts 0;
BA_ "GenSigTimeoutTime_ECM" SG_ 1448 FuelMM_Sts 0;
BA_ "GenSigTimeoutTime_ELSDM" SG_ 1448 FuelMM_Sts 0;
BA_ "GenSigTimeoutTime_ESL" SG_ 1448 FuelMM_Sts 0;
BA_ "GenSigTimeoutTime_GNMM" SG_ 1448 FuelMM_Sts 0;
BA_ "GenSigTimeoutTime_HCP" SG_ 1448 FuelMM_Sts 0;
BA_ "GenSigTimeoutTime_IPC" SG_ 1448 FuelMM_Sts 0;
BA_ "GenSigTimeoutTime_RFHM" SG_ 1448 FuelMM_Sts 0;
BA_ "GenSigTimeoutTime_SGW" SG_ 1448 FuelMM_Sts 0;
BA_ "GenSigTimeoutTime_TCM" SG_ 1448 FuelMM_Sts 0;
BA_ "GenSigStartValue" SG_ 1448 HoursOilLifeRst 4095;
BA_ "GenSigTimeoutTime_AGSM" SG_ 1448 HoursOilLifeRst 0;
BA_ "GenSigTimeoutTime_ASBS" SG_ 1448 HoursOilLifeRst 0;
BA_ "GenSigTimeoutTime_BSM" SG_ 1448 HoursOilLifeRst 0;
BA_ "GenSigTimeoutTime_CADM" SG_ 1448 HoursOilLifeRst 0;
BA_ "GenSigTimeoutTime_DMSM" SG_ 1448 HoursOilLifeRst 0;
BA_ "GenSigTimeoutTime_DTCM" SG_ 1448 HoursOilLifeRst 0;
BA_ "GenSigTimeoutTime_ECM" SG_ 1448 HoursOilLifeRst 0;
BA_ "GenSigTimeoutTime_ELSDM" SG_ 1448 HoursOilLifeRst 0;
BA_ "GenSigTimeoutTime_ESL" SG_ 1448 HoursOilLifeRst 0;
BA_ "GenSigTimeoutTime_GNMM" SG_ 1448 HoursOilLifeRst 0;
BA_ "GenSigTimeoutTime_HCP" SG_ 1448 HoursOilLifeRst 0;
BA_ "GenSigTimeoutTime_IPC" SG_ 1448 HoursOilLifeRst 0;
BA_ "GenSigTimeoutTime_RFHM" SG_ 1448 HoursOilLifeRst 0;
BA_ "GenSigTimeoutTime_SGW" SG_ 1448 HoursOilLifeRst 0;
BA_ "GenSigTimeoutTime_TCM" SG_ 1448 HoursOilLifeRst 0;
BA_ "GenSigTimeoutTime_AGSM" SG_ 1448 MntncSts 0;
BA_ "GenSigTimeoutTime_ASBS" SG_ 1448 MntncSts 0;
BA_ "GenSigTimeoutTime_BCM" SG_ 1448 MntncSts 0;
BA_ "GenSigTimeoutTime_BSM" SG_ 1448 MntncSts 0;
BA_ "GenSigTimeoutTime_CADM" SG_ 1448 MntncSts 0;
BA_ "GenSigTimeoutTime_DMSM" SG_ 1448 MntncSts 0;
BA_ "GenSigTimeoutTime_DTCM" SG_ 1448 MntncSts 0;
BA_ "GenSigTimeoutTime_ECM" SG_ 1448 MntncSts 0;
BA_ "GenSigTimeoutTime_ELSDM" SG_ 1448 MntncSts 0;
BA_ "GenSigTimeoutTime_ESL" SG_ 1448 MntncSts 0;
BA_ "GenSigTimeoutTime_GNMM" SG_ 1448 MntncSts 0;
BA_ "GenSigTimeoutTime_HCP" SG_ 1448 MntncSts 0;
BA_ "GenSigTimeoutTime_RFHM" SG_ 1448 MntncSts 0;
BA_ "GenSigTimeoutTime_TCM" SG_ 1448 MntncSts 0;
BA_ "GenSigSendType" SG_ 1448 ECM_WARN 3;
BA_ "GenSigTimeoutTime_AGSM" SG_ 1448 ECM_WARN 0;
BA_ "GenSigTimeoutTime_ASBS" SG_ 1448 ECM_WARN 0;
BA_ "GenSigTimeoutTime_BCM" SG_ 1448 ECM_WARN 0;
BA_ "GenSigTimeoutTime_BSM" SG_ 1448 ECM_WARN 0;
BA_ "GenSigTimeoutTime_CADM" SG_ 1448 ECM_WARN 0;
BA_ "GenSigTimeoutTime_DMSM" SG_ 1448 ECM_WARN 0;
BA_ "GenSigTimeoutTime_DTCM" SG_ 1448 ECM_WARN 0;
BA_ "GenSigTimeoutTime_ECM" SG_ 1448 ECM_WARN 0;
BA_ "GenSigTimeoutTime_ELSDM" SG_ 1448 ECM_WARN 0;
BA_ "GenSigTimeoutTime_ESL" SG_ 1448 ECM_WARN 0;
BA_ "GenSigTimeoutTime_GNMM" SG_ 1448 ECM_WARN 0;
BA_ "GenSigTimeoutTime_HCP" SG_ 1448 ECM_WARN 0;
BA_ "GenSigTimeoutTime_RFHM" SG_ 1448 ECM_WARN 0;
BA_ "GenSigTimeoutTime_SGW" SG_ 1448 ECM_WARN 0;
BA_ "GenSigTimeoutTime_TCM" SG_ 1448 ECM_WARN 0;
BA_ "GenSigSendType" SG_ 1448 ECM_WARN_BTO 3;
BA_ "GenSigTimeoutTime_AGSM" SG_ 1448 ECM_WARN_BTO 0;
BA_ "GenSigTimeoutTime_ASBS" SG_ 1448 ECM_WARN_BTO 0;
BA_ "GenSigTimeoutTime_BCM" SG_ 1448 ECM_WARN_BTO 0;
BA_ "GenSigTimeoutTime_BSM" SG_ 1448 ECM_WARN_BTO 0;
BA_ "GenSigTimeoutTime_CADM" SG_ 1448 ECM_WARN_BTO 0;
BA_ "GenSigTimeoutTime_DMSM" SG_ 1448 ECM_WARN_BTO 0;
BA_ "GenSigTimeoutTime_DTCM" SG_ 1448 ECM_WARN_BTO 0;
BA_ "GenSigTimeoutTime_ECM" SG_ 1448 ECM_WARN_BTO 0;
BA_ "GenSigTimeoutTime_ELSDM" SG_ 1448 ECM_WARN_BTO 0;
BA_ "GenSigTimeoutTime_ESL" SG_ 1448 ECM_WARN_BTO 0;
BA_ "GenSigTimeoutTime_GNMM" SG_ 1448 ECM_WARN_BTO 0;
BA_ "GenSigTimeoutTime_HCP" SG_ 1448 ECM_WARN_BTO 0;
BA_ "GenSigTimeoutTime_RFHM" SG_ 1448 ECM_WARN_BTO 0;
BA_ "GenSigTimeoutTime_SGW" SG_ 1448 ECM_WARN_BTO 0;
BA_ "GenSigTimeoutTime_TCM" SG_ 1448 ECM_WARN_BTO 0;
BA_ "GenSigStartValue" SG_ 1448 EMSFailSts 2;
BA_ "GenSigSendType" SG_ 1448 EMSFailSts 3;
BA_ "GenSigTimeoutTime_AGSM" SG_ 1448 EMSFailSts 0;
BA_ "GenSigTimeoutTime_ASBS" SG_ 1448 EMSFailSts 0;
BA_ "GenSigTimeoutTime_BSM" SG_ 1448 EMSFailSts 0;
BA_ "GenSigTimeoutTime_DMSM" SG_ 1448 EMSFailSts 0;
BA_ "GenSigTimeoutTime_DTCM" SG_ 1448 EMSFailSts 0;
BA_ "GenSigTimeoutTime_ECM" SG_ 1448 EMSFailSts 0;
BA_ "GenSigTimeoutTime_ELSDM" SG_ 1448 EMSFailSts 0;
BA_ "GenSigTimeoutTime_ESL" SG_ 1448 EMSFailSts 0;
BA_ "GenSigTimeoutTime_GNMM" SG_ 1448 EMSFailSts 0;
BA_ "GenSigTimeoutTime_RFHM" SG_ 1448 EMSFailSts 0;
BA_ "GenSigTimeoutTime_TCM" SG_ 1448 EMSFailSts 0;
BA_ "GenSigSendType" SG_ 1448 EngineOperatingMode 3;
BA_ "GenSigTimeoutTime_AGSM" SG_ 1448 EngineOperatingMode 0;
BA_ "GenSigTimeoutTime_ASBS" SG_ 1448 EngineOperatingMode 0;
BA_ "GenSigTimeoutTime_BCM" SG_ 1448 EngineOperatingMode 0;
BA_ "GenSigTimeoutTime_BSM" SG_ 1448 EngineOperatingMode 0;
BA_ "GenSigTimeoutTime_CADM" SG_ 1448 EngineOperatingMode 0;
BA_ "GenSigTimeoutTime_DMSM" SG_ 1448 EngineOperatingMode 0;
BA_ "GenSigTimeoutTime_DTCM" SG_ 1448 EngineOperatingMode 0;
BA_ "GenSigTimeoutTime_ECM" SG_ 1448 EngineOperatingMode 0;
BA_ "GenSigTimeoutTime_ELSDM" SG_ 1448 EngineOperatingMode 0;
BA_ "GenSigTimeoutTime_ESL" SG_ 1448 EngineOperatingMode 0;
BA_ "GenSigTimeoutTime_GNMM" SG_ 1448 EngineOperatingMode 0;
BA_ "GenSigTimeoutTime_HCP" SG_ 1448 EngineOperatingMode 0;
BA_ "GenSigTimeoutTime_IPC" SG_ 1448 EngineOperatingMode 0;
BA_ "GenSigTimeoutTime_RFHM" SG_ 1448 EngineOperatingMode 0;
BA_ "GenSigTimeoutTime_TCM" SG_ 1448 EngineOperatingMode 0;
BA_ "GenSigSendType" SG_ 1448 ETCFailSts 3;
BA_ "GenSigTimeoutTime_AGSM" SG_ 1448 ETCFailSts 0;
BA_ "GenSigTimeoutTime_ASBS" SG_ 1448 ETCFailSts 0;
BA_ "GenSigTimeoutTime_BSM" SG_ 1448 ETCFailSts 0;
BA_ "GenSigTimeoutTime_CADM" SG_ 1448 ETCFailSts 0;
BA_ "GenSigTimeoutTime_DMSM" SG_ 1448 ETCFailSts 0;
BA_ "GenSigTimeoutTime_DTCM" SG_ 1448 ETCFailSts 0;
BA_ "GenSigTimeoutTime_ECM" SG_ 1448 ETCFailSts 0;
BA_ "GenSigTimeoutTime_ELSDM" SG_ 1448 ETCFailSts 0;
BA_ "GenSigTimeoutTime_ESL" SG_ 1448 ETCFailSts 0;
BA_ "GenSigTimeoutTime_GNMM" SG_ 1448 ETCFailSts 0;
BA_ "GenSigTimeoutTime_HCP" SG_ 1448 ETCFailSts 0;
BA_ "GenSigTimeoutTime_RFHM" SG_ 1448 ETCFailSts 0;
BA_ "GenSigTimeoutTime_TCM" SG_ 1448 ETCFailSts 0;
BA_ "GenSigSendType" SG_ 1448 ExhaustTemperature 3;
BA_ "GenSigTimeoutTime_AGSM" SG_ 1448 ExhaustTemperature 0;
BA_ "GenSigTimeoutTime_ASBS" SG_ 1448 ExhaustTemperature 0;
BA_ "GenSigTimeoutTime_BCM" SG_ 1448 ExhaustTemperature 0;
BA_ "GenSigTimeoutTime_BSM" SG_ 1448 ExhaustTemperature 0;
BA_ "GenSigTimeoutTime_CADM" SG_ 1448 ExhaustTemperature 0;
BA_ "GenSigTimeoutTime_DMSM" SG_ 1448 ExhaustTemperature 0;
BA_ "GenSigTimeoutTime_DTCM" SG_ 1448 ExhaustTemperature 0;
BA_ "GenSigTimeoutTime_ECM" SG_ 1448 ExhaustTemperature 0;
BA_ "GenSigTimeoutTime_ELSDM" SG_ 1448 ExhaustTemperature 0;
BA_ "GenSigTimeoutTime_ESL" SG_ 1448 ExhaustTemperature 0;
BA_ "GenSigTimeoutTime_GNMM" SG_ 1448 ExhaustTemperature 0;
BA_ "GenSigTimeoutTime_HCP" SG_ 1448 ExhaustTemperature 0;
BA_ "GenSigTimeoutTime_IPC" SG_ 1448 ExhaustTemperature 0;
BA_ "GenSigTimeoutTime_RFHM" SG_ 1448 ExhaustTemperature 0;
BA_ "GenSigTimeoutTime_TCM" SG_ 1448 ExhaustTemperature 0;
BA_ "GenSigTimeoutTime_ADCAM" SG_ 1055 Propulsion_DrvMd_Sts_ECM 0;
BA_ "GenSigTimeoutTime_EVCU2" SG_ 1055 Propulsion_DrvMd_Sts_ECM 0;
BA_ "GenSigTimeoutTime_VDCM" SG_ 1055 Propulsion_DrvMd_Sts_ECM 0;
BA_ "GenSigTimeoutTime_AGSM" SG_ 1055 Propulsion_DrvMd_Sts_ECM 0;
BA_ "GenSigTimeoutTime_BCM" SG_ 1055 Propulsion_DrvMd_Sts_ECM 0;
BA_ "GenSigTimeoutTime_BSM" SG_ 1055 Propulsion_DrvMd_Sts_ECM 0;
BA_ "GenSigTimeoutTime_DTCM" SG_ 1055 Propulsion_DrvMd_Sts_ECM 0;
BA_ "GenSigTimeoutTime_ECM" SG_ 1055 Propulsion_DrvMd_Sts_ECM 0;
BA_ "GenSigTimeoutTime_ESL" SG_ 1055 Propulsion_DrvMd_Sts_ECM 0;
BA_ "GenSigTimeoutTime_IPC" SG_ 1055 Propulsion_DrvMd_Sts_ECM 0;
BA_ "GenSigTimeoutTime_RFHM" SG_ 1055 Propulsion_DrvMd_Sts_ECM 0;
BA_ "GenSigTimeoutTime_SGW" SG_ 1055 Propulsion_DrvMd_Sts_ECM 0;
BA_ "GenSigTimeoutTime_TCM" SG_ 1055 Propulsion_DrvMd_Sts_ECM 0;
BA_ "GenSigTimeoutTime_ADCAM" SG_ 1055 RACE_CLDWN_DEAC_TIME 0;
BA_ "GenSigTimeoutTime_EVCU2" SG_ 1055 RACE_CLDWN_DEAC_TIME 0;
BA_ "GenSigTimeoutTime_VDCM" SG_ 1055 RACE_CLDWN_DEAC_TIME 0;
BA_ "GenSigTimeoutTime_AGSM" SG_ 1055 RACE_CLDWN_DEAC_TIME 0;
BA_ "GenSigTimeoutTime_BCM" SG_ 1055 RACE_CLDWN_DEAC_TIME 0;
BA_ "GenSigTimeoutTime_BSM" SG_ 1055 RACE_CLDWN_DEAC_TIME 0;
BA_ "GenSigTimeoutTime_DTCM" SG_ 1055 RACE_CLDWN_DEAC_TIME 0;
BA_ "GenSigTimeoutTime_ECM" SG_ 1055 RACE_CLDWN_DEAC_TIME 0;
BA_ "GenSigTimeoutTime_ESL" SG_ 1055 RACE_CLDWN_DEAC_TIME 0;
BA_ "GenSigTimeoutTime_IPC" SG_ 1055 RACE_CLDWN_DEAC_TIME 0;
BA_ "GenSigTimeoutTime_RFHM" SG_ 1055 RACE_CLDWN_DEAC_TIME 0;
BA_ "GenSigTimeoutTime_TCM" SG_ 1055 RACE_CLDWN_DEAC_TIME 0;
BA_ "GenSigTimeoutTime_ADCAM" SG_ 1055 PSI_Max_RPM 0;
BA_ "GenSigTimeoutTime_EVCU2" SG_ 1055 PSI_Max_RPM 0;
BA_ "GenSigTimeoutTime_VDCM" SG_ 1055 PSI_Max_RPM 0;
BA_ "GenSigTimeoutTime_AGSM" SG_ 1055 PSI_Max_RPM 0;
BA_ "GenSigTimeoutTime_BCM" SG_ 1055 PSI_Max_RPM 0;
BA_ "GenSigTimeoutTime_BSM" SG_ 1055 PSI_Max_RPM 0;
BA_ "GenSigTimeoutTime_DTCM" SG_ 1055 PSI_Max_RPM 0;
BA_ "GenSigTimeoutTime_ECM" SG_ 1055 PSI_Max_RPM 0;
BA_ "GenSigTimeoutTime_ESL" SG_ 1055 PSI_Max_RPM 0;
BA_ "GenSigTimeoutTime_IPC" SG_ 1055 PSI_Max_RPM 0;
BA_ "GenSigTimeoutTime_RFHM" SG_ 1055 PSI_Max_RPM 0;
BA_ "GenSigTimeoutTime_TCM" SG_ 1055 PSI_Max_RPM 0;
BA_ "GenSigTimeoutTime_ADCAM" SG_ 1055 LTR_TARGET_TEMP 0;
BA_ "GenSigTimeoutTime_EVCU2" SG_ 1055 LTR_TARGET_TEMP 0;
BA_ "GenSigTimeoutTime_VDCM" SG_ 1055 LTR_TARGET_TEMP 0;
BA_ "GenSigTimeoutTime_AGSM" SG_ 1055 LTR_TARGET_TEMP 0;
BA_ "GenSigTimeoutTime_BCM" SG_ 1055 LTR_TARGET_TEMP 0;
BA_ "GenSigTimeoutTime_BSM" SG_ 1055 LTR_TARGET_TEMP 0;
BA_ "GenSigTimeoutTime_DTCM" SG_ 1055 LTR_TARGET_TEMP 0;
BA_ "GenSigTimeoutTime_ECM" SG_ 1055 LTR_TARGET_TEMP 0;
BA_ "GenSigTimeoutTime_ESL" SG_ 1055 LTR_TARGET_TEMP 0;
BA_ "GenSigTimeoutTime_IPC" SG_ 1055 LTR_TARGET_TEMP 0;
BA_ "GenSigTimeoutTime_RFHM" SG_ 1055 LTR_TARGET_TEMP 0;
BA_ "GenSigTimeoutTime_TCM" SG_ 1055 LTR_TARGET_TEMP 0;
BA_ "GenSigTimeoutTime_ADCAM" SG_ 1055 PSI_Gr1_RPM 0;
BA_ "GenSigTimeoutTime_EVCU2" SG_ 1055 PSI_Gr1_RPM 0;
BA_ "GenSigTimeoutTime_VDCM" SG_ 1055 PSI_Gr1_RPM 0;
BA_ "GenSigTimeoutTime_AGSM" SG_ 1055 PSI_Gr1_RPM 0;
BA_ "GenSigTimeoutTime_BCM" SG_ 1055 PSI_Gr1_RPM 0;
BA_ "GenSigTimeoutTime_BSM" SG_ 1055 PSI_Gr1_RPM 0;
BA_ "GenSigTimeoutTime_DTCM" SG_ 1055 PSI_Gr1_RPM 0;
BA_ "GenSigTimeoutTime_ECM" SG_ 1055 PSI_Gr1_RPM 0;
BA_ "GenSigTimeoutTime_ESL" SG_ 1055 PSI_Gr1_RPM 0;
BA_ "GenSigTimeoutTime_IPC" SG_ 1055 PSI_Gr1_RPM 0;
BA_ "GenSigTimeoutTime_RFHM" SG_ 1055 PSI_Gr1_RPM 0;
BA_ "GenSigTimeoutTime_TCM" SG_ 1055 PSI_Gr1_RPM 0;
BA_ "GenSigTimeoutTime_ADCAM" SG_ 1055 PSI_Gr2_RPM 0;
BA_ "GenSigTimeoutTime_EVCU2" SG_ 1055 PSI_Gr2_RPM 0;
BA_ "GenSigTimeoutTime_VDCM" SG_ 1055 PSI_Gr2_RPM 0;
BA_ "GenSigTimeoutTime_AGSM" SG_ 1055 PSI_Gr2_RPM 0;
BA_ "GenSigTimeoutTime_BCM" SG_ 1055 PSI_Gr2_RPM 0;
BA_ "GenSigTimeoutTime_BSM" SG_ 1055 PSI_Gr2_RPM 0;
BA_ "GenSigTimeoutTime_DTCM" SG_ 1055 PSI_Gr2_RPM 0;
BA_ "GenSigTimeoutTime_ECM" SG_ 1055 PSI_Gr2_RPM 0;
BA_ "GenSigTimeoutTime_ESL" SG_ 1055 PSI_Gr2_RPM 0;
BA_ "GenSigTimeoutTime_IPC" SG_ 1055 PSI_Gr2_RPM 0;
BA_ "GenSigTimeoutTime_RFHM" SG_ 1055 PSI_Gr2_RPM 0;
BA_ "GenSigTimeoutTime_TCM" SG_ 1055 PSI_Gr2_RPM 0;
BA_ "GenSigTimeoutTime_ADCAM" SG_ 1055 PSI_Gr3_RPM 0;
BA_ "GenSigTimeoutTime_EVCU2" SG_ 1055 PSI_Gr3_RPM 0;
BA_ "GenSigTimeoutTime_VDCM" SG_ 1055 PSI_Gr3_RPM 0;
BA_ "GenSigTimeoutTime_AGSM" SG_ 1055 PSI_Gr3_RPM 0;
BA_ "GenSigTimeoutTime_BCM" SG_ 1055 PSI_Gr3_RPM 0;
BA_ "GenSigTimeoutTime_BSM" SG_ 1055 PSI_Gr3_RPM 0;
BA_ "GenSigTimeoutTime_DTCM" SG_ 1055 PSI_Gr3_RPM 0;
BA_ "GenSigTimeoutTime_ECM" SG_ 1055 PSI_Gr3_RPM 0;
BA_ "GenSigTimeoutTime_ESL" SG_ 1055 PSI_Gr3_RPM 0;
BA_ "GenSigTimeoutTime_IPC" SG_ 1055 PSI_Gr3_RPM 0;
BA_ "GenSigTimeoutTime_RFHM" SG_ 1055 PSI_Gr3_RPM 0;
BA_ "GenSigTimeoutTime_TCM" SG_ 1055 PSI_Gr3_RPM 0;
BA_ "GenSigTimeoutTime_ADCAM" SG_ 1055 PSI_Gr4_RPM 0;
BA_ "GenSigTimeoutTime_EVCU2" SG_ 1055 PSI_Gr4_RPM 0;
BA_ "GenSigTimeoutTime_VDCM" SG_ 1055 PSI_Gr4_RPM 0;
BA_ "GenSigTimeoutTime_AGSM" SG_ 1055 PSI_Gr4_RPM 0;
BA_ "GenSigTimeoutTime_BCM" SG_ 1055 PSI_Gr4_RPM 0;
BA_ "GenSigTimeoutTime_BSM" SG_ 1055 PSI_Gr4_RPM 0;
BA_ "GenSigTimeoutTime_DTCM" SG_ 1055 PSI_Gr4_RPM 0;
BA_ "GenSigTimeoutTime_ECM" SG_ 1055 PSI_Gr4_RPM 0;
BA_ "GenSigTimeoutTime_ESL" SG_ 1055 PSI_Gr4_RPM 0;
BA_ "GenSigTimeoutTime_IPC" SG_ 1055 PSI_Gr4_RPM 0;
BA_ "GenSigTimeoutTime_RFHM" SG_ 1055 PSI_Gr4_RPM 0;
BA_ "GenSigTimeoutTime_TCM" SG_ 1055 PSI_Gr4_RPM 0;
BA_ "GenSigTimeoutTime_ADCAM" SG_ 1055 PSI_Gr5_RPM 0;
BA_ "GenSigTimeoutTime_EVCU2" SG_ 1055 PSI_Gr5_RPM 0;
BA_ "GenSigTimeoutTime_VDCM" SG_ 1055 PSI_Gr5_RPM 0;
BA_ "GenSigTimeoutTime_AGSM" SG_ 1055 PSI_Gr5_RPM 0;
BA_ "GenSigTimeoutTime_BCM" SG_ 1055 PSI_Gr5_RPM 0;
BA_ "GenSigTimeoutTime_BSM" SG_ 1055 PSI_Gr5_RPM 0;
BA_ "GenSigTimeoutTime_DTCM" SG_ 1055 PSI_Gr5_RPM 0;
BA_ "GenSigTimeoutTime_ECM" SG_ 1055 PSI_Gr5_RPM 0;
BA_ "GenSigTimeoutTime_ESL" SG_ 1055 PSI_Gr5_RPM 0;
BA_ "GenSigTimeoutTime_IPC" SG_ 1055 PSI_Gr5_RPM 0;
BA_ "GenSigTimeoutTime_RFHM" SG_ 1055 PSI_Gr5_RPM 0;
BA_ "GenSigTimeoutTime_TCM" SG_ 1055 PSI_Gr5_RPM 0;
BA_ "GenSigTimeoutTime_ADCAM" SG_ 1055 Actual_DriveMode_Status_ECM 0;
BA_ "GenSigTimeoutTime_EVCU2" SG_ 1055 Actual_DriveMode_Status_ECM 0;
BA_ "GenSigTimeoutTime_VDCM" SG_ 1055 Actual_DriveMode_Status_ECM 0;
BA_ "GenSigTimeoutTime_AGSM" SG_ 1055 Actual_DriveMode_Status_ECM 0;
BA_ "GenSigTimeoutTime_BCM" SG_ 1055 Actual_DriveMode_Status_ECM 0;
BA_ "GenSigTimeoutTime_BSM" SG_ 1055 Actual_DriveMode_Status_ECM 0;
BA_ "GenSigTimeoutTime_DTCM" SG_ 1055 Actual_DriveMode_Status_ECM 0;
BA_ "GenSigTimeoutTime_ECM" SG_ 1055 Actual_DriveMode_Status_ECM 0;
BA_ "GenSigTimeoutTime_ESL" SG_ 1055 Actual_DriveMode_Status_ECM 0;
BA_ "GenSigTimeoutTime_IPC" SG_ 1055 Actual_DriveMode_Status_ECM 0;
BA_ "GenSigTimeoutTime_RFHM" SG_ 1055 Actual_DriveMode_Status_ECM 0;
BA_ "GenSigTimeoutTime_TCM" SG_ 1055 Actual_DriveMode_Status_ECM 0;
BA_ "GenSigTimeoutTime_ADCAM" SG_ 1055 SYSTEM_STATUS 0;
BA_ "GenSigTimeoutTime_EVCU2" SG_ 1055 SYSTEM_STATUS 0;
BA_ "GenSigTimeoutTime_VDCM" SG_ 1055 SYSTEM_STATUS 0;
BA_ "GenSigTimeoutTime_AGSM" SG_ 1055 SYSTEM_STATUS 0;
BA_ "GenSigTimeoutTime_BCM" SG_ 1055 SYSTEM_STATUS 0;
BA_ "GenSigTimeoutTime_BSM" SG_ 1055 SYSTEM_STATUS 0;
BA_ "GenSigTimeoutTime_DTCM" SG_ 1055 SYSTEM_STATUS 0;
BA_ "GenSigTimeoutTime_ECM" SG_ 1055 SYSTEM_STATUS 0;
BA_ "GenSigTimeoutTime_ESL" SG_ 1055 SYSTEM_STATUS 0;
BA_ "GenSigTimeoutTime_IPC" SG_ 1055 SYSTEM_STATUS 0;
BA_ "GenSigTimeoutTime_RFHM" SG_ 1055 SYSTEM_STATUS 0;
BA_ "GenSigTimeoutTime_TCM" SG_ 1055 SYSTEM_STATUS 0;
BA_ "GenSigTimeoutTime_ADCAM" SG_ 1055 HOOD_AJAR_STATUS 0;
BA_ "GenSigTimeoutTime_EVCU2" SG_ 1055 HOOD_AJAR_STATUS 0;
BA_ "GenSigTimeoutTime_VDCM" SG_ 1055 HOOD_AJAR_STATUS 0;
BA_ "GenSigTimeoutTime_AGSM" SG_ 1055 HOOD_AJAR_STATUS 0;
BA_ "GenSigTimeoutTime_BCM" SG_ 1055 HOOD_AJAR_STATUS 0;
BA_ "GenSigTimeoutTime_BSM" SG_ 1055 HOOD_AJAR_STATUS 0;
BA_ "GenSigTimeoutTime_DTCM" SG_ 1055 HOOD_AJAR_STATUS 0;
BA_ "GenSigTimeoutTime_ECM" SG_ 1055 HOOD_AJAR_STATUS 0;
BA_ "GenSigTimeoutTime_ESL" SG_ 1055 HOOD_AJAR_STATUS 0;
BA_ "GenSigTimeoutTime_IPC" SG_ 1055 HOOD_AJAR_STATUS 0;
BA_ "GenSigTimeoutTime_RFHM" SG_ 1055 HOOD_AJAR_STATUS 0;
BA_ "GenSigTimeoutTime_SGW" SG_ 1055 HOOD_AJAR_STATUS 0;
BA_ "GenSigTimeoutTime_TCM" SG_ 1055 HOOD_AJAR_STATUS 0;
BA_ "GenSigTimeoutTime_ADCAM" SG_ 1055 RACE_CLDWN_BATT_STAT 0;
BA_ "GenSigTimeoutTime_EVCU2" SG_ 1055 RACE_CLDWN_BATT_STAT 0;
BA_ "GenSigTimeoutTime_VDCM" SG_ 1055 RACE_CLDWN_BATT_STAT 0;
BA_ "GenSigTimeoutTime_AGSM" SG_ 1055 RACE_CLDWN_BATT_STAT 0;
BA_ "GenSigTimeoutTime_BCM" SG_ 1055 RACE_CLDWN_BATT_STAT 0;
BA_ "GenSigTimeoutTime_BSM" SG_ 1055 RACE_CLDWN_BATT_STAT 0;
BA_ "GenSigTimeoutTime_DTCM" SG_ 1055 RACE_CLDWN_BATT_STAT 0;
BA_ "GenSigTimeoutTime_ECM" SG_ 1055 RACE_CLDWN_BATT_STAT 0;
BA_ "GenSigTimeoutTime_ESL" SG_ 1055 RACE_CLDWN_BATT_STAT 0;
BA_ "GenSigTimeoutTime_IPC" SG_ 1055 RACE_CLDWN_BATT_STAT 0;
BA_ "GenSigTimeoutTime_RFHM" SG_ 1055 RACE_CLDWN_BATT_STAT 0;
BA_ "GenSigTimeoutTime_TCM" SG_ 1055 RACE_CLDWN_BATT_STAT 0;
BA_ "GenSigTimeoutTime_ADCAM" SG_ 1055 AFTER_RUN_STATUS 0;
BA_ "GenSigTimeoutTime_EVCU2" SG_ 1055 AFTER_RUN_STATUS 0;
BA_ "GenSigTimeoutTime_VDCM" SG_ 1055 AFTER_RUN_STATUS 0;
BA_ "GenSigTimeoutTime_AGSM" SG_ 1055 AFTER_RUN_STATUS 0;
BA_ "GenSigTimeoutTime_BCM" SG_ 1055 AFTER_RUN_STATUS 0;
BA_ "GenSigTimeoutTime_BSM" SG_ 1055 AFTER_RUN_STATUS 0;
BA_ "GenSigTimeoutTime_DTCM" SG_ 1055 AFTER_RUN_STATUS 0;
BA_ "GenSigTimeoutTime_ECM" SG_ 1055 AFTER_RUN_STATUS 0;
BA_ "GenSigTimeoutTime_ESL" SG_ 1055 AFTER_RUN_STATUS 0;
BA_ "GenSigTimeoutTime_IPC" SG_ 1055 AFTER_RUN_STATUS 0;
BA_ "GenSigTimeoutTime_RFHM" SG_ 1055 AFTER_RUN_STATUS 0;
BA_ "GenSigTimeoutTime_TCM" SG_ 1055 AFTER_RUN_STATUS 0;
BA_ "GenSigTimeoutTime_ADCAM" SG_ 1055 COOLING_REQUIRED_STATUS 0;
BA_ "GenSigTimeoutTime_EVCU2" SG_ 1055 COOLING_REQUIRED_STATUS 0;
BA_ "GenSigTimeoutTime_VDCM" SG_ 1055 COOLING_REQUIRED_STATUS 0;
BA_ "GenSigTimeoutTime_AGSM" SG_ 1055 COOLING_REQUIRED_STATUS 0;
BA_ "GenSigTimeoutTime_BCM" SG_ 1055 COOLING_REQUIRED_STATUS 0;
BA_ "GenSigTimeoutTime_BSM" SG_ 1055 COOLING_REQUIRED_STATUS 0;
BA_ "GenSigTimeoutTime_DTCM" SG_ 1055 COOLING_REQUIRED_STATUS 0;
BA_ "GenSigTimeoutTime_ECM" SG_ 1055 COOLING_REQUIRED_STATUS 0;
BA_ "GenSigTimeoutTime_ESL" SG_ 1055 COOLING_REQUIRED_STATUS 0;
BA_ "GenSigTimeoutTime_IPC" SG_ 1055 COOLING_REQUIRED_STATUS 0;
BA_ "GenSigTimeoutTime_RFHM" SG_ 1055 COOLING_REQUIRED_STATUS 0;
BA_ "GenSigTimeoutTime_TCM" SG_ 1055 COOLING_REQUIRED_STATUS 0;
BA_ "GenSigTimeoutTime_ADCAM" SG_ 1055 RACE_CLDWN_SEL 0;
BA_ "GenSigTimeoutTime_EVCU2" SG_ 1055 RACE_CLDWN_SEL 0;
BA_ "GenSigTimeoutTime_VDCM" SG_ 1055 RACE_CLDWN_SEL 0;
BA_ "GenSigTimeoutTime_AGSM" SG_ 1055 RACE_CLDWN_SEL 0;
BA_ "GenSigTimeoutTime_BCM" SG_ 1055 RACE_CLDWN_SEL 0;
BA_ "GenSigTimeoutTime_BSM" SG_ 1055 RACE_CLDWN_SEL 0;
BA_ "GenSigTimeoutTime_DTCM" SG_ 1055 RACE_CLDWN_SEL 0;
BA_ "GenSigTimeoutTime_ECM" SG_ 1055 RACE_CLDWN_SEL 0;
BA_ "GenSigTimeoutTime_ESL" SG_ 1055 RACE_CLDWN_SEL 0;
BA_ "GenSigTimeoutTime_IPC" SG_ 1055 RACE_CLDWN_SEL 0;
BA_ "GenSigTimeoutTime_RFHM" SG_ 1055 RACE_CLDWN_SEL 0;
BA_ "GenSigTimeoutTime_TCM" SG_ 1055 RACE_CLDWN_SEL 0;
BA_ "GenSigTimeoutTime_ADCAM" SG_ 1055 PSI_EnableSts 0;
BA_ "GenSigTimeoutTime_EVCU2" SG_ 1055 PSI_EnableSts 0;
BA_ "GenSigTimeoutTime_VDCM" SG_ 1055 PSI_EnableSts 0;
BA_ "GenSigTimeoutTime_AGSM" SG_ 1055 PSI_EnableSts 0;
BA_ "GenSigTimeoutTime_BCM" SG_ 1055 PSI_EnableSts 0;
BA_ "GenSigTimeoutTime_BSM" SG_ 1055 PSI_EnableSts 0;
BA_ "GenSigTimeoutTime_DTCM" SG_ 1055 PSI_EnableSts 0;
BA_ "GenSigTimeoutTime_ECM" SG_ 1055 PSI_EnableSts 0;
BA_ "GenSigTimeoutTime_ESL" SG_ 1055 PSI_EnableSts 0;
BA_ "GenSigTimeoutTime_IPC" SG_ 1055 PSI_EnableSts 0;
BA_ "GenSigTimeoutTime_RFHM" SG_ 1055 PSI_EnableSts 0;
BA_ "GenSigTimeoutTime_TCM" SG_ 1055 PSI_EnableSts 0;
BA_ "GenSigTimeoutTime_ADCAM" SG_ 1055 MdsActforANC 0;
BA_ "GenSigTimeoutTime_EVCU2" SG_ 1055 MdsActforANC 0;
BA_ "GenSigTimeoutTime_VDCM" SG_ 1055 MdsActforANC 0;
BA_ "GenSigTimeoutTime_ADCAM" SG_ 1055 OIL_PRESS 0;
BA_ "GenSigTimeoutTime_EVCU2" SG_ 1055 OIL_PRESS 0;
BA_ "GenSigTimeoutTime_VDCM" SG_ 1055 OIL_PRESS 0;
BA_ "GenSigTimeoutTime_ADCAM" SG_ 1055 RevOilLifeRst 0;
BA_ "GenSigTimeoutTime_EVCU2" SG_ 1055 RevOilLifeRst 0;
BA_ "GenSigTimeoutTime_VDCM" SG_ 1055 RevOilLifeRst 0;
BA_ "GenSigTimeoutTime_ADCAM" SG_ 1055 AM_ECM_Prsnt 0;
BA_ "GenSigTimeoutTime_EVCU2" SG_ 1055 AM_ECM_Prsnt 0;
BA_ "GenSigTimeoutTime_VDCM" SG_ 1055 AM_ECM_Prsnt 0;
BA_ "GenSigTimeoutTime_ADCAM" SG_ 1055 GF_Charge 0;
BA_ "GenSigTimeoutTime_EVCU2" SG_ 1055 GF_Charge 0;
BA_ "GenSigTimeoutTime_VDCM" SG_ 1055 GF_Charge 0;
BA_ "GenSigTimeoutTime_ADCAM" SG_ 1055 MAP_4_BAR 0;
BA_ "GenSigTimeoutTime_EVCU2" SG_ 1055 MAP_4_BAR 0;
BA_ "GenSigTimeoutTime_VDCM" SG_ 1055 MAP_4_BAR 0;
BA_ "GenSigTimeoutTime_BSM" SG_ 1055 MAP_4_BAR 0;
BA_ "GenSigTimeoutTime_ADCAM" SG_ 1055 MdsAct 0;
BA_ "GenSigTimeoutTime_EVCU2" SG_ 1055 MdsAct 0;
BA_ "GenSigTimeoutTime_VDCM" SG_ 1055 MdsAct 0;
BA_ "GenSigTimeoutTime_TCM" SG_ 1055 MdsAct 0;
BA_ "GenSigTimeoutTime_AGSM" SG_ 1055 MdsActforANC 0;
BA_ "GenSigTimeoutTime_ASBS" SG_ 1055 MdsActforANC 0;
BA_ "GenSigTimeoutTime_BSM" SG_ 1055 MdsActforANC 0;
BA_ "GenSigTimeoutTime_CADM" SG_ 1055 MdsActforANC 0;
BA_ "GenSigTimeoutTime_DMSM" SG_ 1055 MdsActforANC 0;
BA_ "GenSigTimeoutTime_DTCM" SG_ 1055 MdsActforANC 0;
BA_ "GenSigTimeoutTime_ECM" SG_ 1055 MdsActforANC 0;
BA_ "GenSigTimeoutTime_ELSDM" SG_ 1055 MdsActforANC 0;
BA_ "GenSigTimeoutTime_ESL" SG_ 1055 MdsActforANC 0;
BA_ "GenSigTimeoutTime_GNMM" SG_ 1055 MdsActforANC 0;
BA_ "GenSigTimeoutTime_HCP" SG_ 1055 MdsActforANC 0;
BA_ "GenSigTimeoutTime_IPC" SG_ 1055 MdsActforANC 0;
BA_ "GenSigTimeoutTime_RFHM" SG_ 1055 MdsActforANC 0;
BA_ "GenSigTimeoutTime_SGW" SG_ 1055 MdsActforANC 0;
BA_ "GenSigTimeoutTime_TCM" SG_ 1055 MdsActforANC 0;
BA_ "GenSigStartValue" SG_ 1055 OIL_PRESS 255;
BA_ "GenSigTimeoutTime_AGSM" SG_ 1055 OIL_PRESS 0;
BA_ "GenSigTimeoutTime_ASBS" SG_ 1055 OIL_PRESS 0;
BA_ "GenSigTimeoutTime_BCM" SG_ 1055 OIL_PRESS 0;
BA_ "GenSigTimeoutTime_BSM" SG_ 1055 OIL_PRESS 0;
BA_ "GenSigTimeoutTime_CADM" SG_ 1055 OIL_PRESS 0;
BA_ "GenSigTimeoutTime_DMSM" SG_ 1055 OIL_PRESS 0;
BA_ "GenSigTimeoutTime_DTCM" SG_ 1055 OIL_PRESS 0;
BA_ "GenSigTimeoutTime_ECM" SG_ 1055 OIL_PRESS 0;
BA_ "GenSigTimeoutTime_ELSDM" SG_ 1055 OIL_PRESS 0;
BA_ "GenSigTimeoutTime_ESL" SG_ 1055 OIL_PRESS 0;
BA_ "GenSigTimeoutTime_GNMM" SG_ 1055 OIL_PRESS 0;
BA_ "GenSigTimeoutTime_HCP" SG_ 1055 OIL_PRESS 0;
BA_ "GenSigTimeoutTime_RFHM" SG_ 1055 OIL_PRESS 0;
BA_ "GenSigTimeoutTime_TCM" SG_ 1055 OIL_PRESS 0;
BA_ "GenSigTimeoutTime_AGSM" SG_ 1055 RefuelEvent 0;
BA_ "GenSigTimeoutTime_ASBS" SG_ 1055 RefuelEvent 0;
BA_ "GenSigTimeoutTime_BSM" SG_ 1055 RefuelEvent 0;
BA_ "GenSigTimeoutTime_CADM" SG_ 1055 RefuelEvent 0;
BA_ "GenSigTimeoutTime_DMSM" SG_ 1055 RefuelEvent 0;
BA_ "GenSigTimeoutTime_DTCM" SG_ 1055 RefuelEvent 0;
BA_ "GenSigTimeoutTime_ECM" SG_ 1055 RefuelEvent 0;
BA_ "GenSigTimeoutTime_ELSDM" SG_ 1055 RefuelEvent 0;
BA_ "GenSigTimeoutTime_ESL" SG_ 1055 RefuelEvent 0;
BA_ "GenSigTimeoutTime_GNMM" SG_ 1055 RefuelEvent 0;
BA_ "GenSigTimeoutTime_HCP" SG_ 1055 RefuelEvent 0;
BA_ "GenSigTimeoutTime_IPC" SG_ 1055 RefuelEvent 0;
BA_ "GenSigTimeoutTime_RFHM" SG_ 1055 RefuelEvent 0;
BA_ "GenSigTimeoutTime_SGW" SG_ 1055 RefuelEvent 0;
BA_ "GenSigTimeoutTime_TCM" SG_ 1055 RefuelEvent 0;
BA_ "GenSigStartValue" SG_ 1055 RevOilLifeRst 65535;
BA_ "GenSigTimeoutTime_AGSM" SG_ 1055 RevOilLifeRst 0;
BA_ "GenSigTimeoutTime_ASBS" SG_ 1055 RevOilLifeRst 0;
BA_ "GenSigTimeoutTime_BSM" SG_ 1055 RevOilLifeRst 0;
BA_ "GenSigTimeoutTime_CADM" SG_ 1055 RevOilLifeRst 0;
BA_ "GenSigTimeoutTime_DMSM" SG_ 1055 RevOilLifeRst 0;
BA_ "GenSigTimeoutTime_DTCM" SG_ 1055 RevOilLifeRst 0;
BA_ "GenSigTimeoutTime_ECM" SG_ 1055 RevOilLifeRst 0;
BA_ "GenSigTimeoutTime_ELSDM" SG_ 1055 RevOilLifeRst 0;
BA_ "GenSigTimeoutTime_ESL" SG_ 1055 RevOilLifeRst 0;
BA_ "GenSigTimeoutTime_GNMM" SG_ 1055 RevOilLifeRst 0;
BA_ "GenSigTimeoutTime_HCP" SG_ 1055 RevOilLifeRst 0;
BA_ "GenSigTimeoutTime_IPC" SG_ 1055 RevOilLifeRst 0;
BA_ "GenSigTimeoutTime_RFHM" SG_ 1055 RevOilLifeRst 0;
BA_ "GenSigTimeoutTime_SGW" SG_ 1055 RevOilLifeRst 0;
BA_ "GenSigTimeoutTime_TCM" SG_ 1055 RevOilLifeRst 0;
BA_ "GenSigTimeoutTime_AGSM" SG_ 1055 MessageCounter_ENGINE8 0;
BA_ "GenSigTimeoutTime_ASBS" SG_ 1055 MessageCounter_ENGINE8 0;
BA_ "GenSigTimeoutTime_BCM" SG_ 1055 MessageCounter_ENGINE8 0;
BA_ "GenSigTimeoutTime_BSM" SG_ 1055 MessageCounter_ENGINE8 0;
BA_ "GenSigTimeoutTime_CADM" SG_ 1055 MessageCounter_ENGINE8 0;
BA_ "GenSigTimeoutTime_DMSM" SG_ 1055 MessageCounter_ENGINE8 0;
BA_ "GenSigTimeoutTime_DTCM" SG_ 1055 MessageCounter_ENGINE8 0;
BA_ "GenSigTimeoutTime_ECM" SG_ 1055 MessageCounter_ENGINE8 0;
BA_ "GenSigTimeoutTime_ELSDM" SG_ 1055 MessageCounter_ENGINE8 0;
BA_ "GenSigTimeoutTime_ESL" SG_ 1055 MessageCounter_ENGINE8 0;
BA_ "GenSigTimeoutTime_GNMM" SG_ 1055 MessageCounter_ENGINE8 0;
BA_ "GenSigTimeoutTime_IPC" SG_ 1055 MessageCounter_ENGINE8 0;
BA_ "GenSigTimeoutTime_RFHM" SG_ 1055 MessageCounter_ENGINE8 0;
BA_ "GenSigTimeoutTime_SGW" SG_ 1055 MessageCounter_ENGINE8 0;
BA_ "GenSigTimeoutTime_AGSM" SG_ 1055 AM_ECM_Prsnt 0;
BA_ "GenSigTimeoutTime_ASBS" SG_ 1055 AM_ECM_Prsnt 0;
BA_ "GenSigTimeoutTime_BSM" SG_ 1055 AM_ECM_Prsnt 0;
BA_ "GenSigTimeoutTime_CADM" SG_ 1055 AM_ECM_Prsnt 0;
BA_ "GenSigTimeoutTime_DMSM" SG_ 1055 AM_ECM_Prsnt 0;
BA_ "GenSigTimeoutTime_DTCM" SG_ 1055 AM_ECM_Prsnt 0;
BA_ "GenSigTimeoutTime_ECM" SG_ 1055 AM_ECM_Prsnt 0;
BA_ "GenSigTimeoutTime_ELSDM" SG_ 1055 AM_ECM_Prsnt 0;
BA_ "GenSigTimeoutTime_ESL" SG_ 1055 AM_ECM_Prsnt 0;
BA_ "GenSigTimeoutTime_GNMM" SG_ 1055 AM_ECM_Prsnt 0;
BA_ "GenSigTimeoutTime_HCP" SG_ 1055 AM_ECM_Prsnt 0;
BA_ "GenSigTimeoutTime_IPC" SG_ 1055 AM_ECM_Prsnt 0;
BA_ "GenSigTimeoutTime_RFHM" SG_ 1055 AM_ECM_Prsnt 0;
BA_ "GenSigTimeoutTime_SGW" SG_ 1055 AM_ECM_Prsnt 0;
BA_ "GenSigTimeoutTime_TCM" SG_ 1055 AM_ECM_Prsnt 0;
BA_ "GenSigTimeoutTime_AGSM" SG_ 1055 ENGINE_RESET 0;
BA_ "GenSigTimeoutTime_ASBS" SG_ 1055 ENGINE_RESET 0;
BA_ "GenSigTimeoutTime_BCM" SG_ 1055 ENGINE_RESET 0;
BA_ "GenSigTimeoutTime_BSM" SG_ 1055 ENGINE_RESET 0;
BA_ "GenSigTimeoutTime_CADM" SG_ 1055 ENGINE_RESET 0;
BA_ "GenSigTimeoutTime_DMSM" SG_ 1055 ENGINE_RESET 0;
BA_ "GenSigTimeoutTime_DTCM" SG_ 1055 ENGINE_RESET 0;
BA_ "GenSigTimeoutTime_ECM" SG_ 1055 ENGINE_RESET 0;
BA_ "GenSigTimeoutTime_ELSDM" SG_ 1055 ENGINE_RESET 0;
BA_ "GenSigTimeoutTime_ESL" SG_ 1055 ENGINE_RESET 0;
BA_ "GenSigTimeoutTime_GNMM" SG_ 1055 ENGINE_RESET 0;
BA_ "GenSigTimeoutTime_IPC" SG_ 1055 ENGINE_RESET 0;
BA_ "GenSigTimeoutTime_RFHM" SG_ 1055 ENGINE_RESET 0;
BA_ "GenSigTimeoutTime_SGW" SG_ 1055 ENGINE_RESET 0;
BA_ "GenSigTimeoutTime_TCM" SG_ 1055 ENGINE_RESET 0;
BA_ "GenSigTimeoutTime_AGSM" SG_ 1055 GF_Charge 0;
BA_ "GenSigTimeoutTime_ASBS" SG_ 1055 GF_Charge 0;
BA_ "GenSigTimeoutTime_BSM" SG_ 1055 GF_Charge 0;
BA_ "GenSigTimeoutTime_CADM" SG_ 1055 GF_Charge 0;
BA_ "GenSigTimeoutTime_DMSM" SG_ 1055 GF_Charge 0;
BA_ "GenSigTimeoutTime_DTCM" SG_ 1055 GF_Charge 0;
BA_ "GenSigTimeoutTime_ECM" SG_ 1055 GF_Charge 0;
BA_ "GenSigTimeoutTime_ELSDM" SG_ 1055 GF_Charge 0;
BA_ "GenSigTimeoutTime_ESL" SG_ 1055 GF_Charge 0;
BA_ "GenSigTimeoutTime_GNMM" SG_ 1055 GF_Charge 0;
BA_ "GenSigTimeoutTime_HCP" SG_ 1055 GF_Charge 0;
BA_ "GenSigTimeoutTime_IPC" SG_ 1055 GF_Charge 0;
BA_ "GenSigTimeoutTime_RFHM" SG_ 1055 GF_Charge 0;
BA_ "GenSigTimeoutTime_TCM" SG_ 1055 GF_Charge 0;
BA_ "GenSigStartValue" SG_ 1055 MAP_4_BAR 511;
BA_ "GenSigTimeoutTime_AGSM" SG_ 1055 MAP_4_BAR 0;
BA_ "GenSigTimeoutTime_ASBS" SG_ 1055 MAP_4_BAR 0;
BA_ "GenSigTimeoutTime_CADM" SG_ 1055 MAP_4_BAR 0;
BA_ "GenSigTimeoutTime_DMSM" SG_ 1055 MAP_4_BAR 0;
BA_ "GenSigTimeoutTime_DTCM" SG_ 1055 MAP_4_BAR 0;
BA_ "GenSigTimeoutTime_ECM" SG_ 1055 MAP_4_BAR 0;
BA_ "GenSigTimeoutTime_ELSDM" SG_ 1055 MAP_4_BAR 0;
BA_ "GenSigTimeoutTime_ESL" SG_ 1055 MAP_4_BAR 0;
BA_ "GenSigTimeoutTime_GNMM" SG_ 1055 MAP_4_BAR 0;
BA_ "GenSigTimeoutTime_HCP" SG_ 1055 MAP_4_BAR 0;
BA_ "GenSigTimeoutTime_IPC" SG_ 1055 MAP_4_BAR 0;
BA_ "GenSigTimeoutTime_RFHM" SG_ 1055 MAP_4_BAR 0;
BA_ "GenSigTimeoutTime_TCM" SG_ 1055 MAP_4_BAR 0;
BA_ "GenSigTimeoutTime_AGSM" SG_ 1055 MdsAct 0;
BA_ "GenSigTimeoutTime_ASBS" SG_ 1055 MdsAct 0;
BA_ "GenSigTimeoutTime_BCM" SG_ 1055 MdsAct 0;
BA_ "GenSigTimeoutTime_BSM" SG_ 1055 MdsAct 0;
BA_ "GenSigTimeoutTime_CADM" SG_ 1055 MdsAct 0;
BA_ "GenSigTimeoutTime_DMSM" SG_ 1055 MdsAct 0;
BA_ "GenSigTimeoutTime_DTCM" SG_ 1055 MdsAct 0;
BA_ "GenSigTimeoutTime_ECM" SG_ 1055 MdsAct 0;
BA_ "GenSigTimeoutTime_ELSDM" SG_ 1055 MdsAct 0;
BA_ "GenSigTimeoutTime_ESL" SG_ 1055 MdsAct 0;
BA_ "GenSigTimeoutTime_GNMM" SG_ 1055 MdsAct 0;
BA_ "GenSigTimeoutTime_HCP" SG_ 1055 MdsAct 0;
BA_ "GenSigTimeoutTime_RFHM" SG_ 1055 MdsAct 0;
BA_ "GenSigTimeoutTime_AGSM" SG_ 1055 PCPM_PumpSpeedAct 0;
BA_ "GenSigTimeoutTime_ASBS" SG_ 1055 PCPM_PumpSpeedAct 0;
BA_ "GenSigTimeoutTime_BCM" SG_ 1055 PCPM_PumpSpeedAct 0;
BA_ "GenSigTimeoutTime_BSM" SG_ 1055 PCPM_PumpSpeedAct 0;
BA_ "GenSigTimeoutTime_CADM" SG_ 1055 PCPM_PumpSpeedAct 0;
BA_ "GenSigTimeoutTime_DMSM" SG_ 1055 PCPM_PumpSpeedAct 0;
BA_ "GenSigTimeoutTime_DTCM" SG_ 1055 PCPM_PumpSpeedAct 0;
BA_ "GenSigTimeoutTime_ECM" SG_ 1055 PCPM_PumpSpeedAct 0;
BA_ "GenSigTimeoutTime_ELSDM" SG_ 1055 PCPM_PumpSpeedAct 0;
BA_ "GenSigTimeoutTime_ESL" SG_ 1055 PCPM_PumpSpeedAct 0;
BA_ "GenSigTimeoutTime_GNMM" SG_ 1055 PCPM_PumpSpeedAct 0;
BA_ "GenSigTimeoutTime_HCP" SG_ 1055 PCPM_PumpSpeedAct 0;
BA_ "GenSigTimeoutTime_IPC" SG_ 1055 PCPM_PumpSpeedAct 0;
BA_ "GenSigTimeoutTime_RFHM" SG_ 1055 PCPM_PumpSpeedAct 0;
BA_ "GenSigTimeoutTime_SGW" SG_ 1055 PCPM_PumpSpeedAct 0;
BA_ "GenSigTimeoutTime_TCM" SG_ 1055 PCPM_PumpSpeedAct 0;
BA_ "GenSigTimeoutTime_AGSM" SG_ 1055 RefuelIndication 0;
BA_ "GenSigTimeoutTime_ASBS" SG_ 1055 RefuelIndication 0;
BA_ "GenSigTimeoutTime_BCM" SG_ 1055 RefuelIndication 0;
BA_ "GenSigTimeoutTime_BSM" SG_ 1055 RefuelIndication 0;
BA_ "GenSigTimeoutTime_CADM" SG_ 1055 RefuelIndication 0;
BA_ "GenSigTimeoutTime_DMSM" SG_ 1055 RefuelIndication 0;
BA_ "GenSigTimeoutTime_DTCM" SG_ 1055 RefuelIndication 0;
BA_ "GenSigTimeoutTime_ECM" SG_ 1055 RefuelIndication 0;
BA_ "GenSigTimeoutTime_ELSDM" SG_ 1055 RefuelIndication 0;
BA_ "GenSigTimeoutTime_ESL" SG_ 1055 RefuelIndication 0;
BA_ "GenSigTimeoutTime_GNMM" SG_ 1055 RefuelIndication 0;
BA_ "GenSigTimeoutTime_HCP" SG_ 1055 RefuelIndication 0;
BA_ "GenSigTimeoutTime_RFHM" SG_ 1055 RefuelIndication 0;
BA_ "GenSigTimeoutTime_SGW" SG_ 1055 RefuelIndication 0;
BA_ "GenSigTimeoutTime_TCM" SG_ 1055 RefuelIndication 0;
BA_ "GenSigTimeoutTime_AGSM" SG_ 1055 CRC_ENGINE8 0;
BA_ "GenSigTimeoutTime_ASBS" SG_ 1055 CRC_ENGINE8 0;
BA_ "GenSigTimeoutTime_BCM" SG_ 1055 CRC_ENGINE8 0;
BA_ "GenSigTimeoutTime_BSM" SG_ 1055 CRC_ENGINE8 0;
BA_ "GenSigTimeoutTime_CADM" SG_ 1055 CRC_ENGINE8 0;
BA_ "GenSigTimeoutTime_DMSM" SG_ 1055 CRC_ENGINE8 0;
BA_ "GenSigTimeoutTime_DTCM" SG_ 1055 CRC_ENGINE8 0;
BA_ "GenSigTimeoutTime_ECM" SG_ 1055 CRC_ENGINE8 0;
BA_ "GenSigTimeoutTime_ELSDM" SG_ 1055 CRC_ENGINE8 0;
BA_ "GenSigTimeoutTime_ESL" SG_ 1055 CRC_ENGINE8 0;
BA_ "GenSigTimeoutTime_GNMM" SG_ 1055 CRC_ENGINE8 0;
BA_ "GenSigTimeoutTime_IPC" SG_ 1055 CRC_ENGINE8 0;
BA_ "GenSigTimeoutTime_RFHM" SG_ 1055 CRC_ENGINE8 0;
BA_ "GenSigTimeoutTime_SGW" SG_ 1055 CRC_ENGINE8 0;
BA_ "GenSigTimeoutTime_ADCAM" SG_ 259 RHF_WheelSensorFailSts 0;
BA_ "GenSigTimeoutTime_AGSM" SG_ 259 RHF_WheelSensorFailSts 0;
BA_ "GenSigTimeoutTime_BSM" SG_ 259 RHF_WheelSensorFailSts 0;
BA_ "GenSigTimeoutTime_ESL" SG_ 259 RHF_WheelSensorFailSts 0;
BA_ "GenSigTimeoutTime_IPC" SG_ 259 RHF_WheelSensorFailSts 0;
BA_ "GenSigTimeoutTime_RFHM" SG_ 259 RHF_WheelSensorFailSts 0;
BA_ "GenSigTimeoutTime_TCM" SG_ 259 RHF_WheelSensorFailSts 0;
BA_ "GenSigTimeoutTime_ADCAM" SG_ 259 LHF_WheelSensorFailSts 0;
BA_ "GenSigTimeoutTime_AGSM" SG_ 259 LHF_WheelSensorFailSts 0;
BA_ "GenSigTimeoutTime_BSM" SG_ 259 LHF_WheelSensorFailSts 0;
BA_ "GenSigTimeoutTime_ESL" SG_ 259 LHF_WheelSensorFailSts 0;
BA_ "GenSigTimeoutTime_IPC" SG_ 259 LHF_WheelSensorFailSts 0;
BA_ "GenSigTimeoutTime_RFHM" SG_ 259 LHF_WheelSensorFailSts 0;
BA_ "GenSigTimeoutTime_TCM" SG_ 259 LHF_WheelSensorFailSts 0;
BA_ "GenSigTimeoutTime_ADCAM" SG_ 259 RHR_WheelSensorFailSts 0;
BA_ "GenSigTimeoutTime_AGSM" SG_ 259 RHR_WheelSensorFailSts 0;
BA_ "GenSigTimeoutTime_BSM" SG_ 259 RHR_WheelSensorFailSts 0;
BA_ "GenSigTimeoutTime_ESL" SG_ 259 RHR_WheelSensorFailSts 0;
BA_ "GenSigTimeoutTime_IPC" SG_ 259 RHR_WheelSensorFailSts 0;
BA_ "GenSigTimeoutTime_RFHM" SG_ 259 RHR_WheelSensorFailSts 0;
BA_ "GenSigTimeoutTime_TCM" SG_ 259 RHR_WheelSensorFailSts 0;
BA_ "GenSigTimeoutTime_ADCAM" SG_ 259 LHR_WheelSensorFailSts 0;
BA_ "GenSigTimeoutTime_AGSM" SG_ 259 LHR_WheelSensorFailSts 0;
BA_ "GenSigTimeoutTime_BSM" SG_ 259 LHR_WheelSensorFailSts 0;
BA_ "GenSigTimeoutTime_ESL" SG_ 259 LHR_WheelSensorFailSts 0;
BA_ "GenSigTimeoutTime_IPC" SG_ 259 LHR_WheelSensorFailSts 0;
BA_ "GenSigTimeoutTime_RFHM" SG_ 259 LHR_WheelSensorFailSts 0;
BA_ "GenSigTimeoutTime_TCM" SG_ 259 LHR_WheelSensorFailSts 0;
BA_ "GenSigTimeoutTime_ADCAM" SG_ 259 CRC__BRAKE3 0;
BA_ "GenSigTimeoutTime_ADCAM" SG_ 259 LHFWheelSpeed 0;
BA_ "GenSigTimeoutTime_ADCAM" SG_ 259 LHRWheelSpeed 0;
BA_ "GenSigTimeoutTime_ADCAM" SG_ 259 MessageCounter_BRAKE3 0;
BA_ "GenSigTimeoutTime_ASBS" SG_ 1155 MessageCounter_BRAKE5 0;
BA_ "GenSigTimeoutTime_BCM" SG_ 1155 MessageCounter_BRAKE5 0;
BA_ "GenSigTimeoutTime_BSM" SG_ 1155 MessageCounter_BRAKE5 0;
BA_ "GenSigTimeoutTime_CADM" SG_ 1155 MessageCounter_BRAKE5 0;
BA_ "GenSigTimeoutTime_DMSM" SG_ 1155 MessageCounter_BRAKE5 0;
BA_ "GenSigTimeoutTime_ELSDM" SG_ 1155 MessageCounter_BRAKE5 0;
BA_ "GenSigTimeoutTime_ESL" SG_ 1155 MessageCounter_BRAKE5 0;
BA_ "GenSigTimeoutTime_GNMM" SG_ 1155 MessageCounter_BRAKE5 0;
BA_ "GenSigTimeoutTime_HCP" SG_ 1155 MessageCounter_BRAKE5 0;
BA_ "GenSigTimeoutTime_IPC" SG_ 1155 MessageCounter_BRAKE5 0;
BA_ "GenSigTimeoutTime_RFHM" SG_ 1155 MessageCounter_BRAKE5 0;
BA_ "GenSigTimeoutTime_SGW" SG_ 1155 MessageCounter_BRAKE5 0;
BA_ "GenSigSendType" SG_ 1155 ABSFailSts 3;
BA_ "GenSigTimeoutTime_AGSM" SG_ 1155 ABSFailSts 0;
BA_ "GenSigTimeoutTime_ASBS" SG_ 1155 ABSFailSts 0;
BA_ "GenSigTimeoutTime_BSM" SG_ 1155 ABSFailSts 0;
BA_ "GenSigTimeoutTime_CADM" SG_ 1155 ABSFailSts 0;
BA_ "GenSigTimeoutTime_DMSM" SG_ 1155 ABSFailSts 0;
BA_ "GenSigTimeoutTime_DTCM" SG_ 1155 ABSFailSts 0;
BA_ "GenSigTimeoutTime_ELSDM" SG_ 1155 ABSFailSts 0;
BA_ "GenSigTimeoutTime_ESL" SG_ 1155 ABSFailSts 0;
BA_ "GenSigTimeoutTime_GNMM" SG_ 1155 ABSFailSts 0;
BA_ "GenSigTimeoutTime_HCP" SG_ 1155 ABSFailSts 0;
BA_ "GenSigTimeoutTime_RFHM" SG_ 1155 ABSFailSts 0;
BA_ "GenSigTimeoutTime_TCM" SG_ 1155 ABSFailSts 0;
BA_ "GenSigSendType" SG_ 1155 ACCEngaged 3;
BA_ "GenSigTimeoutTime_AGSM" SG_ 1155 ACCEngaged 0;
BA_ "GenSigTimeoutTime_ASBS" SG_ 1155 ACCEngaged 0;
BA_ "GenSigTimeoutTime_BCM" SG_ 1155 ACCEngaged 0;
BA_ "GenSigTimeoutTime_BSM" SG_ 1155 ACCEngaged 0;
BA_ "GenSigTimeoutTime_CADM" SG_ 1155 ACCEngaged 0;
BA_ "GenSigTimeoutTime_DMSM" SG_ 1155 ACCEngaged 0;
BA_ "GenSigTimeoutTime_ELSDM" SG_ 1155 ACCEngaged 0;
BA_ "GenSigTimeoutTime_ESL" SG_ 1155 ACCEngaged 0;
BA_ "GenSigTimeoutTime_GNMM" SG_ 1155 ACCEngaged 0;
BA_ "GenSigTimeoutTime_IPC" SG_ 1155 ACCEngaged 0;
BA_ "GenSigTimeoutTime_RFHM" SG_ 1155 ACCEngaged 0;
BA_ "GenSigSendType" SG_ 1155 ESCFailSts 3;
BA_ "GenSigTimeoutTime_AGSM" SG_ 1155 ESCFailSts 0;
BA_ "GenSigTimeoutTime_ASBS" SG_ 1155 ESCFailSts 0;
BA_ "GenSigTimeoutTime_BSM" SG_ 1155 ESCFailSts 0;
BA_ "GenSigTimeoutTime_CADM" SG_ 1155 ESCFailSts 0;
BA_ "GenSigTimeoutTime_DMSM" SG_ 1155 ESCFailSts 0;
BA_ "GenSigTimeoutTime_DTCM" SG_ 1155 ESCFailSts 0;
BA_ "GenSigTimeoutTime_ELSDM" SG_ 1155 ESCFailSts 0;
BA_ "GenSigTimeoutTime_ESL" SG_ 1155 ESCFailSts 0;
BA_ "GenSigTimeoutTime_GNMM" SG_ 1155 ESCFailSts 0;
BA_ "GenSigTimeoutTime_RFHM" SG_ 1155 ESCFailSts 0;
BA_ "GenSigTimeoutTime_TCM" SG_ 1155 ESCFailSts 0;
BA_ "GenSigSendType" SG_ 1155 RollsModeAct 3;
BA_ "GenSigTimeoutTime_AGSM" SG_ 1155 RollsModeAct 0;
BA_ "GenSigTimeoutTime_ASBS" SG_ 1155 RollsModeAct 0;
BA_ "GenSigTimeoutTime_BCM" SG_ 1155 RollsModeAct 0;
BA_ "GenSigTimeoutTime_BSM" SG_ 1155 RollsModeAct 0;
BA_ "GenSigTimeoutTime_CADM" SG_ 1155 RollsModeAct 0;
BA_ "GenSigTimeoutTime_DMSM" SG_ 1155 RollsModeAct 0;
BA_ "GenSigTimeoutTime_ELSDM" SG_ 1155 RollsModeAct 0;
BA_ "GenSigTimeoutTime_ESL" SG_ 1155 RollsModeAct 0;
BA_ "GenSigTimeoutTime_GNMM" SG_ 1155 RollsModeAct 0;
BA_ "GenSigTimeoutTime_HCP" SG_ 1155 RollsModeAct 0;
BA_ "GenSigTimeoutTime_IPC" SG_ 1155 RollsModeAct 0;
BA_ "GenSigTimeoutTime_RFHM" SG_ 1155 RollsModeAct 0;
BA_ "GenSigTimeoutTime_SGW" SG_ 1155 RollsModeAct 0;
BA_ "GenSigTimeoutTime_TCM" SG_ 1155 RollsModeAct 0;
BA_ "GenSigTimeoutTime_ADCAM" SG_ 514 BrkPdl_Flt 0;
BA_ "GenSigTimeoutTime_VDCM" SG_ 514 BrkPdl_Flt 0;
BA_ "GenSigTimeoutTime_ADCAM" SG_ 514 BrkPdl_Stat 0;
BA_ "GenSigTimeoutTime_ADCAM" SG_ 514 BSM_ReadyForESS 0;
BA_ "GenSigTimeoutTime_EVCU2" SG_ 514 BSM_ReadyForESS 0;
BA_ "GenSigTimeoutTime_VDCM" SG_ 514 BSM_ReadyForESS 0;
BA_ "GenSigTimeoutTime_ADCAM" SG_ 514 BrakePdlPosn 0;
BA_ "GenSigTimeoutTime_VDCM" SG_ 514 BrakePdlPosn 0;
BA_ "GenSigTimeoutTime_BSM" SG_ 517 DrvLnTrqRq 0;
BA_ "GenSigTimeoutTime_CADM" SG_ 517 DrvLnTrqRq 0;
BA_ "GenSigTimeoutTime_DMSM" SG_ 517 DrvLnTrqRq 0;
BA_ "GenSigTimeoutTime_DTCM" SG_ 517 DrvLnTrqRq 0;
BA_ "GenSigTimeoutTime_ELSDM" SG_ 517 DrvLnTrqRq 0;
BA_ "GenSigTimeoutTime_ESL" SG_ 517 DrvLnTrqRq 0;
BA_ "GenSigTimeoutTime_GNMM" SG_ 517 DrvLnTrqRq 0;
BA_ "GenSigTimeoutTime_HCP" SG_ 517 DrvLnTrqRq 0;
BA_ "GenSigTimeoutTime_IPC" SG_ 517 DrvLnTrqRq 0;
BA_ "GenSigTimeoutTime_RFHM" SG_ 517 DrvLnTrqRq 0;
BA_ "GenSigTimeoutTime_SGW" SG_ 517 DrvLnTrqRq 0;
BA_ "GenSigTimeoutTime_TCM" SG_ 517 DrvLnTrqRq 0;
BA_ "GenSigSendType" SG_ 1068 TCASERANGESTATUS 3;
BA_ "GenSigTimeoutTime_AGSM" SG_ 1068 TCASERANGESTATUS 0;
BA_ "GenSigTimeoutTime_ASBS" SG_ 1068 TCASERANGESTATUS 0;
BA_ "GenSigTimeoutTime_DMSM" SG_ 1068 TCASERANGESTATUS 0;
BA_ "GenSigTimeoutTime_DTCM" SG_ 1068 TCASERANGESTATUS 0;
BA_ "GenSigTimeoutTime_ELSDM" SG_ 1068 TCASERANGESTATUS 0;
BA_ "GenSigTimeoutTime_ESL" SG_ 1068 TCASERANGESTATUS 0;
BA_ "GenSigTimeoutTime_GNMM" SG_ 1068 TCASERANGESTATUS 0;
BA_ "GenSigTimeoutTime_RFHM" SG_ 1068 TCASERANGESTATUS 0;
BA_ "GenSigTimeoutTime_AGSM" SG_ 1068 CRC__DRIVETRAIN3 0;
BA_ "GenSigTimeoutTime_ASBS" SG_ 1068 CRC__DRIVETRAIN3 0;
BA_ "GenSigTimeoutTime_DMSM" SG_ 1068 CRC__DRIVETRAIN3 0;
BA_ "GenSigTimeoutTime_DTCM" SG_ 1068 CRC__DRIVETRAIN3 0;
BA_ "GenSigTimeoutTime_ELSDM" SG_ 1068 CRC__DRIVETRAIN3 0;
BA_ "GenSigTimeoutTime_ESL" SG_ 1068 CRC__DRIVETRAIN3 0;
BA_ "GenSigTimeoutTime_GNMM" SG_ 1068 CRC__DRIVETRAIN3 0;
BA_ "GenSigTimeoutTime_HCP" SG_ 1068 CRC__DRIVETRAIN3 0;
BA_ "GenSigTimeoutTime_IPC" SG_ 1068 CRC__DRIVETRAIN3 0;
BA_ "GenSigTimeoutTime_RFHM" SG_ 1068 CRC__DRIVETRAIN3 0;
BA_ "GenSigTimeoutTime_SGW" SG_ 1068 CRC__DRIVETRAIN3 0;
BA_ "GenSigTimeoutTime_AGSM" SG_ 1068 MessageCounter_DRIVETRAIN3 0;
BA_ "GenSigTimeoutTime_ASBS" SG_ 1068 MessageCounter_DRIVETRAIN3 0;
BA_ "GenSigTimeoutTime_DMSM" SG_ 1068 MessageCounter_DRIVETRAIN3 0;
BA_ "GenSigTimeoutTime_DTCM" SG_ 1068 MessageCounter_DRIVETRAIN3 0;
BA_ "GenSigTimeoutTime_ELSDM" SG_ 1068 MessageCounter_DRIVETRAIN3 0;
BA_ "GenSigTimeoutTime_ESL" SG_ 1068 MessageCounter_DRIVETRAIN3 0;
BA_ "GenSigTimeoutTime_GNMM" SG_ 1068 MessageCounter_DRIVETRAIN3 0;
BA_ "GenSigTimeoutTime_HCP" SG_ 1068 MessageCounter_DRIVETRAIN3 0;
BA_ "GenSigTimeoutTime_IPC" SG_ 1068 MessageCounter_DRIVETRAIN3 0;
BA_ "GenSigTimeoutTime_RFHM" SG_ 1068 MessageCounter_DRIVETRAIN3 0;
BA_ "GenSigTimeoutTime_SGW" SG_ 1068 MessageCounter_DRIVETRAIN3 0;
BA_ "GenSigTimeoutTime_ADCAM" SG_ 259 RHRWheelSpeed 0;
BA_ "GenSigTimeoutTime_AGSM" SG_ 259 CRC__BRAKE3 0;
BA_ "GenSigTimeoutTime_ASBS" SG_ 259 CRC__BRAKE3 0;
BA_ "GenSigTimeoutTime_BSM" SG_ 259 CRC__BRAKE3 0;
BA_ "GenSigTimeoutTime_DMSM" SG_ 259 CRC__BRAKE3 0;
BA_ "GenSigTimeoutTime_ESL" SG_ 259 CRC__BRAKE3 0;
BA_ "GenSigTimeoutTime_IPC" SG_ 259 CRC__BRAKE3 0;
BA_ "GenSigTimeoutTime_RFHM" SG_ 259 CRC__BRAKE3 0;
BA_ "GenSigTimeoutTime_SGW" SG_ 259 CRC__BRAKE3 0;
BA_ "GenSigTimeoutTime_AGSM" SG_ 259 LHFWheelSpeed 0;
BA_ "GenSigTimeoutTime_ASBS" SG_ 259 LHFWheelSpeed 0;
BA_ "GenSigTimeoutTime_BSM" SG_ 259 LHFWheelSpeed 0;
BA_ "GenSigTimeoutTime_DMSM" SG_ 259 LHFWheelSpeed 0;
BA_ "GenSigTimeoutTime_ELSDM" SG_ 259 LHFWheelSpeed 0;
BA_ "GenSigTimeoutTime_ESL" SG_ 259 LHFWheelSpeed 0;
BA_ "GenSigTimeoutTime_IPC" SG_ 259 LHFWheelSpeed 0;
BA_ "GenSigTimeoutTime_RFHM" SG_ 259 LHFWheelSpeed 0;
BA_ "GenSigTimeoutTime_AGSM" SG_ 259 LHRWheelSpeed 0;
BA_ "GenSigTimeoutTime_ASBS" SG_ 259 LHRWheelSpeed 0;
BA_ "GenSigTimeoutTime_BSM" SG_ 259 LHRWheelSpeed 0;
BA_ "GenSigTimeoutTime_DMSM" SG_ 259 LHRWheelSpeed 0;
BA_ "GenSigTimeoutTime_ESL" SG_ 259 LHRWheelSpeed 0;
BA_ "GenSigTimeoutTime_IPC" SG_ 259 LHRWheelSpeed 0;
BA_ "GenSigTimeoutTime_RFHM" SG_ 259 LHRWheelSpeed 0;
BA_ "GenSigTimeoutTime_AGSM" SG_ 259 MessageCounter_BRAKE3 0;
BA_ "GenSigTimeoutTime_ASBS" SG_ 259 MessageCounter_BRAKE3 0;
BA_ "GenSigTimeoutTime_BSM" SG_ 259 MessageCounter_BRAKE3 0;
BA_ "GenSigTimeoutTime_DMSM" SG_ 259 MessageCounter_BRAKE3 0;
BA_ "GenSigTimeoutTime_ESL" SG_ 259 MessageCounter_BRAKE3 0;
BA_ "GenSigTimeoutTime_IPC" SG_ 259 MessageCounter_BRAKE3 0;
BA_ "GenSigTimeoutTime_RFHM" SG_ 259 MessageCounter_BRAKE3 0;
BA_ "GenSigTimeoutTime_SGW" SG_ 259 MessageCounter_BRAKE3 0;
BA_ "GenSigTimeoutTime_AGSM" SG_ 259 RHFWheelSpeed 0;
BA_ "GenSigTimeoutTime_ASBS" SG_ 259 RHFWheelSpeed 0;
BA_ "GenSigTimeoutTime_BSM" SG_ 259 RHFWheelSpeed 0;
BA_ "GenSigTimeoutTime_DMSM" SG_ 259 RHFWheelSpeed 0;
BA_ "GenSigTimeoutTime_ELSDM" SG_ 259 RHFWheelSpeed 0;
BA_ "GenSigTimeoutTime_ESL" SG_ 259 RHFWheelSpeed 0;
BA_ "GenSigTimeoutTime_IPC" SG_ 259 RHFWheelSpeed 0;
BA_ "GenSigTimeoutTime_RFHM" SG_ 259 RHFWheelSpeed 0;
BA_ "GenSigTimeoutTime_AGSM" SG_ 259 RHRWheelSpeed 0;
BA_ "GenSigTimeoutTime_ASBS" SG_ 259 RHRWheelSpeed 0;
BA_ "GenSigTimeoutTime_BSM" SG_ 259 RHRWheelSpeed 0;
BA_ "GenSigTimeoutTime_DMSM" SG_ 259 RHRWheelSpeed 0;
BA_ "GenSigTimeoutTime_ESL" SG_ 259 RHRWheelSpeed 0;
BA_ "GenSigTimeoutTime_IPC" SG_ 259 RHRWheelSpeed 0;
BA_ "GenSigTimeoutTime_RFHM" SG_ 259 RHRWheelSpeed 0;
BA_ "GenSigTimeoutTime_ADCAM" SG_ 609 CODE_CLR_BSM 0;
BA_ "GenSigTimeoutTime_EVCU2" SG_ 609 CODE_CLR_BSM 0;
BA_ "GenSigTimeoutTime_VDCM" SG_ 609 CODE_CLR_BSM 0;
BA_ "GenSigTimeoutTime_ADCAM" SG_ 609 CRC_BRAKE4 0;
BA_ "GenSigTimeoutTime_VDCM" SG_ 609 CRC_BRAKE4 0;
BA_ "GenSigTimeoutTime_ADCAM" SG_ 609 MessageCounter_BRAKE4 0;
BA_ "GenSigTimeoutTime_VDCM" SG_ 609 MessageCounter_BRAKE4 0;
BA_ "GenSigTimeoutTime_ADCAM" SG_ 609 REPRGD_PFC_CLR_BSM 0;
BA_ "GenSigTimeoutTime_EVCU2" SG_ 609 REPRGD_PFC_CLR_BSM 0;
BA_ "GenSigTimeoutTime_VDCM" SG_ 609 REPRGD_PFC_CLR_BSM 0;
BA_ "GenSigTimeoutTime_VDCM" SG_ 609 EPBSts 0;
BA_ "GenSigTimeoutTime_ADCAM" SG_ 609 TravelDistance 0;
BA_ "GenSigTimeoutTime_VDCM" SG_ 609 TravelDistance 0;
BA_ "GenSigTimeoutTime_AGSM" SG_ 609 CODE_CLR_BSM 0;
BA_ "GenSigTimeoutTime_ASBS" SG_ 609 CODE_CLR_BSM 0;
BA_ "GenSigTimeoutTime_BCM" SG_ 609 CODE_CLR_BSM 0;
BA_ "GenSigTimeoutTime_BSM" SG_ 609 CODE_CLR_BSM 0;
BA_ "GenSigTimeoutTime_CADM" SG_ 609 CODE_CLR_BSM 0;
BA_ "GenSigTimeoutTime_DMSM" SG_ 609 CODE_CLR_BSM 0;
BA_ "GenSigTimeoutTime_DTCM" SG_ 609 CODE_CLR_BSM 0;
BA_ "GenSigTimeoutTime_ELSDM" SG_ 609 CODE_CLR_BSM 0;
BA_ "GenSigTimeoutTime_ESL" SG_ 609 CODE_CLR_BSM 0;
BA_ "GenSigTimeoutTime_GNMM" SG_ 609 CODE_CLR_BSM 0;
BA_ "GenSigTimeoutTime_HCP" SG_ 609 CODE_CLR_BSM 0;
BA_ "GenSigTimeoutTime_IPC" SG_ 609 CODE_CLR_BSM 0;
BA_ "GenSigTimeoutTime_RFHM" SG_ 609 CODE_CLR_BSM 0;
BA_ "GenSigTimeoutTime_SGW" SG_ 609 CODE_CLR_BSM 0;
BA_ "GenSigTimeoutTime_TCM" SG_ 609 CODE_CLR_BSM 0;
BA_ "GenSigTimeoutTime_AGSM" SG_ 609 CRC_BRAKE4 0;
BA_ "GenSigTimeoutTime_ASBS" SG_ 609 CRC_BRAKE4 0;
BA_ "GenSigTimeoutTime_BSM" SG_ 609 CRC_BRAKE4 0;
BA_ "GenSigTimeoutTime_DMSM" SG_ 609 CRC_BRAKE4 0;
BA_ "GenSigTimeoutTime_DTCM" SG_ 609 CRC_BRAKE4 0;
BA_ "GenSigTimeoutTime_ELSDM" SG_ 609 CRC_BRAKE4 0;
BA_ "GenSigTimeoutTime_ESL" SG_ 609 CRC_BRAKE4 0;
BA_ "GenSigTimeoutTime_GNMM" SG_ 609 CRC_BRAKE4 0;
BA_ "GenSigTimeoutTime_IPC" SG_ 609 CRC_BRAKE4 0;
BA_ "GenSigTimeoutTime_RFHM" SG_ 609 CRC_BRAKE4 0;
BA_ "GenSigTimeoutTime_SGW" SG_ 609 CRC_BRAKE4 0;
BA_ "GenSigTimeoutTime_AGSM" SG_ 609 MessageCounter_BRAKE4 0;
BA_ "GenSigTimeoutTime_ASBS" SG_ 609 MessageCounter_BRAKE4 0;
BA_ "GenSigTimeoutTime_BSM" SG_ 609 MessageCounter_BRAKE4 0;
BA_ "GenSigTimeoutTime_DMSM" SG_ 609 MessageCounter_BRAKE4 0;
BA_ "GenSigTimeoutTime_DTCM" SG_ 609 MessageCounter_BRAKE4 0;
BA_ "GenSigTimeoutTime_ELSDM" SG_ 609 MessageCounter_BRAKE4 0;
BA_ "GenSigTimeoutTime_ESL" SG_ 609 MessageCounter_BRAKE4 0;
BA_ "GenSigTimeoutTime_GNMM" SG_ 609 MessageCounter_BRAKE4 0;
BA_ "GenSigTimeoutTime_IPC" SG_ 609 MessageCounter_BRAKE4 0;
BA_ "GenSigTimeoutTime_RFHM" SG_ 609 MessageCounter_BRAKE4 0;
BA_ "GenSigTimeoutTime_SGW" SG_ 609 MessageCounter_BRAKE4 0;
BA_ "GenSigSendType" SG_ 609 MIL_OnRq_BSM 3;
BA_ "GenSigTimeoutTime_AGSM" SG_ 609 MIL_OnRq_BSM 0;
BA_ "GenSigTimeoutTime_ASBS" SG_ 609 MIL_OnRq_BSM 0;
BA_ "GenSigTimeoutTime_BCM" SG_ 609 MIL_OnRq_BSM 0;
BA_ "GenSigTimeoutTime_BSM" SG_ 609 MIL_OnRq_BSM 0;
BA_ "GenSigTimeoutTime_CADM" SG_ 609 MIL_OnRq_BSM 0;
BA_ "GenSigTimeoutTime_DMSM" SG_ 609 MIL_OnRq_BSM 0;
BA_ "GenSigTimeoutTime_DTCM" SG_ 609 MIL_OnRq_BSM 0;
BA_ "GenSigTimeoutTime_ELSDM" SG_ 609 MIL_OnRq_BSM 0;
BA_ "GenSigTimeoutTime_ESL" SG_ 609 MIL_OnRq_BSM 0;
BA_ "GenSigTimeoutTime_GNMM" SG_ 609 MIL_OnRq_BSM 0;
BA_ "GenSigTimeoutTime_HCP" SG_ 609 MIL_OnRq_BSM 0;
BA_ "GenSigTimeoutTime_IPC" SG_ 609 MIL_OnRq_BSM 0;
BA_ "GenSigTimeoutTime_RFHM" SG_ 609 MIL_OnRq_BSM 0;
BA_ "GenSigTimeoutTime_TCM" SG_ 609 MIL_OnRq_BSM 0;
BA_ "GenSigTimeoutTime_AGSM" SG_ 609 REPRGD_PFC_CLR_BSM 0;
BA_ "GenSigTimeoutTime_ASBS" SG_ 609 REPRGD_PFC_CLR_BSM 0;
BA_ "GenSigTimeoutTime_BCM" SG_ 609 REPRGD_PFC_CLR_BSM 0;
BA_ "GenSigTimeoutTime_BSM" SG_ 609 REPRGD_PFC_CLR_BSM 0;
BA_ "GenSigTimeoutTime_CADM" SG_ 609 REPRGD_PFC_CLR_BSM 0;
BA_ "GenSigTimeoutTime_DMSM" SG_ 609 REPRGD_PFC_CLR_BSM 0;
BA_ "GenSigTimeoutTime_DTCM" SG_ 609 REPRGD_PFC_CLR_BSM 0;
BA_ "GenSigTimeoutTime_ELSDM" SG_ 609 REPRGD_PFC_CLR_BSM 0;
BA_ "GenSigTimeoutTime_ESL" SG_ 609 REPRGD_PFC_CLR_BSM 0;
BA_ "GenSigTimeoutTime_GNMM" SG_ 609 REPRGD_PFC_CLR_BSM 0;
BA_ "GenSigTimeoutTime_HCP" SG_ 609 REPRGD_PFC_CLR_BSM 0;
BA_ "GenSigTimeoutTime_IPC" SG_ 609 REPRGD_PFC_CLR_BSM 0;
BA_ "GenSigTimeoutTime_RFHM" SG_ 609 REPRGD_PFC_CLR_BSM 0;
BA_ "GenSigTimeoutTime_SGW" SG_ 609 REPRGD_PFC_CLR_BSM 0;
BA_ "GenSigTimeoutTime_TCM" SG_ 609 REPRGD_PFC_CLR_BSM 0;
BA_ "GenSigSendType" SG_ 609 EPBSts 3;
BA_ "GenSigTimeoutTime_AGSM" SG_ 609 EPBSts 0;
BA_ "GenSigTimeoutTime_ASBS" SG_ 609 EPBSts 0;
BA_ "GenSigTimeoutTime_BSM" SG_ 609 EPBSts 0;
BA_ "GenSigTimeoutTime_DMSM" SG_ 609 EPBSts 0;
BA_ "GenSigTimeoutTime_ELSDM" SG_ 609 EPBSts 0;
BA_ "GenSigTimeoutTime_ESL" SG_ 609 EPBSts 0;
BA_ "GenSigTimeoutTime_GNMM" SG_ 609 EPBSts 0;
BA_ "GenSigTimeoutTime_RFHM" SG_ 609 EPBSts 0;
BA_ "GenSigTimeoutTime_AGSM" SG_ 609 TravelDistance 0;
BA_ "GenSigTimeoutTime_ASBS" SG_ 609 TravelDistance 0;
BA_ "GenSigTimeoutTime_BCM" SG_ 609 TravelDistance 0;
BA_ "GenSigTimeoutTime_BSM" SG_ 609 TravelDistance 0;
BA_ "GenSigTimeoutTime_CADM" SG_ 609 TravelDistance 0;
BA_ "GenSigTimeoutTime_DMSM" SG_ 609 TravelDistance 0;
BA_ "GenSigTimeoutTime_DTCM" SG_ 609 TravelDistance 0;
BA_ "GenSigTimeoutTime_ELSDM" SG_ 609 TravelDistance 0;
BA_ "GenSigTimeoutTime_ESL" SG_ 609 TravelDistance 0;
BA_ "GenSigTimeoutTime_GNMM" SG_ 609 TravelDistance 0;
BA_ "GenSigTimeoutTime_HCP" SG_ 609 TravelDistance 0;
BA_ "GenSigTimeoutTime_RFHM" SG_ 609 TravelDistance 0;
BA_ "GenSigTimeoutTime_TCM" SG_ 609 TravelDistance 0;
BA_ "GenSigTimeoutTime_ADCAM" SG_ 1155 CRC_BRAKE5 0;
BA_ "GenSigTimeoutTime_ADCAM" SG_ 1155 MessageCounter_BRAKE5 0;
BA_ "GenSigTimeoutTime_ADCAM" SG_ 1155 ABSFailSts 0;
BA_ "GenSigTimeoutTime_ADCAM" SG_ 1155 ACCEngaged 0;
BA_ "GenSigTimeoutTime_VDCM" SG_ 1155 ACCEngaged 0;
BA_ "GenSigTimeoutTime_ADCAM" SG_ 1155 ESCFailSts 0;
BA_ "GenSigTimeoutTime_ADCAM" SG_ 1155 RollsModeAct 0;
BA_ "GenSigTimeoutTime_VDCM" SG_ 1155 RollsModeAct 0;
BA_ "GenSigTimeoutTime_AGSM" SG_ 1155 CRC_BRAKE5 0;
BA_ "GenSigTimeoutTime_ASBS" SG_ 1155 CRC_BRAKE5 0;
BA_ "GenSigTimeoutTime_BCM" SG_ 1155 CRC_BRAKE5 0;
BA_ "GenSigTimeoutTime_BSM" SG_ 1155 CRC_BRAKE5 0;
BA_ "GenSigTimeoutTime_CADM" SG_ 1155 CRC_BRAKE5 0;
BA_ "GenSigTimeoutTime_DMSM" SG_ 1155 CRC_BRAKE5 0;
BA_ "GenSigTimeoutTime_ELSDM" SG_ 1155 CRC_BRAKE5 0;
BA_ "GenSigTimeoutTime_ESL" SG_ 1155 CRC_BRAKE5 0;
BA_ "GenSigTimeoutTime_GNMM" SG_ 1155 CRC_BRAKE5 0;
BA_ "GenSigTimeoutTime_HCP" SG_ 1155 CRC_BRAKE5 0;
BA_ "GenSigTimeoutTime_IPC" SG_ 1155 CRC_BRAKE5 0;
BA_ "GenSigTimeoutTime_RFHM" SG_ 1155 CRC_BRAKE5 0;
BA_ "GenSigTimeoutTime_SGW" SG_ 1155 CRC_BRAKE5 0;
BA_ "GenSigTimeoutTime_AGSM" SG_ 1155 MessageCounter_BRAKE5 0;
BA_ "GenSigTimeoutTime_ADCAM" SG_ 2564485648 N_PDU_18DAF210 0;
BA_ "GenSigTimeoutTime_EVCU2" SG_ 2564485648 N_PDU_18DAF210 0;
BA_ "GenSigTimeoutTime_VDCM" SG_ 2564485648 N_PDU_18DAF210 0;
BA_ "GenSigTimeoutTime_AGSM" SG_ 2564485648 N_PDU_18DAF210 0;
BA_ "GenSigTimeoutTime_ASBS" SG_ 2564485648 N_PDU_18DAF210 0;
BA_ "GenSigTimeoutTime_BCM" SG_ 2564485648 N_PDU_18DAF210 0;
BA_ "GenSigTimeoutTime_BSM" SG_ 2564485648 N_PDU_18DAF210 0;
BA_ "GenSigTimeoutTime_CADM" SG_ 2564485648 N_PDU_18DAF210 0;
BA_ "GenSigTimeoutTime_DMSM" SG_ 2564485648 N_PDU_18DAF210 0;
BA_ "GenSigTimeoutTime_DTCM" SG_ 2564485648 N_PDU_18DAF210 0;
BA_ "GenSigTimeoutTime_ECM" SG_ 2564485648 N_PDU_18DAF210 0;
BA_ "GenSigTimeoutTime_ELSDM" SG_ 2564485648 N_PDU_18DAF210 0;
BA_ "GenSigTimeoutTime_ESL" SG_ 2564485648 N_PDU_18DAF210 0;
BA_ "GenSigTimeoutTime_GNMM" SG_ 2564485648 N_PDU_18DAF210 0;
BA_ "GenSigTimeoutTime_HCP" SG_ 2564485648 N_PDU_18DAF210 0;
BA_ "GenSigTimeoutTime_IPC" SG_ 2564485648 N_PDU_18DAF210 0;
BA_ "GenSigTimeoutTime_RFHM" SG_ 2564485648 N_PDU_18DAF210 0;
BA_ "GenSigTimeoutTime_SGW" SG_ 2564485648 N_PDU_18DAF210 0;
BA_ "GenSigTimeoutTime_TCM" SG_ 2564485648 N_PDU_18DAF210 0;
BA_ "GenSigTimeoutTime_ADCAM" SG_ 2564682000 N_PDU_18DDF110 0;
BA_ "GenSigTimeoutTime_EVCU2" SG_ 2564682000 N_PDU_18DDF110 0;
BA_ "GenSigTimeoutTime_VDCM" SG_ 2564682000 N_PDU_18DDF110 0;
BA_ "GenSigTimeoutTime_AGSM" SG_ 2564682000 N_PDU_18DDF110 0;
BA_ "GenSigTimeoutTime_ASBS" SG_ 2564682000 N_PDU_18DDF110 0;
BA_ "GenSigTimeoutTime_BCM" SG_ 2564682000 N_PDU_18DDF110 0;
BA_ "GenSigTimeoutTime_BSM" SG_ 2564682000 N_PDU_18DDF110 0;
BA_ "GenSigTimeoutTime_CADM" SG_ 2564682000 N_PDU_18DDF110 0;
BA_ "GenSigTimeoutTime_DMSM" SG_ 2564682000 N_PDU_18DDF110 0;
BA_ "GenSigTimeoutTime_DTCM" SG_ 2564682000 N_PDU_18DDF110 0;
BA_ "GenSigTimeoutTime_ECM" SG_ 2564682000 N_PDU_18DDF110 0;
BA_ "GenSigTimeoutTime_ELSDM" SG_ 2564682000 N_PDU_18DDF110 0;
BA_ "GenSigTimeoutTime_ESL" SG_ 2564682000 N_PDU_18DDF110 0;
BA_ "GenSigTimeoutTime_GNMM" SG_ 2564682000 N_PDU_18DDF110 0;
BA_ "GenSigTimeoutTime_HCP" SG_ 2564682000 N_PDU_18DDF110 0;
BA_ "GenSigTimeoutTime_IPC" SG_ 2564682000 N_PDU_18DDF110 0;
BA_ "GenSigTimeoutTime_RFHM" SG_ 2564682000 N_PDU_18DDF110 0;
BA_ "GenSigTimeoutTime_SGW" SG_ 2564682000 N_PDU_18DDF110 0;
BA_ "GenSigTimeoutTime_TCM" SG_ 2564682000 N_PDU_18DDF110 0;
BA_ "GenSigTimeoutTime_ADCAM" SG_ 2564682256 N_PDU_18DDF210 0;
BA_ "GenSigTimeoutTime_EVCU2" SG_ 2564682256 N_PDU_18DDF210 0;
BA_ "GenSigTimeoutTime_VDCM" SG_ 2564682256 N_PDU_18DDF210 0;
BA_ "GenSigTimeoutTime_AGSM" SG_ 2564682256 N_PDU_18DDF210 0;
BA_ "GenSigTimeoutTime_ASBS" SG_ 2564682256 N_PDU_18DDF210 0;
BA_ "GenSigTimeoutTime_BCM" SG_ 2564682256 N_PDU_18DDF210 0;
BA_ "GenSigTimeoutTime_BSM" SG_ 2564682256 N_PDU_18DDF210 0;
BA_ "GenSigTimeoutTime_CADM" SG_ 2564682256 N_PDU_18DDF210 0;
BA_ "GenSigTimeoutTime_DMSM" SG_ 2564682256 N_PDU_18DDF210 0;
BA_ "GenSigTimeoutTime_DTCM" SG_ 2564682256 N_PDU_18DDF210 0;
BA_ "GenSigTimeoutTime_ECM" SG_ 2564682256 N_PDU_18DDF210 0;
BA_ "GenSigTimeoutTime_ELSDM" SG_ 2564682256 N_PDU_18DDF210 0;
BA_ "GenSigTimeoutTime_ESL" SG_ 2564682256 N_PDU_18DDF210 0;
BA_ "GenSigTimeoutTime_GNMM" SG_ 2564682256 N_PDU_18DDF210 0;
BA_ "GenSigTimeoutTime_HCP" SG_ 2564682256 N_PDU_18DDF210 0;
BA_ "GenSigTimeoutTime_IPC" SG_ 2564682256 N_PDU_18DDF210 0;
BA_ "GenSigTimeoutTime_RFHM" SG_ 2564682256 N_PDU_18DDF210 0;
BA_ "GenSigTimeoutTime_SGW" SG_ 2564682256 N_PDU_18DDF210 0;
BA_ "GenSigTimeoutTime_TCM" SG_ 2564682256 N_PDU_18DDF210 0;
BA_ "GenSigTimeoutTime_ADCAM" SG_ 1054 BoostVacGauge 0;
BA_ "GenSigTimeoutTime_EVCU2" SG_ 1054 BoostVacGauge 0;
BA_ "GenSigTimeoutTime_VDCM" SG_ 1054 BoostVacGauge 0;
BA_ "GenSigStartValue" SG_ 1054 BoostVacGauge 100;
BA_ "GenSigSendType" SG_ 1054 BoostVacGauge 4;
BA_ "GenSigTimeoutTime_AGSM" SG_ 1054 BoostVacGauge 0;
BA_ "GenSigTimeoutTime_BCM" SG_ 1054 BoostVacGauge 0;
BA_ "GenSigTimeoutTime_BSM" SG_ 1054 BoostVacGauge 0;
BA_ "GenSigTimeoutTime_DTCM" SG_ 1054 BoostVacGauge 0;
BA_ "GenSigTimeoutTime_ECM" SG_ 1054 BoostVacGauge 0;
BA_ "GenSigTimeoutTime_ESL" SG_ 1054 BoostVacGauge 0;
BA_ "GenSigTimeoutTime_RFHM" SG_ 1054 BoostVacGauge 0;
BA_ "GenSigTimeoutTime_TCM" SG_ 1054 BoostVacGauge 0;
BA_ "GenSigTimeoutTime_ADCAM" SG_ 1054 HighPressureFuelSystemFailure 0;
BA_ "GenSigTimeoutTime_EVCU2" SG_ 1054 HighPressureFuelSystemFailure 0;
BA_ "GenSigTimeoutTime_VDCM" SG_ 1054 HighPressureFuelSystemFailure 0;
BA_ "GenSigTimeoutTime_ADCAM" SG_ 1054 TransWarmUpReq 0;
BA_ "GenSigTimeoutTime_EVCU2" SG_ 1054 TransWarmUpReq 0;
BA_ "GenSigTimeoutTime_VDCM" SG_ 1054 TransWarmUpReq 0;
BA_ "GenSigTimeoutTime_TCM" SG_ 1054 TransWarmUpReq 0;
BA_ "GenSigTimeoutTime_ADCAM" SG_ 1054 Lv1CrsCtrlOff 0;
BA_ "GenSigTimeoutTime_EVCU2" SG_ 1054 Lv1CrsCtrlOff 0;
BA_ "GenSigTimeoutTime_VDCM" SG_ 1054 Lv1CrsCtrlOff 0;
BA_ "GenSigTimeoutTime_EVCU2" SG_ 1054 MessageCounter_ENGINE1 0;
BA_ "GenSigTimeoutTime_VDCM" SG_ 1054 MessageCounter_ENGINE1 0;
BA_ "GenSigTimeoutTime_BCM" SG_ 1054 MessageCounter_ENGINE1 0;
BA_ "GenSigTimeoutTime_RFHM" SG_ 1054 MessageCounter_ENGINE1 0;
BA_ "GenSigTimeoutTime_ADCAM" SG_ 1054 RawTPS1 0;
BA_ "GenSigTimeoutTime_EVCU2" SG_ 1054 RawTPS1 0;
BA_ "GenSigTimeoutTime_VDCM" SG_ 1054 RawTPS1 0;
BA_ "GenSigTimeoutTime_ADCAM" SG_ 1054 RawTPS2 0;
BA_ "GenSigTimeoutTime_EVCU2" SG_ 1054 RawTPS2 0;
BA_ "GenSigTimeoutTime_VDCM" SG_ 1054 RawTPS2 0;
BA_ "GenSigTimeoutTime_ADCAM" SG_ 1054 ThermalManagementActive_W 0;
BA_ "GenSigTimeoutTime_EVCU2" SG_ 1054 ThermalManagementActive_W 0;
BA_ "GenSigTimeoutTime_VDCM" SG_ 1054 ThermalManagementActive_W 0;
BA_ "GenSigTimeoutTime_ADCAM" SG_ 1054 TransWarmUpMin_RPM 0;
BA_ "GenSigTimeoutTime_EVCU2" SG_ 1054 TransWarmUpMin_RPM 0;
BA_ "GenSigTimeoutTime_VDCM" SG_ 1054 TransWarmUpMin_RPM 0;
BA_ "GenSigTimeoutTime_TCM" SG_ 1054 TransWarmUpMin_RPM 0;
BA_ "GenSigTimeoutTime_ADCAM" SG_ 1054 AtmosphericPressureFailSts_W 0;
BA_ "GenSigTimeoutTime_EVCU2" SG_ 1054 AtmosphericPressureFailSts_W 0;
BA_ "GenSigTimeoutTime_VDCM" SG_ 1054 AtmosphericPressureFailSts_W 0;
BA_ "GenSigTimeoutTime_RFHM" SG_ 1054 AtmosphericPressureFailSts_W 0;
BA_ "GenSigTimeoutTime_TCM" SG_ 1054 AtmosphericPressureFailSts_W 0;
BA_ "GenSigTimeoutTime_ADCAM" SG_ 1054 BrkSw1Stat 0;
BA_ "GenSigTimeoutTime_EVCU2" SG_ 1054 BrkSw1Stat 0;
BA_ "GenSigTimeoutTime_VDCM" SG_ 1054 BrkSw1Stat 0;
BA_ "GenSigTimeoutTime_ADCAM" SG_ 1054 BrkSw2Stat 0;
BA_ "GenSigTimeoutTime_EVCU2" SG_ 1054 BrkSw2Stat 0;
BA_ "GenSigTimeoutTime_VDCM" SG_ 1054 BrkSw2Stat 0;
BA_ "GenSigTimeoutTime_EVCU2" SG_ 1054 CRC_ENGINE1 0;
BA_ "GenSigTimeoutTime_VDCM" SG_ 1054 CRC_ENGINE1 0;
BA_ "GenSigTimeoutTime_BCM" SG_ 1054 CRC_ENGINE1 0;
BA_ "GenSigTimeoutTime_RFHM" SG_ 1054 CRC_ENGINE1 0;
BA_ "GenSigTimeoutTime_ADCAM" SG_ 1054 EngMaxRPM_W 0;
BA_ "GenSigTimeoutTime_EVCU2" SG_ 1054 EngMaxRPM_W 0;
BA_ "GenSigTimeoutTime_VDCM" SG_ 1054 EngMaxRPM_W 0;
BA_ "GenSigTimeoutTime_ADCAM" SG_ 1054 ESP_TrqRqEnabl 0;
BA_ "GenSigTimeoutTime_EVCU2" SG_ 1054 ESP_TrqRqEnabl 0;
BA_ "GenSigTimeoutTime_VDCM" SG_ 1054 ESP_TrqRqEnabl 0;
BA_ "GenSigTimeoutTime_ADCAM" SG_ 1054 ACPressureFailSts 0;
BA_ "GenSigTimeoutTime_EVCU2" SG_ 1054 ACPressureFailSts 0;
BA_ "GenSigTimeoutTime_VDCM" SG_ 1054 ACPressureFailSts 0;
BA_ "GenSigTimeoutTime_ADCAM" SG_ 1054 AtmosphericPressure_W 0;
BA_ "GenSigTimeoutTime_EVCU2" SG_ 1054 AtmosphericPressure_W 0;
BA_ "GenSigTimeoutTime_VDCM" SG_ 1054 AtmosphericPressure_W 0;
BA_ "GenSigTimeoutTime_BCM" SG_ 1054 AtmosphericPressure_W 0;
BA_ "GenSigTimeoutTime_BSM" SG_ 1054 AtmosphericPressure_W 0;
BA_ "GenSigTimeoutTime_TCM" SG_ 1054 AtmosphericPressure_W 0;
BA_ "GenSigTimeoutTime_ADCAM" SG_ 1054 ACPressure 0;
BA_ "GenSigTimeoutTime_EVCU2" SG_ 1054 ACPressure 0;
BA_ "GenSigTimeoutTime_VDCM" SG_ 1054 ACPressure 0;
BA_ "GenSigTimeoutTime_ADCAM" SG_ 1054 RawPVS1 0;
BA_ "GenSigTimeoutTime_EVCU2" SG_ 1054 RawPVS1 0;
BA_ "GenSigTimeoutTime_VDCM" SG_ 1054 RawPVS1 0;
BA_ "GenSigTimeoutTime_ADCAM" SG_ 1054 RawPVS2 0;
BA_ "GenSigTimeoutTime_EVCU2" SG_ 1054 RawPVS2 0;
BA_ "GenSigTimeoutTime_VDCM" SG_ 1054 RawPVS2 0;
BA_ "GenSigTimeoutTime_ADCAM" SG_ 1054 ThrottlePosition 0;
BA_ "GenSigTimeoutTime_EVCU2" SG_ 1054 ThrottlePosition 0;
BA_ "GenSigTimeoutTime_VDCM" SG_ 1054 ThrottlePosition 0;
BA_ "GenSigTimeoutTime_AGSM" SG_ 1054 HighPressureFuelSystemFailure 0;
BA_ "GenSigTimeoutTime_ASBS" SG_ 1054 HighPressureFuelSystemFailure 0;
BA_ "GenSigTimeoutTime_BCM" SG_ 1054 HighPressureFuelSystemFailure 0;
BA_ "GenSigTimeoutTime_BSM" SG_ 1054 HighPressureFuelSystemFailure 0;
BA_ "GenSigTimeoutTime_CADM" SG_ 1054 HighPressureFuelSystemFailure 0;
BA_ "GenSigTimeoutTime_DMSM" SG_ 1054 HighPressureFuelSystemFailure 0;
BA_ "GenSigTimeoutTime_DTCM" SG_ 1054 HighPressureFuelSystemFailure 0;
BA_ "GenSigTimeoutTime_ECM" SG_ 1054 HighPressureFuelSystemFailure 0;
BA_ "GenSigTimeoutTime_ELSDM" SG_ 1054 HighPressureFuelSystemFailure 0;
BA_ "GenSigTimeoutTime_ESL" SG_ 1054 HighPressureFuelSystemFailure 0;
BA_ "GenSigTimeoutTime_GNMM" SG_ 1054 HighPressureFuelSystemFailure 0;
BA_ "GenSigTimeoutTime_HCP" SG_ 1054 HighPressureFuelSystemFailure 0;
BA_ "GenSigTimeoutTime_RFHM" SG_ 1054 HighPressureFuelSystemFailure 0;
BA_ "GenSigTimeoutTime_SGW" SG_ 1054 HighPressureFuelSystemFailure 0;
BA_ "GenSigTimeoutTime_TCM" SG_ 1054 HighPressureFuelSystemFailure 0;
BA_ "GenSigTimeoutTime_AGSM" SG_ 1054 TransWarmUpReq 0;
BA_ "GenSigTimeoutTime_ASBS" SG_ 1054 TransWarmUpReq 0;
BA_ "GenSigTimeoutTime_BCM" SG_ 1054 TransWarmUpReq 0;
BA_ "GenSigTimeoutTime_BSM" SG_ 1054 TransWarmUpReq 0;
BA_ "GenSigTimeoutTime_CADM" SG_ 1054 TransWarmUpReq 0;
BA_ "GenSigTimeoutTime_DMSM" SG_ 1054 TransWarmUpReq 0;
BA_ "GenSigTimeoutTime_DTCM" SG_ 1054 TransWarmUpReq 0;
BA_ "GenSigTimeoutTime_ECM" SG_ 1054 TransWarmUpReq 0;
BA_ "GenSigTimeoutTime_ELSDM" SG_ 1054 TransWarmUpReq 0;
BA_ "GenSigTimeoutTime_ESL" SG_ 1054 TransWarmUpReq 0;
BA_ "GenSigTimeoutTime_GNMM" SG_ 1054 TransWarmUpReq 0;
BA_ "GenSigTimeoutTime_HCP" SG_ 1054 TransWarmUpReq 0;
BA_ "GenSigTimeoutTime_IPC" SG_ 1054 TransWarmUpReq 0;
BA_ "GenSigTimeoutTime_RFHM" SG_ 1054 TransWarmUpReq 0;
BA_ "GenSigTimeoutTime_SGW" SG_ 1054 TransWarmUpReq 0;
BA_ "GenSigSendType" SG_ 1054 AGS2Posn 3;
BA_ "GenSigTimeoutTime_AGSM" SG_ 1054 AGS2Posn 0;
BA_ "GenSigTimeoutTime_ASBS" SG_ 1054 AGS2Posn 0;
BA_ "GenSigTimeoutTime_BCM" SG_ 1054 AGS2Posn 0;
BA_ "GenSigTimeoutTime_BSM" SG_ 1054 AGS2Posn 0;
BA_ "GenSigTimeoutTime_CADM" SG_ 1054 AGS2Posn 0;
BA_ "GenSigTimeoutTime_DMSM" SG_ 1054 AGS2Posn 0;
BA_ "GenSigTimeoutTime_DTCM" SG_ 1054 AGS2Posn 0;
BA_ "GenSigTimeoutTime_ECM" SG_ 1054 AGS2Posn 0;
BA_ "GenSigTimeoutTime_ELSDM" SG_ 1054 AGS2Posn 0;
BA_ "GenSigTimeoutTime_ESL" SG_ 1054 AGS2Posn 0;
BA_ "GenSigTimeoutTime_GNMM" SG_ 1054 AGS2Posn 0;
BA_ "GenSigTimeoutTime_IPC" SG_ 1054 AGS2Posn 0;
BA_ "GenSigTimeoutTime_RFHM" SG_ 1054 AGS2Posn 0;
BA_ "GenSigTimeoutTime_SGW" SG_ 1054 AGS2Posn 0;
BA_ "GenSigTimeoutTime_TCM" SG_ 1054 AGS2Posn 0;
BA_ "GenSigTimeoutTime_AGSM" SG_ 1054 Lv1CrsCtrlOff 0;
BA_ "GenSigTimeoutTime_ASBS" SG_ 1054 Lv1CrsCtrlOff 0;
BA_ "GenSigTimeoutTime_BSM" SG_ 1054 Lv1CrsCtrlOff 0;
BA_ "GenSigTimeoutTime_CADM" SG_ 1054 Lv1CrsCtrlOff 0;
BA_ "GenSigTimeoutTime_DMSM" SG_ 1054 Lv1CrsCtrlOff 0;
BA_ "GenSigTimeoutTime_DTCM" SG_ 1054 Lv1CrsCtrlOff 0;
BA_ "GenSigTimeoutTime_ECM" SG_ 1054 Lv1CrsCtrlOff 0;
BA_ "GenSigTimeoutTime_ELSDM" SG_ 1054 Lv1CrsCtrlOff 0;
BA_ "GenSigTimeoutTime_ESL" SG_ 1054 Lv1CrsCtrlOff 0;
BA_ "GenSigTimeoutTime_GNMM" SG_ 1054 Lv1CrsCtrlOff 0;
BA_ "GenSigTimeoutTime_HCP" SG_ 1054 Lv1CrsCtrlOff 0;
BA_ "GenSigTimeoutTime_IPC" SG_ 1054 Lv1CrsCtrlOff 0;
BA_ "GenSigTimeoutTime_RFHM" SG_ 1054 Lv1CrsCtrlOff 0;
BA_ "GenSigTimeoutTime_TCM" SG_ 1054 Lv1CrsCtrlOff 0;
BA_ "GenSigTimeoutTime_AGSM" SG_ 1054 MessageCounter_ENGINE1 0;
BA_ "GenSigTimeoutTime_ASBS" SG_ 1054 MessageCounter_ENGINE1 0;
BA_ "GenSigTimeoutTime_BSM" SG_ 1054 MessageCounter_ENGINE1 0;
BA_ "GenSigTimeoutTime_CADM" SG_ 1054 MessageCounter_ENGINE1 0;
BA_ "GenSigTimeoutTime_DMSM" SG_ 1054 MessageCounter_ENGINE1 0;
BA_ "GenSigTimeoutTime_DTCM" SG_ 1054 MessageCounter_ENGINE1 0;
BA_ "GenSigTimeoutTime_ECM" SG_ 1054 MessageCounter_ENGINE1 0;
BA_ "GenSigTimeoutTime_ELSDM" SG_ 1054 MessageCounter_ENGINE1 0;
BA_ "GenSigTimeoutTime_ESL" SG_ 1054 MessageCounter_ENGINE1 0;
BA_ "GenSigTimeoutTime_GNMM" SG_ 1054 MessageCounter_ENGINE1 0;
BA_ "GenSigTimeoutTime_IPC" SG_ 1054 MessageCounter_ENGINE1 0;
BA_ "GenSigTimeoutTime_SGW" SG_ 1054 MessageCounter_ENGINE1 0;
BA_ "GenSigStartValue" SG_ 1054 RawTPS1 255;
BA_ "GenSigTimeoutTime_AGSM" SG_ 1054 RawTPS1 0;
BA_ "GenSigTimeoutTime_ASBS" SG_ 1054 RawTPS1 0;
BA_ "GenSigTimeoutTime_BSM" SG_ 1054 RawTPS1 0;
BA_ "GenSigTimeoutTime_CADM" SG_ 1054 RawTPS1 0;
BA_ "GenSigTimeoutTime_DMSM" SG_ 1054 RawTPS1 0;
BA_ "GenSigTimeoutTime_DTCM" SG_ 1054 RawTPS1 0;
BA_ "GenSigTimeoutTime_ECM" SG_ 1054 RawTPS1 0;
BA_ "GenSigTimeoutTime_ELSDM" SG_ 1054 RawTPS1 0;
BA_ "GenSigTimeoutTime_ESL" SG_ 1054 RawTPS1 0;
BA_ "GenSigTimeoutTime_GNMM" SG_ 1054 RawTPS1 0;
BA_ "GenSigTimeoutTime_HCP" SG_ 1054 RawTPS1 0;
BA_ "GenSigTimeoutTime_IPC" SG_ 1054 RawTPS1 0;
BA_ "GenSigTimeoutTime_RFHM" SG_ 1054 RawTPS1 0;
BA_ "GenSigTimeoutTime_TCM" SG_ 1054 RawTPS1 0;
BA_ "GenSigStartValue" SG_ 1054 RawTPS2 255;
BA_ "GenSigTimeoutTime_AGSM" SG_ 1054 RawTPS2 0;
BA_ "GenSigTimeoutTime_ASBS" SG_ 1054 RawTPS2 0;
BA_ "GenSigTimeoutTime_BSM" SG_ 1054 RawTPS2 0;
BA_ "GenSigTimeoutTime_CADM" SG_ 1054 RawTPS2 0;
BA_ "GenSigTimeoutTime_DMSM" SG_ 1054 RawTPS2 0;
BA_ "GenSigTimeoutTime_DTCM" SG_ 1054 RawTPS2 0;
BA_ "GenSigTimeoutTime_ECM" SG_ 1054 RawTPS2 0;
BA_ "GenSigTimeoutTime_ELSDM" SG_ 1054 RawTPS2 0;
BA_ "GenSigTimeoutTime_ESL" SG_ 1054 RawTPS2 0;
BA_ "GenSigTimeoutTime_GNMM" SG_ 1054 RawTPS2 0;
BA_ "GenSigTimeoutTime_HCP" SG_ 1054 RawTPS2 0;
BA_ "GenSigTimeoutTime_IPC" SG_ 1054 RawTPS2 0;
BA_ "GenSigTimeoutTime_RFHM" SG_ 1054 RawTPS2 0;
BA_ "GenSigTimeoutTime_TCM" SG_ 1054 RawTPS2 0;
BA_ "GenSigTimeoutTime_AGSM" SG_ 1054 ThermalManagementActive_W 0;
BA_ "GenSigTimeoutTime_ASBS" SG_ 1054 ThermalManagementActive_W 0;
BA_ "GenSigTimeoutTime_BCM" SG_ 1054 ThermalManagementActive_W 0;
BA_ "GenSigTimeoutTime_BSM" SG_ 1054 ThermalManagementActive_W 0;
BA_ "GenSigTimeoutTime_CADM" SG_ 1054 ThermalManagementActive_W 0;
BA_ "GenSigTimeoutTime_DMSM" SG_ 1054 ThermalManagementActive_W 0;
BA_ "GenSigTimeoutTime_DTCM" SG_ 1054 ThermalManagementActive_W 0;
BA_ "GenSigTimeoutTime_ECM" SG_ 1054 ThermalManagementActive_W 0;
BA_ "GenSigTimeoutTime_ELSDM" SG_ 1054 ThermalManagementActive_W 0;
BA_ "GenSigTimeoutTime_ESL" SG_ 1054 ThermalManagementActive_W 0;
BA_ "GenSigTimeoutTime_GNMM" SG_ 1054 ThermalManagementActive_W 0;
BA_ "GenSigTimeoutTime_IPC" SG_ 1054 ThermalManagementActive_W 0;
BA_ "GenSigTimeoutTime_RFHM" SG_ 1054 ThermalManagementActive_W 0;
BA_ "GenSigTimeoutTime_SGW" SG_ 1054 ThermalManagementActive_W 0;
BA_ "GenSigTimeoutTime_TCM" SG_ 1054 ThermalManagementActive_W 0;
BA_ "GenSigTimeoutTime_AGSM" SG_ 1054 TransWarmUpMin_RPM 0;
BA_ "GenSigTimeoutTime_ASBS" SG_ 1054 TransWarmUpMin_RPM 0;
BA_ "GenSigTimeoutTime_BCM" SG_ 1054 TransWarmUpMin_RPM 0;
BA_ "GenSigTimeoutTime_BSM" SG_ 1054 TransWarmUpMin_RPM 0;
BA_ "GenSigTimeoutTime_CADM" SG_ 1054 TransWarmUpMin_RPM 0;
BA_ "GenSigTimeoutTime_DMSM" SG_ 1054 TransWarmUpMin_RPM 0;
BA_ "GenSigTimeoutTime_DTCM" SG_ 1054 TransWarmUpMin_RPM 0;
BA_ "GenSigTimeoutTime_ECM" SG_ 1054 TransWarmUpMin_RPM 0;
BA_ "GenSigTimeoutTime_ELSDM" SG_ 1054 TransWarmUpMin_RPM 0;
BA_ "GenSigTimeoutTime_ESL" SG_ 1054 TransWarmUpMin_RPM 0;
BA_ "GenSigTimeoutTime_GNMM" SG_ 1054 TransWarmUpMin_RPM 0;
BA_ "GenSigTimeoutTime_HCP" SG_ 1054 TransWarmUpMin_RPM 0;
BA_ "GenSigTimeoutTime_IPC" SG_ 1054 TransWarmUpMin_RPM 0;
BA_ "GenSigTimeoutTime_RFHM" SG_ 1054 TransWarmUpMin_RPM 0;
BA_ "GenSigTimeoutTime_SGW" SG_ 1054 TransWarmUpMin_RPM 0;
BA_ "GenSigTimeoutTime_AGSM" SG_ 1054 AtmosphericPressureFailSts_W 0;
BA_ "GenSigTimeoutTime_ASBS" SG_ 1054 AtmosphericPressureFailSts_W 0;
BA_ "GenSigTimeoutTime_BCM" SG_ 1054 AtmosphericPressureFailSts_W 0;
BA_ "GenSigTimeoutTime_BSM" SG_ 1054 AtmosphericPressureFailSts_W 0;
BA_ "GenSigTimeoutTime_CADM" SG_ 1054 AtmosphericPressureFailSts_W 0;
BA_ "GenSigTimeoutTime_DMSM" SG_ 1054 AtmosphericPressureFailSts_W 0;
BA_ "GenSigTimeoutTime_DTCM" SG_ 1054 AtmosphericPressureFailSts_W 0;
BA_ "GenSigTimeoutTime_ECM" SG_ 1054 AtmosphericPressureFailSts_W 0;
BA_ "GenSigTimeoutTime_ELSDM" SG_ 1054 AtmosphericPressureFailSts_W 0;
BA_ "GenSigTimeoutTime_ESL" SG_ 1054 AtmosphericPressureFailSts_W 0;
BA_ "GenSigTimeoutTime_GNMM" SG_ 1054 AtmosphericPressureFailSts_W 0;
BA_ "GenSigTimeoutTime_HCP" SG_ 1054 AtmosphericPressureFailSts_W 0;
BA_ "GenSigTimeoutTime_IPC" SG_ 1054 AtmosphericPressureFailSts_W 0;
BA_ "GenSigTimeoutTime_AGSM" SG_ 1054 BrkSw1Stat 0;
BA_ "GenSigTimeoutTime_ASBS" SG_ 1054 BrkSw1Stat 0;
BA_ "GenSigTimeoutTime_BSM" SG_ 1054 BrkSw1Stat 0;
BA_ "GenSigTimeoutTime_CADM" SG_ 1054 BrkSw1Stat 0;
BA_ "GenSigTimeoutTime_DMSM" SG_ 1054 BrkSw1Stat 0;
BA_ "GenSigTimeoutTime_DTCM" SG_ 1054 BrkSw1Stat 0;
BA_ "GenSigTimeoutTime_ECM" SG_ 1054 BrkSw1Stat 0;
BA_ "GenSigTimeoutTime_ELSDM" SG_ 1054 BrkSw1Stat 0;
BA_ "GenSigTimeoutTime_ESL" SG_ 1054 BrkSw1Stat 0;
BA_ "GenSigTimeoutTime_GNMM" SG_ 1054 BrkSw1Stat 0;
BA_ "GenSigTimeoutTime_HCP" SG_ 1054 BrkSw1Stat 0;
BA_ "GenSigTimeoutTime_IPC" SG_ 1054 BrkSw1Stat 0;
BA_ "GenSigTimeoutTime_RFHM" SG_ 1054 BrkSw1Stat 0;
BA_ "GenSigTimeoutTime_TCM" SG_ 1054 BrkSw1Stat 0;
BA_ "GenSigTimeoutTime_AGSM" SG_ 1054 BrkSw2Stat 0;
BA_ "GenSigTimeoutTime_ASBS" SG_ 1054 BrkSw2Stat 0;
BA_ "GenSigTimeoutTime_BSM" SG_ 1054 BrkSw2Stat 0;
BA_ "GenSigTimeoutTime_CADM" SG_ 1054 BrkSw2Stat 0;
BA_ "GenSigTimeoutTime_DMSM" SG_ 1054 BrkSw2Stat 0;
BA_ "GenSigTimeoutTime_DTCM" SG_ 1054 BrkSw2Stat 0;
BA_ "GenSigTimeoutTime_ECM" SG_ 1054 BrkSw2Stat 0;
BA_ "GenSigTimeoutTime_ELSDM" SG_ 1054 BrkSw2Stat 0;
BA_ "GenSigTimeoutTime_ESL" SG_ 1054 BrkSw2Stat 0;
BA_ "GenSigTimeoutTime_GNMM" SG_ 1054 BrkSw2Stat 0;
BA_ "GenSigTimeoutTime_HCP" SG_ 1054 BrkSw2Stat 0;
BA_ "GenSigTimeoutTime_IPC" SG_ 1054 BrkSw2Stat 0;
BA_ "GenSigTimeoutTime_RFHM" SG_ 1054 BrkSw2Stat 0;
BA_ "GenSigTimeoutTime_TCM" SG_ 1054 BrkSw2Stat 0;
BA_ "GenSigTimeoutTime_AGSM" SG_ 1054 CRC_ENGINE1 0;
BA_ "GenSigTimeoutTime_ASBS" SG_ 1054 CRC_ENGINE1 0;
BA_ "GenSigTimeoutTime_BSM" SG_ 1054 CRC_ENGINE1 0;
BA_ "GenSigTimeoutTime_CADM" SG_ 1054 CRC_ENGINE1 0;
BA_ "GenSigTimeoutTime_DMSM" SG_ 1054 CRC_ENGINE1 0;
BA_ "GenSigTimeoutTime_DTCM" SG_ 1054 CRC_ENGINE1 0;
BA_ "GenSigTimeoutTime_ECM" SG_ 1054 CRC_ENGINE1 0;
BA_ "GenSigTimeoutTime_ELSDM" SG_ 1054 CRC_ENGINE1 0;
BA_ "GenSigTimeoutTime_ESL" SG_ 1054 CRC_ENGINE1 0;
BA_ "GenSigTimeoutTime_GNMM" SG_ 1054 CRC_ENGINE1 0;
BA_ "GenSigTimeoutTime_IPC" SG_ 1054 CRC_ENGINE1 0;
BA_ "GenSigTimeoutTime_SGW" SG_ 1054 CRC_ENGINE1 0;
BA_ "GenSigStartValue" SG_ 1054 EngMaxRPM_W 255;
BA_ "GenSigTimeoutTime_AGSM" SG_ 1054 EngMaxRPM_W 0;
BA_ "GenSigTimeoutTime_ASBS" SG_ 1054 EngMaxRPM_W 0;
BA_ "GenSigTimeoutTime_BCM" SG_ 1054 EngMaxRPM_W 0;
BA_ "GenSigTimeoutTime_BSM" SG_ 1054 EngMaxRPM_W 0;
BA_ "GenSigTimeoutTime_CADM" SG_ 1054 EngMaxRPM_W 0;
BA_ "GenSigTimeoutTime_DMSM" SG_ 1054 EngMaxRPM_W 0;
BA_ "GenSigTimeoutTime_DTCM" SG_ 1054 EngMaxRPM_W 0;
BA_ "GenSigTimeoutTime_ECM" SG_ 1054 EngMaxRPM_W 0;
BA_ "GenSigTimeoutTime_ELSDM" SG_ 1054 EngMaxRPM_W 0;
BA_ "GenSigTimeoutTime_ESL" SG_ 1054 EngMaxRPM_W 0;
BA_ "GenSigTimeoutTime_GNMM" SG_ 1054 EngMaxRPM_W 0;
BA_ "GenSigTimeoutTime_IPC" SG_ 1054 EngMaxRPM_W 0;
BA_ "GenSigTimeoutTime_RFHM" SG_ 1054 EngMaxRPM_W 0;
BA_ "GenSigTimeoutTime_SGW" SG_ 1054 EngMaxRPM_W 0;
BA_ "GenSigTimeoutTime_TCM" SG_ 1054 EngMaxRPM_W 0;
BA_ "GenSigTimeoutTime_AGSM" SG_ 1054 ESP_TrqRqEnabl 0;
BA_ "GenSigTimeoutTime_ASBS" SG_ 1054 ESP_TrqRqEnabl 0;
BA_ "GenSigTimeoutTime_BSM" SG_ 1054 ESP_TrqRqEnabl 0;
BA_ "GenSigTimeoutTime_CADM" SG_ 1054 ESP_TrqRqEnabl 0;
BA_ "GenSigTimeoutTime_DMSM" SG_ 1054 ESP_TrqRqEnabl 0;
BA_ "GenSigTimeoutTime_DTCM" SG_ 1054 ESP_TrqRqEnabl 0;
BA_ "GenSigTimeoutTime_ECM" SG_ 1054 ESP_TrqRqEnabl 0;
BA_ "GenSigTimeoutTime_ELSDM" SG_ 1054 ESP_TrqRqEnabl 0;
BA_ "GenSigTimeoutTime_ESL" SG_ 1054 ESP_TrqRqEnabl 0;
BA_ "GenSigTimeoutTime_GNMM" SG_ 1054 ESP_TrqRqEnabl 0;
BA_ "GenSigTimeoutTime_HCP" SG_ 1054 ESP_TrqRqEnabl 0;
BA_ "GenSigTimeoutTime_IPC" SG_ 1054 ESP_TrqRqEnabl 0;
BA_ "GenSigTimeoutTime_RFHM" SG_ 1054 ESP_TrqRqEnabl 0;
BA_ "GenSigTimeoutTime_TCM" SG_ 1054 ESP_TrqRqEnabl 0;
BA_ "GenSigTimeoutTime_AGSM" SG_ 1054 ACPressureFailSts 0;
BA_ "GenSigTimeoutTime_ASBS" SG_ 1054 ACPressureFailSts 0;
BA_ "GenSigTimeoutTime_BCM" SG_ 1054 ACPressureFailSts 0;
BA_ "GenSigTimeoutTime_BSM" SG_ 1054 ACPressureFailSts 0;
BA_ "GenSigTimeoutTime_CADM" SG_ 1054 ACPressureFailSts 0;
BA_ "GenSigTimeoutTime_DMSM" SG_ 1054 ACPressureFailSts 0;
BA_ "GenSigTimeoutTime_DTCM" SG_ 1054 ACPressureFailSts 0;
BA_ "GenSigTimeoutTime_ECM" SG_ 1054 ACPressureFailSts 0;
BA_ "GenSigTimeoutTime_ELSDM" SG_ 1054 ACPressureFailSts 0;
BA_ "GenSigTimeoutTime_ESL" SG_ 1054 ACPressureFailSts 0;
BA_ "GenSigTimeoutTime_GNMM" SG_ 1054 ACPressureFailSts 0;
BA_ "GenSigTimeoutTime_HCP" SG_ 1054 ACPressureFailSts 0;
BA_ "GenSigTimeoutTime_IPC" SG_ 1054 ACPressureFailSts 0;
BA_ "GenSigTimeoutTime_RFHM" SG_ 1054 ACPressureFailSts 0;
BA_ "GenSigTimeoutTime_SGW" SG_ 1054 ACPressureFailSts 0;
BA_ "GenSigTimeoutTime_TCM" SG_ 1054 ACPressureFailSts 0;
BA_ "GenSigStartValue" SG_ 1054 AtmosphericPressure_W 255;
BA_ "GenSigTimeoutTime_AGSM" SG_ 1054 AtmosphericPressure_W 0;
BA_ "GenSigTimeoutTime_ASBS" SG_ 1054 AtmosphericPressure_W 0;
BA_ "GenSigTimeoutTime_CADM" SG_ 1054 AtmosphericPressure_W 0;
BA_ "GenSigTimeoutTime_DMSM" SG_ 1054 AtmosphericPressure_W 0;
BA_ "GenSigTimeoutTime_DTCM" SG_ 1054 AtmosphericPressure_W 0;
BA_ "GenSigTimeoutTime_ECM" SG_ 1054 AtmosphericPressure_W 0;
BA_ "GenSigTimeoutTime_ELSDM" SG_ 1054 AtmosphericPressure_W 0;
BA_ "GenSigTimeoutTime_ESL" SG_ 1054 AtmosphericPressure_W 0;
BA_ "GenSigTimeoutTime_GNMM" SG_ 1054 AtmosphericPressure_W 0;
BA_ "GenSigTimeoutTime_HCP" SG_ 1054 AtmosphericPressure_W 0;
BA_ "GenSigTimeoutTime_IPC" SG_ 1054 AtmosphericPressure_W 0;
BA_ "GenSigStartValue" SG_ 1054 ACPressure 511;
BA_ "GenSigTimeoutTime_AGSM" SG_ 1054 ACPressure 0;
BA_ "GenSigTimeoutTime_ASBS" SG_ 1054 ACPressure 0;
BA_ "GenSigTimeoutTime_BSM" SG_ 1054 ACPressure 0;
BA_ "GenSigTimeoutTime_CADM" SG_ 1054 ACPressure 0;
BA_ "GenSigTimeoutTime_DMSM" SG_ 1054 ACPressure 0;
BA_ "GenSigTimeoutTime_DTCM" SG_ 1054 ACPressure 0;
BA_ "GenSigTimeoutTime_ECM" SG_ 1054 ACPressure 0;
BA_ "GenSigTimeoutTime_ELSDM" SG_ 1054 ACPressure 0;
BA_ "GenSigTimeoutTime_ESL" SG_ 1054 ACPressure 0;
BA_ "GenSigTimeoutTime_GNMM" SG_ 1054 ACPressure 0;
BA_ "GenSigTimeoutTime_HCP" SG_ 1054 ACPressure 0;
BA_ "GenSigTimeoutTime_IPC" SG_ 1054 ACPressure 0;
BA_ "GenSigTimeoutTime_RFHM" SG_ 1054 ACPressure 0;
BA_ "GenSigTimeoutTime_SGW" SG_ 1054 ACPressure 0;
BA_ "GenSigTimeoutTime_TCM" SG_ 1054 ACPressure 0;
BA_ "GenSigStartValue" SG_ 1054 RawPVS1 255;
BA_ "GenSigTimeoutTime_AGSM" SG_ 1054 RawPVS1 0;
BA_ "GenSigTimeoutTime_ASBS" SG_ 1054 RawPVS1 0;
BA_ "GenSigTimeoutTime_BSM" SG_ 1054 RawPVS1 0;
BA_ "GenSigTimeoutTime_CADM" SG_ 1054 RawPVS1 0;
BA_ "GenSigTimeoutTime_DMSM" SG_ 1054 RawPVS1 0;
BA_ "GenSigTimeoutTime_DTCM" SG_ 1054 RawPVS1 0;
BA_ "GenSigTimeoutTime_ECM" SG_ 1054 RawPVS1 0;
BA_ "GenSigTimeoutTime_ELSDM" SG_ 1054 RawPVS1 0;
BA_ "GenSigTimeoutTime_ESL" SG_ 1054 RawPVS1 0;
BA_ "GenSigTimeoutTime_GNMM" SG_ 1054 RawPVS1 0;
BA_ "GenSigTimeoutTime_HCP" SG_ 1054 RawPVS1 0;
BA_ "GenSigTimeoutTime_IPC" SG_ 1054 RawPVS1 0;
BA_ "GenSigTimeoutTime_RFHM" SG_ 1054 RawPVS1 0;
BA_ "GenSigTimeoutTime_TCM" SG_ 1054 RawPVS1 0;
BA_ "GenSigStartValue" SG_ 1054 RawPVS2 255;
BA_ "GenSigTimeoutTime_AGSM" SG_ 1054 RawPVS2 0;
BA_ "GenSigTimeoutTime_ASBS" SG_ 1054 RawPVS2 0;
BA_ "GenSigTimeoutTime_BSM" SG_ 1054 RawPVS2 0;
BA_ "GenSigTimeoutTime_CADM" SG_ 1054 RawPVS2 0;
BA_ "GenSigTimeoutTime_DMSM" SG_ 1054 RawPVS2 0;
BA_ "GenSigTimeoutTime_DTCM" SG_ 1054 RawPVS2 0;
BA_ "GenSigTimeoutTime_ECM" SG_ 1054 RawPVS2 0;
BA_ "GenSigTimeoutTime_ELSDM" SG_ 1054 RawPVS2 0;
BA_ "GenSigTimeoutTime_ESL" SG_ 1054 RawPVS2 0;
BA_ "GenSigTimeoutTime_GNMM" SG_ 1054 RawPVS2 0;
BA_ "GenSigTimeoutTime_HCP" SG_ 1054 RawPVS2 0;
BA_ "GenSigTimeoutTime_IPC" SG_ 1054 RawPVS2 0;
BA_ "GenSigTimeoutTime_RFHM" SG_ 1054 RawPVS2 0;
BA_ "GenSigTimeoutTime_TCM" SG_ 1054 RawPVS2 0;
BA_ "GenSigTimeoutTime_AGSM" SG_ 1054 ThrottlePosition 0;
BA_ "GenSigTimeoutTime_ASBS" SG_ 1054 ThrottlePosition 0;
BA_ "GenSigTimeoutTime_BSM" SG_ 1054 ThrottlePosition 0;
BA_ "GenSigTimeoutTime_CADM" SG_ 1054 ThrottlePosition 0;
BA_ "GenSigTimeoutTime_DMSM" SG_ 1054 ThrottlePosition 0;
BA_ "GenSigTimeoutTime_DTCM" SG_ 1054 ThrottlePosition 0;
BA_ "GenSigTimeoutTime_ECM" SG_ 1054 ThrottlePosition 0;
BA_ "GenSigTimeoutTime_ELSDM" SG_ 1054 ThrottlePosition 0;
BA_ "GenSigTimeoutTime_ESL" SG_ 1054 ThrottlePosition 0;
BA_ "GenSigTimeoutTime_GNMM" SG_ 1054 ThrottlePosition 0;
BA_ "GenSigTimeoutTime_HCP" SG_ 1054 ThrottlePosition 0;
BA_ "GenSigTimeoutTime_IPC" SG_ 1054 ThrottlePosition 0;
BA_ "GenSigTimeoutTime_RFHM" SG_ 1054 ThrottlePosition 0;
BA_ "GenSigTimeoutTime_TCM" SG_ 1054 ThrottlePosition 0;
BA_ "GenSigTimeoutTime_ADCAM" SG_ 518 Prplsn_Raceoptions_Status_ECM 0;
BA_ "GenSigTimeoutTime_EVCU2" SG_ 518 Prplsn_Raceoptions_Status_ECM 0;
BA_ "GenSigTimeoutTime_VDCM" SG_ 518 Prplsn_Raceoptions_Status_ECM 0;
BA_ "GenSigTimeoutTime_AGSM" SG_ 518 Prplsn_Raceoptions_Status_ECM 0;
BA_ "GenSigTimeoutTime_ECM" SG_ 518 Prplsn_Raceoptions_Status_ECM 0;
BA_ "GenSigTimeoutTime_ESL" SG_ 518 Prplsn_Raceoptions_Status_ECM 0;
BA_ "GenSigTimeoutTime_RFHM" SG_ 518 Prplsn_Raceoptions_Status_ECM 0;
BA_ "GenSigTimeoutTime_TCM" SG_ 518 Prplsn_Raceoptions_Status_ECM 0;
BA_ "GenSigTimeoutTime_ADCAM" SG_ 518 AirFuelRatio 0;
BA_ "GenSigTimeoutTime_EVCU2" SG_ 518 AirFuelRatio 0;
BA_ "GenSigTimeoutTime_VDCM" SG_ 518 AirFuelRatio 0;
BA_ "GenSigStartValue" SG_ 518 AirFuelRatio 255;
BA_ "GenSigTimeoutTime_AGSM" SG_ 518 AirFuelRatio 0;
BA_ "GenSigTimeoutTime_BCM" SG_ 518 AirFuelRatio 0;
BA_ "GenSigTimeoutTime_BSM" SG_ 518 AirFuelRatio 0;
BA_ "GenSigTimeoutTime_DTCM" SG_ 518 AirFuelRatio 0;
BA_ "GenSigTimeoutTime_ECM" SG_ 518 AirFuelRatio 0;
BA_ "GenSigTimeoutTime_ESL" SG_ 518 AirFuelRatio 0;
BA_ "GenSigTimeoutTime_RFHM" SG_ 518 AirFuelRatio 0;
BA_ "GenSigTimeoutTime_TCM" SG_ 518 AirFuelRatio 0;
BA_ "GenSigTimeoutTime_ADCAM" SG_ 518 IntkAirTempIntrClr 0;
BA_ "GenSigTimeoutTime_EVCU2" SG_ 518 IntkAirTempIntrClr 0;
BA_ "GenSigTimeoutTime_VDCM" SG_ 518 IntkAirTempIntrClr 0;
BA_ "GenSigStartValue" SG_ 518 IntkAirTempIntrClr 255;
BA_ "GenSigTimeoutTime_AGSM" SG_ 518 IntkAirTempIntrClr 0;
BA_ "GenSigTimeoutTime_BCM" SG_ 518 IntkAirTempIntrClr 0;
BA_ "GenSigTimeoutTime_BSM" SG_ 518 IntkAirTempIntrClr 0;
BA_ "GenSigTimeoutTime_DTCM" SG_ 518 IntkAirTempIntrClr 0;
BA_ "GenSigTimeoutTime_ECM" SG_ 518 IntkAirTempIntrClr 0;
BA_ "GenSigTimeoutTime_ESL" SG_ 518 IntkAirTempIntrClr 0;
BA_ "GenSigTimeoutTime_RFHM" SG_ 518 IntkAirTempIntrClr 0;
BA_ "GenSigTimeoutTime_TCM" SG_ 518 IntkAirTempIntrClr 0;
BA_ "GenSigTimeoutTime_EVCU2" SG_ 518 RaceModeSts_ECM 0;
BA_ "GenSigTimeoutTime_VDCM" SG_ 518 RaceModeSts_ECM 0;
BA_ "GenSigTimeoutTime_AGSM" SG_ 518 RaceModeSts_ECM 0;
BA_ "GenSigTimeoutTime_ECM" SG_ 518 RaceModeSts_ECM 0;
BA_ "GenSigTimeoutTime_ESL" SG_ 518 RaceModeSts_ECM 0;
BA_ "GenSigTimeoutTime_RFHM" SG_ 518 RaceModeSts_ECM 0;
BA_ "GenSigTimeoutTime_TCM" SG_ 518 RaceModeSts_ECM 0;
BA_ "GenSigTimeoutTime_ADCAM" SG_ 518 LTR_CoolantTemp 0;
BA_ "GenSigTimeoutTime_EVCU2" SG_ 518 LTR_CoolantTemp 0;
BA_ "GenSigTimeoutTime_VDCM" SG_ 518 LTR_CoolantTemp 0;
BA_ "GenSigStartValue" SG_ 518 LTR_CoolantTemp 255;
BA_ "GenSigTimeoutTime_AGSM" SG_ 518 LTR_CoolantTemp 0;
BA_ "GenSigTimeoutTime_BCM" SG_ 518 LTR_CoolantTemp 0;
BA_ "GenSigTimeoutTime_BSM" SG_ 518 LTR_CoolantTemp 0;
BA_ "GenSigTimeoutTime_DTCM" SG_ 518 LTR_CoolantTemp 0;
BA_ "GenSigTimeoutTime_ECM" SG_ 518 LTR_CoolantTemp 0;
BA_ "GenSigTimeoutTime_ESL" SG_ 518 LTR_CoolantTemp 0;
BA_ "GenSigTimeoutTime_RFHM" SG_ 518 LTR_CoolantTemp 0;
BA_ "GenSigTimeoutTime_TCM" SG_ 518 LTR_CoolantTemp 0;
BA_ "GenSigTimeoutTime_ADCAM" SG_ 518 EngTrqMaxCorrFctr_W 0;
BA_ "GenSigTimeoutTime_EVCU2" SG_ 518 EngTrqMaxCorrFctr_W 0;
BA_ "GenSigTimeoutTime_VDCM" SG_ 518 EngTrqMaxCorrFctr_W 0;
BA_ "GenSigTimeoutTime_ADCAM" SG_ 518 GrMin_Rq_ECM_W 0;
BA_ "GenSigTimeoutTime_EVCU2" SG_ 518 GrMin_Rq_ECM_W 0;
BA_ "GenSigTimeoutTime_VDCM" SG_ 518 GrMin_Rq_ECM_W 0;
BA_ "GenSigTimeoutTime_TCM" SG_ 518 GrMin_Rq_ECM_W 0;
BA_ "GenSigTimeoutTime_ADCAM" SG_ 518 MessageCounter_ENGINE5 0;
BA_ "GenSigTimeoutTime_EVCU2" SG_ 518 MessageCounter_ENGINE5 0;
BA_ "GenSigTimeoutTime_VDCM" SG_ 518 MessageCounter_ENGINE5 0;
BA_ "GenSigTimeoutTime_BCM" SG_ 518 MessageCounter_ENGINE5 0;
BA_ "GenSigTimeoutTime_ADCAM" SG_ 518 PdlPosActual 0;
BA_ "GenSigTimeoutTime_EVCU2" SG_ 518 PdlPosActual 0;
BA_ "GenSigTimeoutTime_VDCM" SG_ 518 PdlPosActual 0;
BA_ "GenSigTimeoutTime_ADCAM" SG_ 518 RPMOverRev_W 0;
BA_ "GenSigTimeoutTime_EVCU2" SG_ 518 RPMOverRev_W 0;
BA_ "GenSigTimeoutTime_VDCM" SG_ 518 RPMOverRev_W 0;
BA_ "GenSigTimeoutTime_ADCAM" SG_ 518 CRC_ENGINE5 0;
BA_ "GenSigTimeoutTime_EVCU2" SG_ 518 CRC_ENGINE5 0;
BA_ "GenSigTimeoutTime_VDCM" SG_ 518 CRC_ENGINE5 0;
BA_ "GenSigTimeoutTime_BCM" SG_ 518 CRC_ENGINE5 0;
BA_ "GenSigTimeoutTime_ADCAM" SG_ 518 ECM_CODE_CLR_W 0;
BA_ "GenSigTimeoutTime_VDCM" SG_ 518 ECM_CODE_CLR_W 0;
BA_ "GenSigTimeoutTime_TCM" SG_ 518 ECM_CODE_CLR_W 0;
BA_ "GenSigTimeoutTime_ADCAM" SG_ 518 ECM_READINESS_RESET_W 0;
BA_ "GenSigTimeoutTime_VDCM" SG_ 518 ECM_READINESS_RESET_W 0;
BA_ "GenSigTimeoutTime_TCM" SG_ 518 ECM_READINESS_RESET_W 0;
BA_ "GenSigTimeoutTime_ADCAM" SG_ 518 EngineReadyForESS_W 0;
BA_ "GenSigTimeoutTime_EVCU2" SG_ 518 EngineReadyForESS_W 0;
BA_ "GenSigTimeoutTime_VDCM" SG_ 518 EngineReadyForESS_W 0;
BA_ "GenSigTimeoutTime_TCM" SG_ 518 EngineReadyForESS_W 0;
BA_ "GenSigStartValue" SG_ 518 EngTrqEnblRq_DAS_W 1;
BA_ "GenSigTimeoutTime_AGSM" SG_ 518 EngTrqEnblRq_DAS_W 0;
BA_ "GenSigTimeoutTime_ASBS" SG_ 518 EngTrqEnblRq_DAS_W 0;
BA_ "GenSigTimeoutTime_CADM" SG_ 518 EngTrqEnblRq_DAS_W 0;
BA_ "GenSigTimeoutTime_DMSM" SG_ 518 EngTrqEnblRq_DAS_W 0;
BA_ "GenSigTimeoutTime_DTCM" SG_ 518 EngTrqEnblRq_DAS_W 0;
BA_ "GenSigTimeoutTime_ECM" SG_ 518 EngTrqEnblRq_DAS_W 0;
BA_ "GenSigTimeoutTime_ELSDM" SG_ 518 EngTrqEnblRq_DAS_W 0;
BA_ "GenSigTimeoutTime_ESL" SG_ 518 EngTrqEnblRq_DAS_W 0;
BA_ "GenSigTimeoutTime_GNMM" SG_ 518 EngTrqEnblRq_DAS_W 0;
BA_ "GenSigTimeoutTime_HCP" SG_ 518 EngTrqEnblRq_DAS_W 0;
BA_ "GenSigTimeoutTime_IPC" SG_ 518 EngTrqEnblRq_DAS_W 0;
BA_ "GenSigTimeoutTime_RFHM" SG_ 518 EngTrqEnblRq_DAS_W 0;
BA_ "GenSigTimeoutTime_SGW" SG_ 518 EngTrqEnblRq_DAS_W 0;
BA_ "GenSigTimeoutTime_TCM" SG_ 518 EngTrqEnblRq_DAS_W 0;
BA_ "GenSigStartValue" SG_ 518 EngTrqMaxCorrFctr_W 255;
BA_ "GenSigTimeoutTime_AGSM" SG_ 518 EngTrqMaxCorrFctr_W 0;
BA_ "GenSigTimeoutTime_ASBS" SG_ 518 EngTrqMaxCorrFctr_W 0;
BA_ "GenSigTimeoutTime_BCM" SG_ 518 EngTrqMaxCorrFctr_W 0;
BA_ "GenSigTimeoutTime_BSM" SG_ 518 EngTrqMaxCorrFctr_W 0;
BA_ "GenSigTimeoutTime_CADM" SG_ 518 EngTrqMaxCorrFctr_W 0;
VAL_ 1448 ExhaustTemperature 255 "SNA";
VAL_ 1448 ETCFailSts 0 "Fail_Not_Present" 1 "Fail_Flash_Light_Indication" 2 "Fail_Fix_Light_Indication" 3 "Flash_For_Service";
VAL_ 1448 EngineOperatingMode 0 "Normal" 1 "DPF Regeneration LO" 2 "DPF Regeneration HI" 3 "NSC DeNOx Regeneration" 4 "NSC DeSOx Regeneration" 5 "SCR Heat-up strategy";
VAL_ 1448 EMSFailSts 0 "Fail_Not_Present" 1 "Fail_Flash_Light_Indication" 2 "Fail_Fix_Light_Indication" 3 "Flash_For_Service";
VAL_ 1448 ECM_WARN_BTO 0 "Not_Active" 1 "Active";
VAL_ 1448 ECM_WARN 0 "NONE" 1 "CC_NOT_AVAIL_PLACE_SHIFTER_IN_D" 2 "CC_NOT_AVAIL_PARKBRAKE_ENGAGED" 3 "CC_NOT_AVAIL_STABIL_EVENT_OCCUR" 4 "CC_NOT_AVAIL_LOW_RANGE_4WD" 5 "CC_NOT_AVAIL_VEHICLE_SYSTEM_ERR" 6 "SL_NOT_AVAIL_HDC_SET" 7 "CC_CANC_PLACE_SHIFTER_IN_DRIVE" 8 "CC_CANC_PARKBRAKE_ENGAGED" 9 "CC_CANC_STABILITY_EVENT_OCCUR" 10 "SL_NOT_AVAILABLE_SSC_SET" 11 "CC_CANC_VEHICLE_SYSTEM_ERROR" 12 "CC_OFF_ASL_ACTIVE" 13 "ASL OFF CRUISE ACTIVE" 14 "CC_NOT_AVAIL_BELOW_MIN_RES_SPD" 15 "CC_CANCELLED_ESC_OFF" 16 "CC_UNAVAILABLE_ESC_OFF" 17 "CC_CANCELLED_BY_DRIVER" 18 "CC_OFF" 19 "CC_CANCELLED_RPM_DROPS_TOO_LOW" 20 "CC_NOT_AVAIL_RPM_DROPS_TOO_LOW" 21 "CC_CANCELLED_RPM_TOO_HIGH" 22 "CC_NOT_AVAILABLE_RPM_TOO_HIGH" 23 "DRIVER_CRUISE_OVERRIDE" 24 "CC_NOT_AVAILABLE_HDC_SET" 25 "ISA_NOT_AVAIL_TSR_NOT_AVAIL" 26 "ISA_NOT_AVAIL_SPEED_TOO_HIGH" 27 "ISA_NOT_AVAIL_SPEED_TOO_ LOW" 28 "CC_NOT_AVAIL_ABOVE_MAX_SPD" 29 "CC_UNAVAIL_CORSA_MODE_ON" 30 "SL_UNAVAIL_CORSA_MODE_ON" 31 "CNA_OFF_ROAD_PLUS_ACTIVE";
VAL_ 1448 CompressorSts 0 "Not_Used" 1 "Not_inserted_by_NCM" 2 "Not_insrtd_by_driver_or_security" 3 "Inserted";
VAL_ 751 StartRelayECMFeedbackFault 0 "False" 1 "True";
VAL_ 751 StartRelayBCMFeedbackFault 0 "False" 1 "True";
VAL_ 751 StartProtectionInhibit 0 "Default" 2 "Crank_Inhibit" 3 "SNA";
VAL_ 751 GearShiftIndication 0 "No_Gearshift_Suggestion_by_ECM" 1 "Downshift_Suggestion_by_ECM" 2 "Upshift_Suggestion_by_ECM" 3 "Strategy_Not_Available_ECM_Fail";
VAL_ 751 FuelConsumption_GAG 65535 "SNA";
VAL_ 751 EngineWaterTemp 255 "SNA";
VAL_ 1054 ACPressure 511 "SNA";
VAL_ 517 DrvLnTrqRq 511 "SNA";
VAL_ 517 DrvLnMinTrqMd 0 "False" 1 "True";
VAL_ 517 AWDSysStat 0 "SH_IPG" 1 "4LO" 2 "4HI" 3 "2WD" 4 "NEUTRAL" 5 "SYNC_IPG" 6 "4WDLock" 7 "SNA";
VAL_ 1155 RollsModeAct 0 "Not_active" 1 "Active";
VAL_ 1155 ESCFailSts 0 "Fail_Not_Present" 1 "Fail_Present";
VAL_ 1155 ACCEngaged 0 "Not_Engaged" 1 "Engaged";
VAL_ 1155 ABSFailSts 0 "Fail_Not_Present" 1 "Fail_Present";
VAL_ 609 TravelDistance 255 "SNA";
VAL_ 609 EPBSts 0 "Released" 1 "Applied" 2 "DynamicBrkESC" 3 "DynamicBrkEPB" 4 "Emergency_Braking" 5 "Applying" 6 "Maintenance_Mode" 7 "Assembly_Check" 8 "Inspection_Mode" 9 "Re_Clamping" 10 "Adjuste_Mode" 11 "Releasing" 12 "Fault_EPB_Released" 13 "Fault_EPB_Applied" 14 "Fault_Present" 15 "SNA";
VAL_ 259 RHR_WheelSensorFailSts 0 "Fail_Not_Present" 1 "Fail_Present";
VAL_ 259 RHF_WheelSensorFailSts 0 "Fail_Not_Present" 1 "Fail_Present";
VAL_ 259 LHR_WheelSensorFailSts 0 "Fail_Not_Present" 1 "Fail_Present";
VAL_ 259 LHF_WheelSensorFailSts 0 "Fail_Not_Present" 1 "Fail_Present";
VAL_ 1055 RevOilLifeRst 65535 "SNA";
VAL_ 1055 RefuelEvent 0 "NONE" 1 "PEND" 2 "TRUE" 3 "COMP" 4 "FAULT";
VAL_ 1055 OIL_PRESS 255 "SNA";
VAL_ 1055 MdsActforANC 0 "Not Active" 1 "Active";
VAL_ 1055 MdsAct 0 "Not Active" 1 "Active";
VAL_ 1055 MAP_4_BAR 511 "SNA";
VAL_ 1055 GF_Charge 65535 "SNA";
VAL_ 1055 ENGINE_RESET 0 "Not_Active" 1 "Active";
VAL_ 1055 AM_ECM_Prsnt 0 "DEFAULT" 2 "AM_ECM_PRESENT" 3 "SNA";
VAL_ 1448 SpStSwStat 0 "OFF" 1 "CONT" 2 "BLINK" 3 "SNA";
VAL_ 1448 SpStDispstat 0 "NONE" 1 "PCR_OPENS" 3 "ACTIVE" 4 "D_OR_SB" 5 "NR_DRV_NOT_DET" 6 "DR_INHIB" 7 "TX_INHIB" 8 "KEY" 9 "BATT" 10 "SYSFLT" 11 "NR" 12 "READY" 13 "OFF" 14 "HOOD" 15 "PEDAL" 16 "BATT_CHG" 17 "TM" 18 "T4WD_L" 20 "INCLINE" 21 "AMB_TEMP" 23 "SB" 24 "DR_AJAR" 25 "CABIN" 26 "MAX_HVAC" 27 "FT_DEFROST" 29 "ST_WHEEL" 30 "Eng_Temp_Hi" 31 "Eng_Temp_Lo" 32 "Prk_Brk_Inhib" 33 "Park_Inhib" 34 "Hood_Inhib" 35 "DPF_Regen" 38 "BATT_HIGH" 63 "SNA";
VAL_ 1448 OilPressureSts 0 "Normal_Pressure" 1 "Low_Pressure";
VAL_ 1448 OilLifeSts 0 "Normal_Oil_Properties" 1 "Oil_Life_Reset" 2 "Change_Oil_Required" 3 "Not_used";
VAL_ 1448 HoursOilLifeRst 4095 "SNA";
VAL_ 1448 FuelMM_Sts 0 "INACTIVE" 1 "ACTIVE" 2 "DISABLED";
VAL_ 751 TerrainModeStat_ECM 0 "Auto" 1 "Auto_Fault" 2 "Rock" 3 "Track" 4 "Snow" 5 "Offroad" 6 "Eco" 7 "Corsa" 8 "Sport" 9 "Mud_Sand" 10 "Mud" 11 "Sand" 12 "Valet" 13 "Custom" 14 "Tow" 15 "DRAG" 16 "BAJA" 31 "SNA";
VAL_ 751 TerrainModeDesiredStat 0 "Auto" 1 "Auto_Fault" 2 "Rock" 3 "Track" 4 "Snow" 5 "Offroad" 6 "Eco" 7 "Corsa" 8 "Sport" 9 "Mud_Sand" 10 "Mud" 11 "Sand" 12 "Valet" 13 "Custom" 14 "Tow" 15 "DRAG" 16 "BAJA" 31 "SNA";
VAL_ 751 Terrain_HMI_Rq_ECM 0 "No_Request" 1 "SCREEN_1" 2 "SCREEN_2" 3 "SCREEN_3" 4 "SCREEN_4" 5 "SCREEN_5" 6 "SCREEN_6" 7 "SCREEN_7" 8 "SCREEN_8" 9 "SCREEN_9" 10 "SCREEN_10" 11 "SCREEN_11" 12 "SCREEN_12" 13 "SCREEN_13" 14 "SCREEN_14" 15 "SCREEN_15" 16 "SCREEN_16" 17 "SCREEN_17" 18 "SCREEN_18" 19 "SCREEN_19" 20 "SCREEN_20" 21 "SCREEN_21" 22 "SCREEN_22" 23 "SCREEN_23" 24 "SCREEN_24" 25 "SCREEN_25" 26 "SCREEN_26" 27 "SCREEN_27" 28 "SCREEN_28" 29 "SCREEN_29" 30 "SCREEN_30" 31 "SNA";
VAL_ 751 StarterProtectionTime 255 "SNA";
VAL_ 751 SAMInfo 0 "OFF" 1 "Engine_OFF" 2 "Cranking_management" 3 "ColdEngineManagement" 4 "Eassist_Ready" 5 "Steady_State" 6 "Regenerative_Braking_BSG" 7 "Quick_Charge" 8 "Auto_Shut_OFF" 9 "Shut_OFF" 10 "SAM_recovery" 11 "Battery_Regeneration" 12 "STOP_START" 13 "E_Assist" 14 "NEUTRAL" 15 "SNA";
VAL_ 751 LeakTestSts 0 "NONE" 1 "PEND" 2 "COMPLETE" 3 "DELAY";
VAL_ 751 LeakTestRequest 0 "No_Request" 1 "Leak_Test_Requested";
VAL_ 751 LeakCheckTimerValue 511 "SNA";
VAL_ 751 DrvAway_Inhibit 0 "FALSE" 1 "TRUE";
VAL_ 751 DrvAway_Indications 0 "No_Indication" 1 "DrvAway_Shft_Corr" 2 "DrvAway_Auto_Stop";
VAL_ 751 DrvAway_Alert 0 "FALSE" 1 "TRUE";
VAL_ 518 RPMOverRev_W 0 "FALSE" 1 "TRUE";
VAL_ 518 PdlPosActual 255 "SNA";
VAL_ 518 GrMin_Rq_ECM_W 0 "Passive" 1 "G1" 2 "G2" 3 "G3" 4 "G4" 5 "G5" 6 "G6" 7 "G7" 8 "G8" 9 "G9";
VAL_ 518 EngTrqMaxCorrFctr_W 255 "SNA";
VAL_ 518 EngTrqEnblRq_DAS_W 0 "FALSE" 1 "TRUE";
VAL_ 518 EngineReadyForESS_W 0 "Not_Active" 1 "Active";
VAL_ 518 ECM_READINESS_RESET_W 0 "Not Set" 1 "Set";
VAL_ 518 ECM_CODE_CLR_W 0 "Not Cleared" 1 "Cleared";
VAL_ 1054 TransWarmUpReq 0 "WarmUp_Not_Enabled" 1 "WarmUp_Enabled";
VAL_ 1054 TransWarmUpMin_RPM 255 "SNA";
VAL_ 1054 ThermalManagementActive_W 0 "Not_active" 1 "Active";
VAL_ 1054 EngMaxRPM_W 255 "SNA";
VAL_ 1054 AtmosphericPressureFailSts_W 0 "Fail_Not_Present" 1 "Fail_Present";
VAL_ 1054 AtmosphericPressure_W 255 "SNA";
VAL_ 1054 ACPressureFailSts 0 "Fail_Not_Present" 1 "Fail_Present";
VAL_ 514 BrkPdl_Stat 0 "UPSTOP" 1 "PSD" 2 "NDEF2" 3 "SNA";
VAL_ 514 BrkPdl_Flt 0 "NOT FAULTED" 1 "FAULTED";
VAL_ 514 BrakePdlPosn 255 "SNA";
VAL_ 514 AutoVehHoldSts 0 "Enabled" 1 "NOT Enabled" 2 "Active" 3 "Failed";
VAL_ 609 REPRGD_PFC_CLR_BSM 0 "Do_Nothing" 1 "Set_Incomplete";
VAL_ 609 MIL_OnRq_BSM 0 "False" 1 "True";
VAL_ 609 CODE_CLR_BSM 0 "Do_Nothing" 1 "Set_Incomplete";
VAL_ 259 RHRWheelSpeed 8191 "SNA";
VAL_ 259 RHFWheelSpeed 8191 "SNA";
VAL_ 259 LHRWheelSpeed 8191 "SNA";
VAL_ 259 LHFWheelSpeed 8191 "SNA";
VAL_ 1448 GPFServiceSts 0 "Not_Service" 1 "Rgn_in_process" 2 "Regeneration" 3 "Service" 4 "RGN_CMPT" 5 "PF_PWR_RED" 6 "Not_used" 7 "Not_used";
VAL_ 1068 TCASERANGESTATUS 0 "HIGH" 1 "NTRL" 2 "LOW" 3 "SNA";
VAL_ 514 BSM_ReadyForESS 0 "Not_Ready" 1 "Ready" 2 "Active" 3 "SNA";
VAL_ 751 Selector_SystemFailSts 0 "Fail_Not_Present" 1 "Fail_Present";
VAL_ 1054 HighPressureFuelSystemFailure 0 "No_Fault" 1 "Fault";
VAL_ 1054 AGS2Posn 127 "SNA";
VAL_ 1448 KNK_MG_TRIGGER 0 "LSPI_NO_MESSAGE" 1 "LSPI_LEVEL_1" 2 "LSPI_LEVEL_2" 3 "LSPI_LEVEL_3";
VAL_ 1448 SpStIndRq 0 "Not_Active" 1 "Active";
VAL_ 1448 MntncSts 0 "NONE" 1 "SOON" 2 "NOW" 3 "SNA";
VAL_ 1448 ECM_WARN_BTO_1 0 "Not_Active" 1 "Active";
VAL_ 1055 RefuelIndication 0 "NONE" 1 "WAIT" 2 "PARK" 3 "OK" 4 "DOOR" 5 "BLOCKAGE" 6 "SERVICE";
VAL_ 1055 PSI_Gr5_RPM 31 "SNA";
VAL_ 1055 PSI_Gr4_RPM 31 "SNA";
VAL_ 1055 PSI_Gr3_RPM 31 "SNA";
VAL_ 1055 PSI_Gr2_RPM 31 "SNA";
VAL_ 1055 PSI_Gr1_RPM 31 "SNA";
VAL_ 1055 PSI_EnableSts 0 "Not_Enabled" 1 "Enabled";
VAL_ 1448 PerfShftRq_HUD 0 "DISABLE_MUTE" 1 "PRE_SHIFT 1" 2 "PRE_SHIFT 2" 3 "SHIFT NOW";
VAL_ 751 Trns_DrvMdReq_ECM 0 "NP" 1 "STREET" 2 "VALET" 3 "SPORT" 4 "S_PLUS" 5 "TRACK" 6 "ECO" 7 "SNOW" 8 "ROCK " 9 "TOW" 10 "DRAG" 11 "MUD" 12 "SAND" 13 "BAJA" 14 "OFFROAD" 15 "LAUNCH" 16 "LINELOCK" 31 "SNA";
VAL_ 751 Trns_DrvMd_CfgSts_ECM 0 "NP" 1 "STREET" 2 "VALET" 3 "SPORT" 4 "S_PLUS" 5 "TRACK" 6 "ECO" 7 "SNOW" 8 "ROCK " 9 "TOW" 10 "DRAG" 11 "MUD" 12 "SAND" 13 "BAJA" 14 "OFFROAD" 31 "SNA";
VAL_ 751 TerrainModeInterfaceButton_ECM 0 "Not_Activated" 1 "Activated" 5 "Short_to_Ground_Fault" 6 "Open_Short_to_Power_Fault" 7 "SNA";
VAL_ 518 IntkAirTempIntrClr 255 "SNA";
VAL_ 518 AirFuelRatio 255 "SNA";
VAL_ 751 ECM_FOTA_Conflict 0 "False" 1 "True";
VAL_ 1055 RACE_CLDWN_DEAC_TIME 1023 "SNA";
VAL_ 1055 PCPM_PumpSpeedAct 127 "SNA";
VAL_ 1055 LTR_TARGET_TEMP 254 "Failure" 255 "SNA";
VAL_ 518 LTR_CoolantTemp 255 "SNA";
VAL_ 518 RaceModeSts_ECM 0 "RaceMode_Off" 1 "RaceMode_On" 2 "RaceMode_Active" 3 "RaceMode_Cancelled" 4 "RaceMode_Complete" 5 "RaceMode_Unavailable" 7 "SNA";
VAL_ 518 Prplsn_Raceoptions_Status_ECM 0 "No_Race_Options_Selected" 1 "Launch_Control" 2 "Line_Lock" 3 "Drift" 4 "Donut" 15 "SNA";
VAL_ 1055 Propulsion_DrvMd_Sts_ECM 0 "NP" 1 "STREET" 2 "SPORT" 3 "WET_SNOW" 4 "CUSTOM" 5 "ECO" 6 "TRACK" 7 "DRAG" 8 "ROCK" 9 "TOW" 10 "VALET" 11 "SAND/MUD" 12 "BAJA" 13 "DRIVE_MODE13" 14 "DRIVE_MODE14" 15 "SNA";
VAL_ 1055 Actual_DriveMode_Status_ECM 0 "AUTO" 1 "SPORT" 2 "WET_SNOW" 3 "CUSTOM" 4 "ECO" 5 "TRACK" 6 "DRAG" 7 "DRIFT" 8 "DONUT" 9 "LAUNCH" 10 "VALET" 11 "TOW" 12 "SAND_MUD" 13 "ROCK" 14 "BAJA" 15 "OFFROAD" 16 "LINELOCK" 17 "DRIVEMODE18" 18 "DRIVEMODE19" 19 "DRIVEMODE20" 31 "SNA";
VAL_ 1448 HP_EngPwrMd_RED 1023 "SNA";
VAL_ 1054 BoostVacGauge 255 "SNA";
SIG_GROUP_ 518 ENGINE_FD_5_Pkt 1 : RPMOverRev_W PdlPosActual MessageCounter_ENGINE5 GrMin_Rq_ECM_W EngTrqMaxCorrFctr_W EngTrqEnblRq_DAS_W EngineReadyForESS_W ECM_READINESS_RESET_W ECM_CODE_CLR_W CRC_ENGINE5 IntkAirTempIntrClr AirFuelRatio LTR_CoolantTemp RaceModeSts_ECM Prplsn_Raceoptions_Status_ECM;
SIG_GROUP_ 517 DRIVETRAIN_FD_1_Pkt 1 : DrvLnTrqRq DrvLnMinTrqMd AWDSysStat MessageCounter_DRIVETRAIN1 CRC_DRIVETRAIN1;
SIG_GROUP_ 514 BRAKE_FD_7_Pkt 1 : MessageCounter_BRAKE7 CRC_BRAKE7 BrkPdl_Stat BrkPdl_Flt BrakePdlPosn AutoVehHoldSts BSM_ReadyForESS;
SIG_GROUP_ 1155 BRAKE_FD_5_Pkt 1 : RollsModeAct ESCFailSts ACCEngaged ABSFailSts MessageCounter_BRAKE5 CRC_BRAKE5;
SIG_GROUP_ 609 BRAKE_FD_4_Pkt 1 : TravelDistance EPBSts REPRGD_PFC_CLR_BSM MIL_OnRq_BSM MessageCounter_BRAKE4 CRC_BRAKE4 CODE_CLR_BSM;
SIG_GROUP_ 259 BRAKE_FD_3_Pkt 1 : RHR_WheelSensorFailSts RHF_WheelSensorFailSts LHR_WheelSensorFailSts LHF_WheelSensorFailSts RHRWheelSpeed RHFWheelSpeed MessageCounter_BRAKE3 LHRWheelSpeed LHFWheelSpeed CRC__BRAKE3;
